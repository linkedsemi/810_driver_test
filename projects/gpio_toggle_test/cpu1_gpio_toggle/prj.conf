## CMakeLists.txt
```
# SPDX-License-Identifier: Apache-2.0

cmake_minimum_required(VERSION 3.20.0)
find_package(Zephyr REQUIRED HINTS $ENV{ZEPHYR_BASE})
project(cpu1_gpio_toggle)

target_sources(app PRIVATE
    src/main.c
    ${CMAKE_CURRENT_SOURCE_DIR}/../../../common/test_results.c)
target_include_directories(app PRIVATE
    ${CMAKE_CURRENT_SOURCE_DIR}/../tests/include
    ${CMAKE_CURRENT_SOURCE_DIR}/../../../common)
```

## prj.conf
```kconfig
CONFIG_LOG=y
CONFIG_LOG_MODE_DEFERRED=y
CONFIG_LOG_BUFFER_SIZE=16384
CONFIG_LOG_PROCESS_THREAD_SLEEP_MS=10
CONFIG_LOG_BACKEND_UART=y
# printk 直通 console UART，不经 log 子系统（deferred+shell 后端会吞 printk）
CONFIG_LOG_PRINTK=n
CONFIG_SERIAL=y
CONFIG_SHELL=y
CONFIG_ZTEST=y
CONFIG_ZTEST_ASSERT_VERBOSE=1
CONFIG_ZTEST_VERBOSE_OUTPUT=n
CONFIG_ZTEST_SUMMARY=n
CONFIG_MINIMAL_LIBC=y
CONFIG_NEWLIB_LIBC=n
```

## app.overlay
```dts
/*
 * GPIO 基础翻转测试（cpu1 单核）——无设备树改动。
 *
 * PJ10/PJ11（I3C5 的 SCL/SDA 引脚）由固件经 HAL io_* 接口直接配置为
 * GPIO 推挽输出（per_func_disable_all + io_cfg_output），不经 pinctrl。
 * 板级 dts 中 i2c5/i3c5 默认 disabled（lsqsh_evb_cpu1.dts 已注释），
 * 引脚无其他占用。
 */
```

## src/main.c
```c
/*
 * Copyright (c) 2026 LinkedSemi
 *
 * SPDX-License-Identifier: Apache-2.0
 *
 * GPIO 基础翻转测试 —— cpu1 单核。
 *
 * 用途：时钟链验证。PJ10/PJ11（I3C5 的 SCL/SDA 引脚）以 1s 周期翻转
 * （k_msleep(500) 半周期），示波器实测周期 vs 软件设定 1s：
 *   - 实测周期 ≈1s     → 系统时钟链准确，I2C 速率偏差根因在分频计算
 *   - 实测周期同比偏差 → 时钟源（PLL/晶振/PBUS4 配置）不准
 *
 * 引脚配置走 HAL io_* 直控（ls_soc_gpio.h），不经 Zephyr pinctrl/gpio
 * 子系统；本工程不使能 i2c5/i3c5，PJ10/PJ11 无其他占用。
 *
 * 无限循环翻转（示波器观察），test_main 按设计不返回（CLAUDE.md §4.1）。
 */

#include "gpio_toggle_test_protocol.h"
#include "test_results.h"

#include <zephyr/kernel.h>
#include <zephyr/logging/log.h>
#include <ls_soc_gpio.h>

LOG_MODULE_REGISTER(gpio_toggle_test, LOG_LEVEL_INF);

/* I3C5 的 SCL/SDA 引脚（GPIOJ10/J11） */
#define TOGGLE_PIN_SCL PJ10
#define TOGGLE_PIN_SDA PJ11

void test_main(void)
{
	GPIO_TOGGLE_TGT_BOOT();
	LOG_INF("[CPU1 GPIO_TOGGLE] io toggle test started");

	tr_init(GPIO_TOGGLE_TEST_COUNT);

	GPIO_TOGGLE_TGT_START_VAR(gpio_toggle_test_names[TEST_IO_TOGGLE_1S]);

	/* PJ10/PJ11 配置为 GPIO 推挽输出（确保无片上外设功能占用） */
	per_func_disable_all(TOGGLE_PIN_SCL);
	per_func_disable_all(TOGGLE_PIN_SDA);
	io_cfg_output(TOGGLE_PIN_SCL);
	io_cfg_output(TOGGLE_PIN_SDA);
	io_cfg_pushpull(TOGGLE_PIN_SCL);
	io_cfg_pushpull(TOGGLE_PIN_SDA);

	GPIO_TOGGLE_TGT_INFO(gpio_toggle_test_names[TEST_IO_TOGGLE_1S],
			     "pins=PJ10_PJ11,period_ms=%u,ticks_per_sec=%d",
			     TOGGLE_PERIOD_MS, CONFIG_SYS_CLOCK_TICKS_PER_SEC);

	/* 无限翻转：500ms 半周期 → 1s 方波；示波器人工判定，无 DONE */
	while (true) {
		io_toggle_pin(TOGGLE_PIN_SCL);
		io_toggle_pin(TOGGLE_PIN_SDA);
		k_msleep(TOGGLE_PERIOD_MS / 2);
	}
}
```
