## CMakeLists.txt
```
# SPDX-License-Identifier: Apache-2.0
# sec_iwdg_cpu1_test CMakeLists.txt

cmake_minimum_required(VERSION 3.20.0)
find_package(Zephyr REQUIRED HINTS $ENV{ZEPHYR_BASE})
project(cpu1_sec_iwdg_test)

# 破坏性测试用不同源文件（test.sh 通过 -DWDT_DESTRUCTIVE_RESET 传递）
if(WDT_DESTRUCTIVE_RESET)
    target_sources(app PRIVATE
        src/main.c
        src/wdt_destructive_test.c)
    target_compile_definitions(app PRIVATE WDT_DESTRUCTIVE_RESET=1)
elseif(WDT_BOUNDARY_TEST)
    target_sources(app PRIVATE
        src/main.c
        src/wdt_boundary_test.c)
    target_compile_definitions(app PRIVATE WDT_BOUNDARY_TEST=1)
elseif(WDT_PMU_RESET_TEST)
    target_sources(app PRIVATE
        src/main.c
        src/wdt_pmu_reset_test.c)
    target_compile_definitions(app PRIVATE WDT_PMU_RESET_TEST=1)
else()
    target_sources(app PRIVATE
        src/main.c
        src/wdt_test.c)
endif()

target_include_directories(app PRIVATE
    ${CMAKE_CURRENT_SOURCE_DIR}/../tests/include)

include(${CMAKE_CURRENT_SOURCE_DIR}/../../../common/common_sources.cmake)
```

## prj.conf
```kconfig
CONFIG_LOG=y
CONFIG_LOG_MODE_DEFERRED=y
CONFIG_LOG_BUFFER_SIZE=16384
CONFIG_LOG_PROCESS_THREAD_SLEEP_MS=10
CONFIG_SERIAL=y
CONFIG_SHELL=n
CONFIG_ZTEST=y
CONFIG_ZTEST_ASSERT_VERBOSE=1
CONFIG_ZTEST_VERBOSE_OUTPUT=y
CONFIG_ZTEST_SUMMARY=n
CONFIG_WATCHDOG=y
CONFIG_WDT_DISABLE_AT_BOOT=n
CONFIG_PICOLIBC=y
CONFIG_NEWLIB_LIBC=n
CONFIG_MINIMAL_LIBC=n
CONFIG_GPIO=y
```

## app.overlay
```dts
/*
 * WDT test overlay (cpu1, lsqsh_evb)
 * 使能 sec_iwdg 看门狗实例。
 */

/ {
	chosen {
		zephyr,console = &uart1;
		zephyr,shell-uart = &uart1;
	};
};

&sec_iwdg {
	status = "okay";
};
```

## src/main.c
```c
/*
 * SPDX-License-Identifier: Apache-2.0
 *
 * WDT test - entry point (single-core, cpu1)
 */

#include <zephyr/kernel.h>
#include <zephyr/logging/log.h>
#include "ztest_glue.h"

LOG_MODULE_REGISTER(wdt_test, LOG_LEVEL_INF);

void test_main(void)
{
#ifdef WDT_DESTRUCTIVE_RESET
	extern void wdt_destructive_main(void);
	wdt_destructive_main();
#elif defined(WDT_PMU_RESET_TEST)
	extern void wdt_pmu_reset_main(void);
	wdt_pmu_reset_main();
#else
	LOG_INF("[CPU1 WDT] WDT test started");
	LOG_INF("[CPU1 WDT] non-destructive suite: install/query only, "
		"the watchdog is never allowed to fire -> no reset here. "
		"Real reset: `itest hwreset sec_iwdg` (standalone: "
		"case_destructive_reset / case_pmu_iwdg_full_reset)");
	zt_init("TGT");
	zt_run_all();
#endif
}
```

## src/wdt_boundary_test.c
```c
/*
 * SPDX-License-Identifier: Apache-2.0
 *
 * WDT boundary / error-path tests (non-destructive, sec_iwdg + pmu_iwdg)
 *
 * 对照 zephyr/drivers/watchdog/wdt_iwdg_ls.c 逐分支覆盖：
 *   install_timeout: window.min != 0 拒 / window.max == 0 拒 /
 *                    HAL_IWDG_IS_MATCH 按实例匹配 flags / callback 注册与清除
 *   setup:           IWDT_LOAD == 0 -> -ENOTSUP /
 *                    IWDT_CTRL & (IWDT_EN|IWDT_RST_EN) != 0 -> -EBUSY /
 *                    WDT_OPT_PAUSE_IN_SLEEP -> -ENOTSUP / 正常使能路径
 *   disable/feed:    正常返回 0
 *   换算:            timeout_ms -> IWDT_LOAD ticks（含 uint32 饱和边界）
 *
 * 全部用例均不使能看门狗到超时（setup 成功的用例在断言后立即 disable），
 * 因此不触发任何复位。
 */

#include <zephyr/kernel.h>
#include <zephyr/device.h>
#include <zephyr/devicetree.h>
#include <zephyr/drivers/watchdog.h>
#include <zephyr/ztest.h>
#include <errno.h>

#include "ztest_glue.h"

/*
 * IWDT_LOAD / IWDT_CTRL 在实例寄存器块偏移 0x0 / 0x4。
 * 驱动无 API 把 IWDT_LOAD 复位为 0，故「未安装超时」前置态由测试直接写寄存器复现
 * （白盒前置态设置，不改变被测驱动行为）。
 */
#define IWDG_LOAD_OFFSET 0u
#define IWDG_CTRL_OFFSET 1u

#define SEC_IWDG_REGS ((volatile uint32_t *)DT_REG_ADDR(DT_NODELABEL(sec_iwdg)))

/*
 * sec_iwdg / pmu_iwdg 的 clock-frequency = 32768（lsqsh.dtsi）。
 * 驱动换算（wdt_iwdg_ls.c，iwdt_calculate_load）：
 *     uint64_t ticks = (uint64_t)timeout_ms * frequency / 1000;
 *     return (ticks > UINT32_MAX) ? UINT32_MAX : (uint32_t)ticks;
 *
 * 2026-09-18 驱动修复为 64 位乘法后，本节预期值同步改判（原 4294934 / 0 / 4294934
 * 是按 32 位回绕语义手算的，已作废）。改判后语义：
 *   - 未饱和区（timeout_ms < 131072000）：ticks = timeout_ms * 32768 / 1000；
 *   - 饱和区（timeout_ms >= 131072000）：ticks 超过 UINT32_MAX，饱和到 0xFFFFFFFF。
 * ⚠ 饱和是「钳到硬件寄存器最大值」的本意行为，不是缺陷：0xFFFFFFFF ticks 在 32768 Hz
 *    下约合 131072 s（≈36.4 h）——请求超过该上限即被钳到此值。
 */
#define TICKS_1MS 32u              /* 1 * 32768 / 1000（未饱和区）   */
#define TICKS_1000MS 32768u        /* 1000 * 32768 / 1000（未饱和区） */
/* 64 位饱和边界（timeout_ms >= 131072000 落入饱和区） */
#define TICKS_131071999MS 4294967263u  /* 131071999*32768/1000 = 4294967263（未饱和） */
#define TICKS_131072000MS 0xFFFFFFFFu  /* 131072000*32768/1000 = 2^32 > UINT32_MAX -> 饱和 */
#define TICKS_UINT32_MAX_MS 0xFFFFFFFFu /* 0xFFFFFFFF*32768/1000 远大于 UINT32_MAX -> 饱和 */

static const struct device *sec_dev;
static const struct device *pmu_dev;

static void wdt_boundary_dummy_cb(const struct device *dev, int channel)
{
	ARG_UNUSED(dev);
	ARG_UNUSED(channel);
}

static void *wdt_boundary_setup(void)
{
	sec_dev = DEVICE_DT_GET(DT_NODELABEL(sec_iwdg));
	pmu_dev = DEVICE_DT_GET(DT_NODELABEL(pmu_iwdg));
	zassert_true(device_is_ready(sec_dev), "sec_iwdg not ready");
	zassert_true(device_is_ready(pmu_dev), "pmu_iwdg not ready");
	return NULL;
}

static void wdt_boundary_teardown(void *data)
{
	ARG_UNUSED(data);
	/* 确保两个实例都被关闭，不影响后续用例 */
	wdt_disable(sec_dev);
	wdt_disable(pmu_dev);
}

/* ---- install_timeout: 窗口参数 ---- */

/* window.min != 0：驱动不支持窗口模式，一律 -EINVAL */
ZTEST(sec_iwdg_boundary,test_window_min_nonzero_rejected)
{
	struct wdt_timeout_cfg cfg = {
		.flags = WDT_FLAG_RESET_CPU_CORE,
		.window.min = 1,
		.window.max = 1000,
	};
	int ret = wdt_install_timeout(sec_dev, &cfg);
	zassert_equal(ret, -EINVAL,
		      "install(window.min=1) returned %d, expected -EINVAL", ret);
}

/* window.min == window.max != 0：仍属窗口模式，-EINVAL */
ZTEST(sec_iwdg_boundary,test_window_min_equals_max_rejected)
{
	struct wdt_timeout_cfg cfg = {
		.flags = WDT_FLAG_RESET_CPU_CORE,
		.window.min = 500,
		.window.max = 500,
	};
	int ret = wdt_install_timeout(sec_dev, &cfg);
	zassert_equal(ret, -EINVAL,
		      "install(min==max==500) returned %d, expected -EINVAL", ret);
}

/* window.max == 0：上界为 0 无意义，-EINVAL */
ZTEST(sec_iwdg_boundary,test_window_max_zero_rejected)
{
	struct wdt_timeout_cfg cfg = {
		.flags = WDT_FLAG_RESET_CPU_CORE,
		.window.min = 0,
		.window.max = 0,
	};
	int ret = wdt_install_timeout(sec_dev, &cfg);
	zassert_equal(ret, -EINVAL,
		      "install(window.max=0) returned %d, expected -EINVAL", ret);
}

/* ---- install_timeout: flags × 实例匹配（HAL_IWDG_IS_MATCH） ---- */

/* sec_iwdg 属 HART 复位域，只接受 WDT_FLAG_RESET_CPU_CORE */
ZTEST(sec_iwdg_boundary,test_sec_iwdg_rejects_reset_soc_flag)
{
	struct wdt_timeout_cfg cfg = {
		.flags = WDT_FLAG_RESET_SOC,
		.window.min = 0,
		.window.max = 1000,
	};
	int ret = wdt_install_timeout(sec_dev, &cfg);
	zassert_equal(ret, -EINVAL,
		      "sec_iwdg install(RESET_SOC) returned %d, expected -EINVAL", ret);
}

/* pmu_iwdg 属 SOC 复位域，只接受 WDT_FLAG_RESET_SOC */
ZTEST(sec_iwdg_boundary,test_pmu_iwdg_rejects_reset_cpu_core_flag)
{
	struct wdt_timeout_cfg cfg = {
		.flags = WDT_FLAG_RESET_CPU_CORE,
		.window.min = 0,
		.window.max = 1000,
	};
	int ret = wdt_install_timeout(pmu_dev, &cfg);
	zassert_equal(ret, -EINVAL,
		      "pmu_iwdg install(RESET_CPU_CORE) returned %d, expected -EINVAL", ret);
}

/* flags = 0（WDT_FLAG_RESET_NONE）与未知位 0xFF 均不匹配任何实例 -> -EINVAL */
ZTEST(sec_iwdg_boundary,test_install_rejects_unmatched_flags)
{
	struct wdt_timeout_cfg cfg_none = {
		.flags = WDT_FLAG_RESET_NONE,
		.window.min = 0,
		.window.max = 1000,
	};
	struct wdt_timeout_cfg cfg_ff = {
		.flags = 0xFF,
		.window.min = 0,
		.window.max = 1000,
	};

	int ret_none = wdt_install_timeout(sec_dev, &cfg_none);
	zassert_equal(ret_none, -EINVAL,
		      "install(flags=0) returned %d, expected -EINVAL", ret_none);

	int ret_ff = wdt_install_timeout(sec_dev, &cfg_ff);
	zassert_equal(ret_ff, -EINVAL,
		      "install(flags=0xFF) returned %d, expected -EINVAL", ret_ff);
}

/* 各实例在自身支持的 flags 下 install 成功（返回非负 channel） */
ZTEST(sec_iwdg_boundary,test_install_accepted_on_supported_flags)
{
	struct wdt_timeout_cfg cfg_sec = {
		.flags = WDT_FLAG_RESET_CPU_CORE,
		.window.min = 0,
		.window.max = 60000,
	};
	struct wdt_timeout_cfg cfg_pmu = {
		.flags = WDT_FLAG_RESET_SOC,
		.window.min = 0,
		.window.max = 60000,
	};

	int ch_sec = wdt_install_timeout(sec_dev, &cfg_sec);
	zassert_true(ch_sec >= 0,
		     "sec_iwdg install(RESET_CPU_CORE) returned %d", ch_sec);

	int ch_pmu = wdt_install_timeout(pmu_dev, &cfg_pmu);
	zassert_true(ch_pmu >= 0,
		     "pmu_iwdg install(RESET_SOC) returned %d", ch_pmu);
}

/* ---- install_timeout: callback 注册 / 清除分支 ---- */

/* callback != NULL：驱动走 irq_config_func + data->callback 赋值分支 */
ZTEST(sec_iwdg_boundary,test_install_with_callback_accepted)
{
	struct wdt_timeout_cfg cfg = {
		.flags = WDT_FLAG_RESET_CPU_CORE,
		.window.min = 0,
		.window.max = 60000,
		.callback = wdt_boundary_dummy_cb,
	};
	int ret = wdt_install_timeout(sec_dev, &cfg);
	zassert_equal(ret, 0,
		      "install(callback!=NULL) returned %d, expected 0", ret);

	/* 清除已注册的回调：避免遗留 irq_enable + 非空 data->callback 影响后续用例 */
	struct wdt_timeout_cfg cfg_clear = {
		.flags = WDT_FLAG_RESET_CPU_CORE,
		.window.min = 0,
		.window.max = 60000,
		.callback = NULL,
	};
	(void)wdt_install_timeout(sec_dev, &cfg_clear);
}

/* callback == NULL：驱动走 data->callback 置空分支 */
ZTEST(sec_iwdg_boundary,test_install_without_callback_accepted)
{
	struct wdt_timeout_cfg cfg = {
		.flags = WDT_FLAG_RESET_CPU_CORE,
		.window.min = 0,
		.window.max = 60000,
		.callback = NULL,
	};
	int ret = wdt_install_timeout(sec_dev, &cfg);
	zassert_equal(ret, 0,
		      "install(callback==NULL) returned %d, expected 0", ret);
}

/* ---- setup 错误分支 ---- */

/* IWDT_LOAD == 0（未安装超时）-> -ENOTSUP */
ZTEST(sec_iwdg_boundary,test_setup_without_timeout_enotsup)
{
	/* 复现「未安装超时」前置态：CTRL=0 且 LOAD=0。
	 * 直接写寄存器使本项与套件内其它用例的执行顺序解耦。 */
	wdt_disable(sec_dev);
	SEC_IWDG_REGS[IWDG_LOAD_OFFSET] = 0;
	SEC_IWDG_REGS[IWDG_CTRL_OFFSET] = 0;

	int ret = wdt_setup(sec_dev, 0);
	zassert_equal(ret, -ENOTSUP,
		      "setup without install returned %d, expected -ENOTSUP", ret);
}

/* WDT_OPT_PAUSE_IN_SLEEP 不支持 -> -ENOTSUP（且不使能看门狗） */
ZTEST(sec_iwdg_boundary,test_setup_pause_in_sleep_enotsup)
{
	struct wdt_timeout_cfg cfg = {
		.flags = WDT_FLAG_RESET_CPU_CORE,
		.window.min = 0,
		.window.max = 60000,
	};
	int ch = wdt_install_timeout(sec_dev, &cfg);
	zassert_true(ch >= 0, "install_timeout failed: %d", ch);

	int ret = wdt_setup(sec_dev, WDT_OPT_PAUSE_IN_SLEEP);
	zassert_equal(ret, -ENOTSUP,
		      "setup(PAUSE_IN_SLEEP) returned %d, expected -ENOTSUP", ret);
}

/* IWDT_CTRL != 0（已 setup）-> -EBUSY */
ZTEST(sec_iwdg_boundary,test_setup_twice_ebusy)
{
	struct wdt_timeout_cfg cfg = {
		.flags = WDT_FLAG_RESET_CPU_CORE,
		.window.min = 0,
		.window.max = 60000,
	};
	int ch = wdt_install_timeout(sec_dev, &cfg);
	zassert_true(ch >= 0, "install_timeout failed: %d", ch);

	int ret = wdt_setup(sec_dev, 0);
	zassert_equal(ret, 0, "first setup returned %d, expected 0", ret);

	int ret2 = wdt_setup(sec_dev, 0);
	zassert_equal(ret2, -EBUSY,
		      "second setup returned %d, expected -EBUSY", ret2);

	wdt_disable(sec_dev);
}

/* ---- setup / feed / disable 正常通路 ---- */

/* WDT_OPT_PAUSE_HALTED_BY_DBG 被接受；feed/disable 返回 0 */
ZTEST(sec_iwdg_boundary,test_setup_pause_halted_by_dbg_feed_disable)
{
	struct wdt_timeout_cfg cfg = {
		.flags = WDT_FLAG_RESET_CPU_CORE,
		.window.min = 0,
		.window.max = 60000,
	};
	int ch = wdt_install_timeout(sec_dev, &cfg);
	zassert_true(ch >= 0, "install_timeout failed: %d", ch);

	int ret = wdt_setup(sec_dev, WDT_OPT_PAUSE_HALTED_BY_DBG);
	zassert_equal(ret, 0,
		      "setup(PAUSE_HALTED_BY_DBG) returned %d, expected 0", ret);

	int feed_ret = wdt_feed(sec_dev, ch);
	zassert_equal(feed_ret, 0, "feed returned %d, expected 0", feed_ret);

	int dis_ret = wdt_disable(sec_dev);
	zassert_equal(dis_ret, 0, "disable returned %d, expected 0", dis_ret);
}

/* pmu_iwdg 功能通路：install(RESET_SOC) -> setup -> feed -> disable */
ZTEST(sec_iwdg_boundary,test_pmu_iwdg_lifecycle)
{
	struct wdt_timeout_cfg cfg = {
		.flags = WDT_FLAG_RESET_SOC,
		.window.min = 0,
		.window.max = 60000,
	};
	int ch = wdt_install_timeout(pmu_dev, &cfg);
	zassert_true(ch >= 0, "pmu_iwdg install_timeout returned %d", ch);

	int ret = wdt_setup(pmu_dev, WDT_OPT_PAUSE_HALTED_BY_DBG);
	zassert_equal(ret, 0, "pmu_iwdg setup returned %d, expected 0", ret);

	int feed_ret = wdt_feed(pmu_dev, ch);
	zassert_equal(feed_ret, 0, "pmu_iwdg feed returned %d, expected 0", feed_ret);

	int dis_ret = wdt_disable(pmu_dev);
	zassert_equal(dis_ret, 0, "pmu_iwdg disable returned %d, expected 0", dis_ret);
}

/* ---- timeout_ms -> IWDT_LOAD 换算（边界） ---- */

/* 最小有效超时 1 ms */
ZTEST(sec_iwdg_boundary,test_load_ticks_min_timeout)
{
	struct wdt_timeout_cfg cfg = {
		.flags = WDT_FLAG_RESET_CPU_CORE,
		.window.min = 0,
		.window.max = 1,
	};
	int ch = wdt_install_timeout(sec_dev, &cfg);
	zassert_true(ch >= 0, "install_timeout failed: %d", ch);

	uint32_t load = SEC_IWDG_REGS[IWDG_LOAD_OFFSET];
	ZT_INFO("test_load_ticks_min_timeout", "ms=1,ticks=%u", load);
	zassert_equal(load, TICKS_1MS,
		      "IWDT_LOAD=%u for max=1ms, expected %u", load, TICKS_1MS);
}

/* 常用值 1000 ms */
ZTEST(sec_iwdg_boundary,test_load_ticks_1000ms)
{
	struct wdt_timeout_cfg cfg = {
		.flags = WDT_FLAG_RESET_CPU_CORE,
		.window.min = 0,
		.window.max = 1000,
	};
	int ch = wdt_install_timeout(sec_dev, &cfg);
	zassert_true(ch >= 0, "install_timeout failed: %d", ch);

	uint32_t load = SEC_IWDG_REGS[IWDG_LOAD_OFFSET];
	ZT_INFO("test_load_ticks_1000ms", "ms=1000,ticks=%u", load);
	zassert_equal(load, TICKS_1000MS,
		      "IWDT_LOAD=%u for max=1000ms, expected %u", load, TICKS_1000MS);
}

/*
 * 饱和边界下侧：131071999 ms —— 64 位算式 131071999*32768/1000 = 4294967263，
 * 未超过 UINT32_MAX，故 IWDT_LOAD = 4294967263。
 * 2026-09-18 驱动改为 64 位乘法后改判（原值 4294934 是按 32 位回绕语义手算的）。
 */
ZTEST(sec_iwdg_boundary,test_load_ticks_just_below_saturation)
{
	struct wdt_timeout_cfg cfg = {
		.flags = WDT_FLAG_RESET_CPU_CORE,
		.window.min = 0,
		.window.max = 131071999u,
	};
	int ch = wdt_install_timeout(sec_dev, &cfg);
	zassert_true(ch >= 0, "install_timeout failed: %d", ch);

	uint32_t load = SEC_IWDG_REGS[IWDG_LOAD_OFFSET];
	ZT_INFO("test_load_ticks_just_below_saturation", "ms=131071999,ticks=%u", load);
	zassert_equal(load, TICKS_131071999MS,
		      "IWDT_LOAD=%u for max=131071999ms, expected %u",
		      load, TICKS_131071999MS);
}

/*
 * 饱和边界：131072000 ms —— 64 位算式 131072000*32768/1000 = 2^32 > UINT32_MAX，
 * 触发饱和，故 IWDT_LOAD = 0xFFFFFFFF（本意 = 钳到硬件寄存器最大值）。
 * 2026-09-18 驱动改为 64 位乘法后改判（原值 0 是按 32 位回绕语义手算的）。
 */
ZTEST(sec_iwdg_boundary,test_load_ticks_saturation_boundary)
{
	struct wdt_timeout_cfg cfg = {
		.flags = WDT_FLAG_RESET_CPU_CORE,
		.window.min = 0,
		.window.max = 131072000u,
	};
	int ch = wdt_install_timeout(sec_dev, &cfg);
	zassert_true(ch >= 0, "install_timeout failed: %d", ch);

	uint32_t load = SEC_IWDG_REGS[IWDG_LOAD_OFFSET];
	ZT_INFO("test_load_ticks_saturation_boundary", "ms=131072000,ticks=%u", load);
	zassert_equal(load, TICKS_131072000MS,
		      "IWDT_LOAD=%u for max=131072000ms, expected %u",
		      load, TICKS_131072000MS);
}

/*
 * 饱和区上界：window.max 取 uint32 上限 0xFFFFFFFF ms —— 64 位算式远大于 UINT32_MAX，
 * 触发饱和，故 IWDT_LOAD = 0xFFFFFFFF（与 131072000 ms 同值）。
 * 2026-09-18 驱动改为 64 位乘法后改判（原值 4294934 是按 32 位回绕语义手算的）。
 */
ZTEST(sec_iwdg_boundary,test_load_ticks_uint32_max_timeout)
{
	struct wdt_timeout_cfg cfg = {
		.flags = WDT_FLAG_RESET_CPU_CORE,
		.window.min = 0,
		.window.max = 0xFFFFFFFFu,
	};
	int ch = wdt_install_timeout(sec_dev, &cfg);
	zassert_true(ch >= 0, "install_timeout failed: %d", ch);

	uint32_t load = SEC_IWDG_REGS[IWDG_LOAD_OFFSET];
	ZT_INFO("test_load_ticks_uint32_max_timeout", "ms=4294967295,ticks=%u", load);
	zassert_equal(load, TICKS_UINT32_MAX_MS,
		      "IWDT_LOAD=%u for max=UINT32_MAX ms, expected %u",
		      load, TICKS_UINT32_MAX_MS);
}

/* teardown 放在 after 槽（第 5 个参数）：每条 case 之后都关狗，避免断言
 * 失败时把已装好的 sec/pmu 看门狗留给后续套件（本套件现在可进 run all）。 */
ZTEST_SUITE(sec_iwdg_boundary, NULL, wdt_boundary_setup, NULL, wdt_boundary_teardown, NULL);
```

## src/wdt_destructive_test.c
```c
/*
 * SPDX-License-Identifier: Apache-2.0
 *
 * WDT destructive reset test - 触发 sec_iwdg 硬件复位
 *
 * 独立 main，不走 ztest（流程不是独立测试项而是状态机）。
 *
 * 流程：
 *   Phase 0 (第一次启动): 设置 2000ms 超时，不喂狗，等复位
 *   Phase 1 (复位后启动): 检查 reset_reason == SEC_IWDT_HART_RESET，
 *                         打印 PASS/FAIL + PROJECT EXECUTION 裁决行
 *   Phase 2 (上一轮遗留): 本次启动没装狗、没复位、没校验 ⇒ 不打裁决；
 *                         清 noinit 状态后按 Phase 0 重跑一轮完整流程
 *
 * noinit 跨复位保留既是本状态机的基础，也意味着重复 load/run 会读到上一轮
 * 的终态（GDB load 不写 NOLOAD 段）。故"测试通过"只能由本轮真跑出来的
 * Phase 1 宣布。
 */

#include <zephyr/kernel.h>
#include <zephyr/device.h>
#include <zephyr/devicetree.h>
#include <zephyr/drivers/watchdog.h>
#include <zephyr/sys/reboot.h>
#include <errno.h>
#include <string.h>

#include "soc_reset.h"

/* noinit 段跨复位保留 */
__noinit static uint32_t test_phase;  /* 0=未跑, 1=已跑(等复位), 2=复位后验证 */
__noinit static uint32_t phase0_passed;  /* 第一阶段是否执行完 */

#define WDT_NODE DT_NODELABEL(sec_iwdg)
#define WDT_TIMEOUT_MS 2000

static bool wdt_is_watchdog_reset(uint32_t reason);
static const char *wdt_reset_reason_name(uint32_t reason);
static void wdt_phase1_verdict(uint32_t reason);

void wdt_destructive_main(void)
{
	printk("\n*** WDT destructive reset test ***\n");
	printk("Reset reason: %u\n", reset_reason_get());
	printk("test_phase: %u, phase0_passed: %u\n", test_phase, phase0_passed);

	/* Phase 2: noinit 里是上一轮留下的终态（或上电随机值）。本次启动尚未
	 * 装狗、未复位、未校验 ⇒ 此处不产生任何裁决行；清状态后落到下面的
	 * Phase 0 重新走完整流程，裁决由那一轮的 Phase 1 给出。 */
	if (test_phase != 0 && test_phase != 1) {
		printk("PHASE 2: stale noinit state (test_phase=%u), no test ran this "
		       "boot; clearing and restarting from PHASE 0\n", test_phase);
		test_phase = 0;
		phase0_passed = 0;
	}

phase0_restart:
	if (test_phase == 0) {
		/* Phase 0: 设置超时，不喂狗，等复位 */
		printk("PHASE 0: install timeout, will NOT feed, expecting reset in %d ms\n",
		       WDT_TIMEOUT_MS);

		const struct device *wdt_dev = DEVICE_DT_GET(WDT_NODE);
		if (!device_is_ready(wdt_dev)) {
			printk("ERROR: sec_iwdg not ready\n");
			printk("PROJECT EXECUTION: FAILED\n");
			k_sleep(K_FOREVER);
		}

		struct wdt_timeout_cfg cfg = {
			.flags = WDT_FLAG_RESET_CPU_CORE,
			.window.min = 0,
			.window.max = WDT_TIMEOUT_MS,
		};
		int channel = wdt_install_timeout(wdt_dev, &cfg);
		if (channel < 0) {
			printk("ERROR: install_timeout failed: %d\n", channel);
			printk("PROJECT EXECUTION: FAILED\n");
			k_sleep(K_FOREVER);
		}
		printk("channel: %d\n", channel);

		int ret = wdt_setup(wdt_dev, WDT_OPT_PAUSE_HALTED_BY_DBG);
		if (ret != 0) {
			printk("ERROR: wdt_setup failed: %d\n", ret);
			printk("PROJECT EXECUTION: FAILED\n");
			k_sleep(K_FOREVER);
		}
		printk("wdt_setup OK\n");

		test_phase = 1;
		phase0_passed = 1;
		printk("PHASE 0 complete, waiting for watchdog reset...\n");

		/* 不喂狗，等 sec_iwdg 超时复位 */
		k_sleep(K_FOREVER);

		/* 正常情况下不会执行到这里 */
		printk("ERROR: wdt did not reset after timeout!\n");
		printk("PROJECT EXECUTION: FAILED\n");
		k_sleep(K_FOREVER);
	} else {
		/* test_phase == 1：上一轮 Phase 0 已装狗等复位。
		 *
		 * 但 noinit 段跨"重烧 + 复位"存活（GDB/烧录器不写 NOLOAD 段），
		 * 所以 phase==1 也可能是**上一次会话**留下的。只有"复位来源确实是看门狗"
		 * 才证明本轮真的走完了 Phase 0；其它来源（重烧、上电、调试器复位）
		 * 说明本轮没跑过测试 —— 清状态重来，绝不打裁决。
		 *
		 * 实测 2026-10-28：没有这个检查时，重烧后首次调用会拿烧录复位原因
		 * 去比对，打出假的 `FAIL: reset_reason == 3`，随后 k_sleep(K_FOREVER)
		 * 把 shell 线程永久挂死（后续 `itest reset` 采集 120 s 零字节）。 */
		uint32_t reason = reset_reason_get();

		if (!wdt_is_watchdog_reset(reason)) {
			printk("STALE: phase==1 but reset_reason=%u (%s) is not a "
			       "watchdog reset; no test ran this boot, restarting "
			       "from PHASE 0\n", reason, wdt_reset_reason_name(reason));
			test_phase = 0;
			phase0_passed = 0;
			goto phase0_restart;
		} else {
			/* Phase 1: 复位后检查 reset_reason */
			printk("PHASE 1: after reset, checking reset_reason\n");
			wdt_phase1_verdict(reason);
		}
	}
}

/* 复位来源是否为看门狗（本文件用到的三种）。 */
static bool wdt_is_watchdog_reset(uint32_t reason)
{
	return reason == SEC_IWDT_HART_RESET ||
	       reason == SEC_WWDT_HART_RESET ||
	       reason == SYS_IWDT_FULL_RESET;
}

static const char *wdt_reset_reason_name(uint32_t reason)
{
	switch (reason) {
	case NO_RESET_REASON:     return "NO_RESET_REASON";
	case PWR_FULL_RESET:      return "PWR_FULL_RESET";
	case SOFT_FULL_RESET:     return "SOFT_FULL_RESET";
	case CPU_FULL_RESET:      return "CPU_FULL_RESET";
	case SYS_IWDT_FULL_RESET: return "SYS_IWDT_FULL_RESET";
	case EXT_FULL_RESET:      return "EXT_FULL_RESET";
	case SEC_IWDT_HART_RESET: return "SEC_IWDT_HART_RESET";
	case SEC_WWDT_HART_RESET: return "SEC_WWDT_HART_RESET";
	case SOFT_HART_RESET:     return "SOFT_HART_RESET";
	default:                  return "UNKNOWN";
	}
}

static void wdt_phase1_verdict(uint32_t reason)
{
	/* sec_iwdg 用 WDT_FLAG_RESET_CPU_CORE → 触发 HART 复位
	 * （SEC_IWDT_HART_RESET=6），不是 FULL reset（SYS_IWDT=4）。 */
	bool ok = (reason == SEC_IWDT_HART_RESET);

	if (ok) {
		printk("PASS: reset_reason == SEC_IWDT_HART_RESET (expected)\n");
	} else {
		printk("FAIL: reset_reason == %u, expected SEC_IWDT_HART_RESET (%d)\n",
		       reason, SEC_IWDT_HART_RESET);
	}
	test_phase = 2;
	printk("PROJECT EXECUTION: %s\n", ok ? "SUCCESSFUL" : "FAILED");
	k_sleep(K_FOREVER);
}
```

## src/wdt_pmu_reset_test.c
```c
/*
 * SPDX-License-Identifier: Apache-2.0
 *
 * WDT pmu_iwdg full-reset test - 触发 pmu_iwdg 整芯片复位
 *
 * 独立 main，不走 ztest（流程是跨复位状态机，不是独立测试项）。
 *
 * sec_iwdg 与 pmu_iwdg 是两条独立复位路径：
 *   sec_iwdg + WDT_FLAG_RESET_CPU_CORE -> SEC_IWDT_HART_RESET（只复位本 hart）
 *   pmu_iwdg + WDT_FLAG_RESET_SOC      -> SYS_IWDT_FULL_RESET（整芯片复位）
 *
 * 流程：
 *   Phase 0（第一次启动）: 装 2s 超时，不喂狗，等整芯片复位
 *   Phase 1（复位后启动）: 校验 reset_reason == SYS_IWDT_FULL_RESET
 *   Phase 2（上一轮遗留）: 本次启动没装狗、没复位、没校验 ⇒ 不打裁决；
 *                         清 noinit 状态后按 Phase 0 重跑一轮完整流程
 *
 * noinit 跨复位保留既是本状态机的基础，也意味着重复 load/run 会读到上一轮
 * 的终态（GDB load 不写 NOLOAD 段）。故"测试通过"只能由本轮真跑出来的
 * Phase 1 宣布。
 *
 * ⚠ 本 case 会整芯片复位（连带另一核与全部外设），必须单独运行，
 *   不进批量回归（与 case_destructive_reset 同理）。
 */

#include <zephyr/kernel.h>
#include <zephyr/device.h>
#include <zephyr/devicetree.h>
#include <zephyr/drivers/watchdog.h>
#include <errno.h>

#include "soc_reset.h"

/* noinit 段跨复位保留 */
__noinit static uint32_t pmu_test_phase;   /* 0=未跑, 1=已装超时等复位, 2=复位后已校验 */
__noinit static uint32_t pmu_phase0_passed;

#define WDT_NODE DT_NODELABEL(pmu_iwdg)
#define WDT_TIMEOUT_MS 2000

void wdt_pmu_reset_main(void)
{
	printk("\n*** WDT pmu_iwdg full-reset test ***\n");
	printk("Reset reason: %u\n", reset_reason_get());
	printk("pmu_test_phase: %u, pmu_phase0_passed: %u\n",
	       pmu_test_phase, pmu_phase0_passed);

	/* Phase 2: noinit 里是上一轮留下的终态（或上电随机值）。本次启动尚未
	 * 装狗、未复位、未校验 ⇒ 此处不产生任何裁决行；清状态后落到下面的
	 * Phase 0 重新走完整流程，裁决由那一轮的 Phase 1 给出。 */
	if (pmu_test_phase != 0 && pmu_test_phase != 1) {
		printk("PHASE 2: stale noinit state (pmu_test_phase=%u), no test ran this "
		       "boot; clearing and restarting from PHASE 0\n", pmu_test_phase);
		pmu_test_phase = 0;
		pmu_phase0_passed = 0;
	}

phase0_restart:
	if (pmu_test_phase == 0) {
		/* Phase 0: 装超时，不喂狗，等整芯片复位 */
		printk("PHASE 0: install pmu_iwdg timeout (SOC reset), will NOT feed, "
		       "expecting full reset in %d ms\n", WDT_TIMEOUT_MS);

		const struct device *wdt_dev = DEVICE_DT_GET(WDT_NODE);
		if (!device_is_ready(wdt_dev)) {
			printk("ERROR: pmu_iwdg not ready\n");
			printk("PROJECT EXECUTION: FAILED\n");
			k_sleep(K_FOREVER);
		}

		struct wdt_timeout_cfg cfg = {
			.flags = WDT_FLAG_RESET_SOC,
			.window.min = 0,
			.window.max = WDT_TIMEOUT_MS,
		};
		int channel = wdt_install_timeout(wdt_dev, &cfg);
		if (channel < 0) {
			printk("ERROR: install_timeout failed: %d\n", channel);
			printk("PROJECT EXECUTION: FAILED\n");
			k_sleep(K_FOREVER);
		}
		printk("channel: %d\n", channel);

		int ret = wdt_setup(wdt_dev, 0);
		if (ret != 0) {
			printk("ERROR: wdt_setup failed: %d\n", ret);
			printk("PROJECT EXECUTION: FAILED\n");
			k_sleep(K_FOREVER);
		}
		printk("wdt_setup OK\n");

		pmu_phase0_passed = 1;
		pmu_test_phase = 1;
		printk("PHASE 0 complete, waiting for pmu_iwdg full reset...\n");

		/* 不喂狗，等 pmu_iwdg 超时整芯片复位 */
		k_sleep(K_FOREVER);

		/* 正常情况下不会执行到这里 */
		printk("ERROR: pmu_iwdg did not reset after timeout!\n");
		printk("PROJECT EXECUTION: FAILED\n");
		k_sleep(K_FOREVER);
	} else {
		/* pmu_test_phase == 1：上一轮 Phase 0 已装狗等复位。
		 *
		 * noinit 段跨"重烧 + 复位"存活，phase==1 也可能是上一次会话留下的。
		 * 只有"复位来源是看门狗"才证明本轮真的走完了 Phase 0；否则清状态重来，
		 * 不打裁决（否则重烧后会拿烧录复位原因比对，打出假 FAIL 并挂死 shell）。 */
		uint32_t reason = reset_reason_get();

		if (reason != SYS_IWDT_FULL_RESET &&
		    reason != SEC_IWDT_HART_RESET &&
		    reason != SEC_WWDT_HART_RESET) {
			printk("STALE: pmu_test_phase==1 but reset_reason=%u is not a "
			       "watchdog reset; no test ran this boot, restarting "
			       "from PHASE 0\n", reason);
			pmu_test_phase = 0;
			pmu_phase0_passed = 0;
			goto phase0_restart;
		}

		/* Phase 1: 复位后校验复位原因 */
		printk("PHASE 1: after reset, checking reset_reason\n");
		bool ok = (reason == SYS_IWDT_FULL_RESET);

		if (ok) {
			printk("PASS: reset_reason == SYS_IWDT_FULL_RESET (expected)\n");
			printk("PROJECT EXECUTION: SUCCESSFUL\n");
		} else {
			printk("FAIL: reset_reason == %u, expected SYS_IWDT_FULL_RESET (%d)\n",
			       reason, SYS_IWDT_FULL_RESET);
			printk("PROJECT EXECUTION: FAILED\n");
		}
		pmu_test_phase = 2;
		k_sleep(K_FOREVER);
	}
}
```

## src/wdt_test.c
```c
/*
 * SPDX-License-Identifier: Apache-2.0
 *
 * WDT test cases (non-destructive, sec_iwdg)
 *
 * 破坏性 case（触发复位）需要 XIP 变体 + noinit 状态机，
 * 成本太高不纳入本工程，由独立脚本跑。
 * 本工程只跑非破坏性 case（不触发复位）。
 */

#include <zephyr/kernel.h>
#include <zephyr/device.h>
#include <zephyr/devicetree.h>
#include <zephyr/drivers/watchdog.h>
#include <zephyr/ztest.h>
#include <errno.h>

/*
 * 白盒回读 sec_iwdg 寄存器块（与同工程 case_boundary 的
 * wdt_boundary_test.c:35 同款做法）：
 *   IWDT_LOAD / IWDT_CTRL 在偏移 0x0 / 0x4
 *   （modules/hal/linkedsemi/hal_driver/inc/reg_iwdgv2_type.h:5-8）。
 * 驱动 install_timeout 只写不读、disable 只写 IWDT_CTRL=0，API 层拿不到
 * 这两项的落地结果，故这里直接回读寄存器做判别性断言。
 * sec_iwdg clock-frequency = 32768（zephyr/dts/riscv/linkedsemi/lsqsh.dtsi:590）。
 */
#define SEC_IWDG_REGS ((volatile uint32_t *)DT_REG_ADDR(DT_NODELABEL(sec_iwdg)))
#define IWDG_LOAD_OFFSET 0u
#define IWDG_CTRL_OFFSET 1u

/* iwdt_calculate_load 的 64 位算式（wdt_iwdg_ls.c:43-51）：ms * 32768 / 1000 */
#define WDT_TICKS_5000MS  163840u   /*  5000 * 32768 / 1000 */
#define WDT_TICKS_10000MS 327680u   /* 10000 * 32768 / 1000 */

static const struct device *wdt_dev;

static void *wdt_test_setup(void)
{
	wdt_dev = DEVICE_DT_GET(DT_NODELABEL(sec_iwdg));
	zassert_true(device_is_ready(wdt_dev), "sec_iwdg not ready");
	return NULL;
}

static void wdt_test_teardown(void *data)
{
	ARG_UNUSED(data);
	/* 确保狗被关闭，不影响后续 case。pmu_iwdg 也要关：本套件现在可进
	 * run all，任何一条 case 断言失败都不能把已装好的狗留给后面的套件
	 * （10s 后复位会打断整批）。 */
	wdt_disable(wdt_dev);
	wdt_disable(DEVICE_DT_GET(DT_NODELABEL(pmu_iwdg)));
}

/* TC-1: install_timeout with max_time_ms=0 -> -EINVAL */
ZTEST(sec_iwdg, test_wdt_invalid_timeout_min)
{
	struct wdt_timeout_cfg cfg = {
		.flags = WDT_FLAG_RESET_CPU_CORE,
		.window.min = 0,
		.window.max = 0,
	};
	int ret = wdt_install_timeout(wdt_dev, &cfg);
	zassert_equal(ret, -EINVAL,
		"install_timeout(max=0) returned %d, expected -EINVAL", ret);
}

/* TC-2: install_timeout with invalid flags -> -EINVAL */
ZTEST(sec_iwdg, test_wdt_invalid_flags)
{
	struct wdt_timeout_cfg cfg = {
		.flags = 0xFF,  /* 无效 flags */
		.window.min = 0,
		.window.max = 500,
	};
	int ret = wdt_install_timeout(wdt_dev, &cfg);

	/* 驱动在 HAL_IWDG_IS_MATCH(reg, flags) == 0 时返回 -EINVAL
	 * （wdt_iwdg_ls.c:108-112）。HAL_IWDG_IS_MATCH 只认
	 * WDT_FLAG_RESET_CPU_CORE(1) / WDT_FLAG_RESET_SOC(2)，其余一律返回 0
	 * （modules/hal/linkedsemi/soc/rv32/qsh/ls_msp_iwdg.c:72-81）
	 * ⇒ 0xFF 两者皆非 ⇒ 必返回 -EINVAL。
	 * 驱动正确时必过；驱动若把未识别 flags 静默接受（返回 >=0）则必不过。 */
	zassert_equal(ret, -EINVAL,
		"install(flags=0xFF) returned %d, expected -EINVAL", ret);
}

/* TC-3: setup + feed (不复位) */
ZTEST(sec_iwdg, test_wdt_setup_then_feed)
{
	struct wdt_timeout_cfg cfg = {
		.flags = WDT_FLAG_RESET_CPU_CORE,
		.window.min = 0,
		.window.max = 10000,  /* 10s 超时 */
	};
	int channel = wdt_install_timeout(wdt_dev, &cfg);
	zassert_true(channel >= 0, "install_timeout failed: %d", channel);

	int ret = wdt_setup(wdt_dev, WDT_OPT_PAUSE_HALTED_BY_DBG);
	zassert_equal(ret, 0, "wdt_setup failed: %d", ret);

	/* 连续 feed 5 次（间隔 1s < 10s 超时），不应复位 */
	for (int i = 0; i < 5; i++) {
		wdt_feed(wdt_dev, channel);
		k_msleep(1000);
	}

	wdt_disable(wdt_dev);
}

/* TC-4: disable 后不再触发回调 */
ZTEST(sec_iwdg, test_wdt_disable)
{
	struct wdt_timeout_cfg cfg = {
		.flags = WDT_FLAG_RESET_CPU_CORE,
		.window.min = 0,
		.window.max = 500,
	};
	int channel = wdt_install_timeout(wdt_dev, &cfg);
	zassert_true(channel >= 0, "install_timeout failed: %d", channel);

	int ret = wdt_setup(wdt_dev, WDT_OPT_PAUSE_HALTED_BY_DBG);
	zassert_equal(ret, 0, "wdt_setup failed: %d", ret);

	wdt_disable(wdt_dev);

	/* disable 生效判据：驱动 iwdt_ls_disable 把 IWDT_CTRL 写 0
	 * （wdt_iwdg_ls.c:131-136），回读必为 0。
	 * 驱动正确时必过；disable 未真正清 CTRL（例如漏写或写错实例）时必不过。
	 * （原用例只靠"1s 内没复位"隐式判定：若 disable 没生效但超时窗口早已错过，
	 *  同样不会复位 ⇒ 判别力弱，补此直接判据。） */
	zassert_equal(SEC_IWDG_REGS[IWDG_CTRL_OFFSET], 0u,
		      "IWDT_CTRL must read 0 right after wdt_disable()");

	/* 等 1s（超过 500ms 超时），因已 disable 不应复位 */
	k_msleep(1000);
}

/* TC-5: install 两次超时（第二次应报错，单通道） */
ZTEST(sec_iwdg, test_wdt_two_timeouts_not_supported)
{
	struct wdt_timeout_cfg cfg1 = {
		.flags = WDT_FLAG_RESET_CPU_CORE,
		.window.min = 0,
		.window.max = 10000,
	};
	int ch1 = wdt_install_timeout(wdt_dev, &cfg1);
	zassert_true(ch1 >= 0, "first install_timeout failed: %d", ch1);

	struct wdt_timeout_cfg cfg2 = {
		.flags = WDT_FLAG_RESET_CPU_CORE,
		.window.min = 0,
		.window.max = 5000,
	};
	int ch2 = wdt_install_timeout(wdt_dev, &cfg2);
	zassert_true(ch2 >= 0, "second install_timeout failed: %d", ch2);

	/* 驱动没有"通道数"概念：iwdt_ls_install_timeout 每次都对同一个
	 * IWDT_LOAD 覆盖写新 cfg 的 ticks（wdt_iwdg_ls.c:122-126），第二次
	 * 安装必返回 0（channel 0）。可测的单通道不变式：
	 *   第二次安装后 IWDT_LOAD == ticks(5000ms) = 5000*32768/1000 = 163840，
	 *   且不再是第一次的 ticks(10000ms) = 327680。
	 * 驱动正确时必过；驱动若把第二次安装拒绝（返回负）或未覆盖装载值
	 * （仍留 10000ms 的 327680）则必不过。 */
	uint32_t load = SEC_IWDG_REGS[IWDG_LOAD_OFFSET];
	zassert_equal(load, WDT_TICKS_5000MS,
		      "IWDT_LOAD=%u after second install(max=5000ms), expected %u "
		      "(单通道覆盖；first install max=10000ms -> %u)",
		      load, WDT_TICKS_5000MS, WDT_TICKS_10000MS);

	wdt_disable(wdt_dev);
}

ZTEST_SUITE(sec_iwdg, NULL, wdt_test_setup, NULL, wdt_test_teardown, NULL);
```
