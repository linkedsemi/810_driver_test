## CMakeLists.txt
```
# SPDX-License-Identifier: Apache-2.0

cmake_minimum_required(VERSION 3.20.0)
find_package(Zephyr REQUIRED HINTS $ENV{ZEPHYR_BASE})
project(cpu1_crypto_api_test)

# 项目特定源文件
target_sources(app PRIVATE
    src/main.c
    src/sm4_crypto_test.c
    src/sm4_ext_test.c
    src/hash_crypto_test.c
    src/crypto_err_test.c)

# 项目特定include目录（向量本体在 ../tests/expected）
target_include_directories(app PRIVATE
    ${CMAKE_CURRENT_SOURCE_DIR}/../tests/include
    ${CMAKE_CURRENT_SOURCE_DIR}/../tests/expected)

# 包含公共源文件和配置（test_results.c, ztest_glue.c, gpio_toggle.c）
include(${CMAKE_CURRENT_SOURCE_DIR}/../../../common/common_sources.cmake)
```

## prj.conf
```kconfig
# crypto_api_test 单核基座配置（cpu1 安全域，lsqsh_evb@1os/lsqsh/cpu1）。
#
# 被测对象 = Zephyr crypto 驱动 API（zephyr/crypto/crypto.h 的
# cipher_*_op / hash_* 系列），驱动本体在 zephyr/drivers/crypto/
# crypto_linkedsemi_{sm4,sha256,sha512}.c。
#
# ⚠️ 具体使能哪颗驱动由各 case 的 case.conf 差异注入
#    （tests/case_*/case.conf，CONF_FILE 合并）。本文件把三颗都**钉成 n**：
#    app.overlay 里三个 DT 节点全局 status="okay"（DT_HAS_*_ENABLED 成立），
#    而这些 Kconfig 的 default 是 y ⇒ 不钉死的话每个 case 都会静默带上全部驱动。

# ---- log 输出规范（CLAUDE.md §4.1：统一 LOG_INF、deferred buf 模式） ----
CONFIG_LOG=y
CONFIG_LOG_MODE_DEFERRED=y
CONFIG_LOG_BUFFER_SIZE=16384
CONFIG_LOG_PROCESS_THREAD_SLEEP_MS=10
CONFIG_LOG_BACKEND_UART=y
CONFIG_LOG_PRINTK=n
CONFIG_SERIAL=y
CONFIG_SHELL=n

# ---- ztest 原生框架 ----
# CONFIG_ZTEST_VERBOSE_OUTPUT 是逐项 START/PASS/FAIL 行的门控，必须 =y，
# 否则 harness 只见 PROJECT EXECUTION 一行、逐项结果全 MISSING。
CONFIG_ZTEST=y
CONFIG_ZTEST_ASSERT_VERBOSE=1
CONFIG_ZTEST_VERBOSE_OUTPUT=y
CONFIG_ZTEST_SUMMARY=n
CONFIG_ZTEST_STACK_SIZE=16384
CONFIG_MAIN_STACK_SIZE=8192

# ---- libc 三件套（缺一构建失败，KNOWN_ISSUES #58） ----
CONFIG_PICOLIBC=y
CONFIG_NEWLIB_LIBC=n
CONFIG_MINIMAL_LIBC=n

# ---- GPIO support for PA05/PA07 toggle threads ----
CONFIG_GPIO=y

# ---- crypto 子系统（驱动 Kconfig 的 depends 前提） ----
CONFIG_CRYPTO=y

# 驱动基线：三个都关，由 case.conf 按 case 打开
CONFIG_CRYPTO_LINKEDSEMI_SM4=n
CONFIG_CRYPTO_LINKEDSEMI_SHA256=n
CONFIG_CRYPTO_LINKEDSEMI_SHA512=n
```

## app.overlay
```dts
/*
 * SPDX-License-Identifier: Apache-2.0
 *
 * crypto_api_test 单核 overlay（cpu1 安全域）。
 *
 * 三颗加密引擎节点在 SoC dtsi 里默认 status="disabled"，而驱动 Kconfig
 * （CRYPTO_LINKEDSEMI_{SM4,SHA256,SHA512}）的 depends 是
 * DT_HAS_LINKEDSEMI_*_ENABLED ⇒ 不使能节点时 Kconfig 根本不存在。
 *
 * 这里统一使能三个节点，但 prj.conf 已把三个驱动 Kconfig 钉成 n，
 * 实际编入哪颗由各 case 的 case.conf 决定 —— 未使能驱动的节点不会生成
 * 实例、不注册 SYS_INIT、不占中断。
 */

&sm4 {
	status = "okay";
};

&sha256 {
	status = "okay";
};

&sha512 {
	status = "okay";
};

/* GPIO toggle 使能块统一走公共层（SPEC_REFERENCE §6.1.9 复用收敛）：
 * 使能 GPIOA（PA05/PA07 翻转线程所在端口），label 调整只改公共文件。 */
#include "../../../common/gpio_toggle.dtsi"
```

## src/main.c
```c
/*
 * SPDX-License-Identifier: Apache-2.0
 *
 * crypto_api_test 单核测试入口（cpu1 安全域）。
 * 纯 ztest：test_main 打印角色 banner 后 zt_init + zt_run_all
 * （common/ztest_glue），不返回（同 ztest 语义）。
 */

#include <zephyr/kernel.h>

#include "ztest_glue.h"

void test_main(void)
{
	printk("[CPU1 CRYPTO API] crypto api test started\n");   /* 角色 banner（harness 依赖） */

	zt_init("TGT");
	zt_run_all();
}
```

## src/crypto_err_test.c
```c
/*
 * SPDX-License-Identifier: Apache-2.0
 *
 * Crypto 驱动 API 的**错误返回**校验（负例）。
 *
 * DUT（同一镜像内三颗驱动）：
 *   zephyr/drivers/crypto/crypto_linkedsemi_sm4.c
 *   zephyr/drivers/crypto/crypto_linkedsemi_sha256.c
 *   zephyr/drivers/crypto/crypto_linkedsemi_sha512.c
 *
 * 判据来源 = **本驱动的实际契约**（2026-10-29 实机复核），按 API 层级区分：
 *
 *   - session 级不支持（algo / mode / flags）→ `-ENOTSUP`
 *       本驱动 `crypto_linkedsemi_{sm4,sha256,sha512}.c` 在这些路径上
 *       一律 `return -ENOTSUP` 并打 `LOG_ERR("Unsupported …")`。语义上也
 *       更贴切：这些参数的**枚举值本身合法**，只是驱动不支持，不属"参数非法"。
 *       ⚠️ 与本树多数厂商驱动（`return -EINVAL` 184 处 vs `-ENOTSUP` 23 处）
 *       **刻意不一致**：驱动侧统一成 -EINVAL 会波及 mbedtls 等其它工程，
 *       本仓测试按驱动真实契约断言。若将来驱动统一口径，本组期望值需同步改
 *       （见 KNOWN_ISSUES #157）。
 *   - keylen 错误 → `-ENOTSUP`（session 级参数不受支持，与 O-55 方案②一致）
 *   - 参数越界（CCM 的 NULL / out_buf_max 不足 / tag_len）→ `-EINVAL`
 *
 * ⚠️ 2026-11-03 驱动临时改过 keylen→-EINVAL、out_buf_max→-EMSGSIZE；
 *    用户裁定**测试保持上述原始判断**，由**驱动侧后续改回对齐**。因此
 *    `sm4_bad_keylen` / `sm4_ccm_params` 当前为**预期 FAIL**，驱动对齐后转 PASS。
 *
 * ⚠️ 历史沿革：本组用例原先按生态多数惯例把 session 级也断言为 `-EINVAL`，
 *    导致对当前驱动 7 项恒 FAIL。2026-10-29 核实"驱动 session/pkt 两套错误码
 *    是有意为之、且各自语义自洽"后改判为本驱动的真实契约。**这不是放宽校验**：
 *    仍是逐值精确断言，错误码不同照样 FAIL。
 *
 * ⚠️ 负例的"假 PASS"防线：所有 CCM 负例**先跑一次合法调用作正对照**，
 *    只有正对照返回 0 时，后续 `ret == -EINVAL` 才有判别力（否则"全返 -EINVAL"
 *    的实现也能让负例全绿）。
 *
 * ⚠️ 未覆盖（驱动侧缺口，登记在 COVERAGE.md）：
 *   - GCM 路径**没有任何参数校验**，NULL 入参会直接解引用（Load access fault），
 *     故不做 NULL 负例（会把整个 case 打崩）；需驱动先补校验。
 *   - ECB/CBC 对 `in_len % 16 != 0` 既无错误码也无断言：ECB 忽略余块后
 *     `return ret;`（`ret` 未初始化），CBC 同样忽略余块。无确定返回值可断言，
 *     故不写负例，记为覆盖缺口。
 */

#include <errno.h>
#include <stdbool.h>
#include <string.h>

#include <zephyr/kernel.h>
#include <zephyr/device.h>
#include <zephyr/ztest.h>
#include <zephyr/crypto/crypto.h>

#include "ztest_glue.h"

#if defined(CONFIG_CRYPTO_LINKEDSEMI_SM4) || \
	defined(CONFIG_CRYPTO_LINKEDSEMI_SHA256) || \
	defined(CONFIG_CRYPTO_LINKEDSEMI_SHA512)

/* 合法 flags：RAW_KEY + SYNC + SEPARATE_IO_BUFS（两个 wrapper 的断言都要求
 * 恰好一个 IO 类型、恰好一个 sync/async 类型） */
#define ERR_VALID_FLAGS (CAP_RAW_KEY | CAP_SYNC_OPS | CAP_SEPARATE_IO_BUFS)
/* 非法但能过 wrapper 断言的 flags：只声明 ASYNC（驱动 caps 不含它） */
#define ERR_ASYNC_FLAGS (CAP_RAW_KEY | CAP_ASYNC_OPS | CAP_SEPARATE_IO_BUFS)

#define ERR_MSG_LEN 64
#define ERR_NONCE_LEN 12
#define ERR_AAD_LEN 8
#define ERR_TAG_LEN 16

/* ============================ SM4 ============================ */
#if defined(CONFIG_CRYPTO_LINKEDSEMI_SM4)

static const struct device *err_sm4_dev = DEVICE_DT_GET(DT_NODELABEL(sm4));

static const uint8_t err_sm4_key[16] = {
	0xFF, 0xEE, 0xDD, 0xCC, 0xBB, 0xAA, 0x99, 0x88,
	0x77, 0x66, 0x55, 0x44, 0x33, 0x22, 0x11, 0x00,
};

ZTEST_SUITE(sm4_err, NULL, NULL, NULL, NULL, NULL);

static int err_sm4_begin(enum cipher_algo algo, uint16_t keylen,
			 uint16_t flags, enum cipher_mode mode)
{
	struct cipher_ctx ctx = {
		.keylen = keylen,
		.key.bit_stream = err_sm4_key,
		.flags = flags,
	};

	return cipher_begin_session(err_sm4_dev, &ctx, algo, mode,
				    CRYPTO_CIPHER_OP_ENCRYPT);
}

/* ---- 能力位与设备就绪：三条必需能力必须都声明 ----
 * 测试名一律带 `sm4_`/`hash_` 前缀：run_test.py 的 unit_test_names 会剥掉
 * suite 名（只取 `<suite>__<name>` 的后半段），同名项在报告表里会撞键。 */
ZTEST(sm4_err, sm4_caps)
{
	int caps = crypto_query_hwcaps(err_sm4_dev);
	bool ready = device_is_ready(err_sm4_dev);
	bool raw = (caps & CAP_RAW_KEY) != 0;
	bool sync = (caps & CAP_SYNC_OPS) != 0;
	bool sep = (caps & CAP_SEPARATE_IO_BUFS) != 0;

	ZT_INFO("sm4_caps", "ready=%d,caps=0x%x,raw_key=%d,sync=%d,sep_io=%d",
		ready, caps, raw, sync, sep);

	zassert_true(ready, "sm4 device not ready");
	zassert_true(raw, "sm4 caps missing CAP_RAW_KEY (0x%x)", caps);
	zassert_true(sync, "sm4 caps missing CAP_SYNC_OPS (0x%x)", caps);
	zassert_true(sep, "sm4 caps missing CAP_SEPARATE_IO_BUFS (0x%x)", caps);
}

/* ---- 不支持的算法 → -ENOTSUP ---- */
ZTEST(sm4_err, sm4_bad_algo)
{
	int ret = err_sm4_begin(CRYPTO_CIPHER_ALGO_AES, 16, ERR_VALID_FLAGS,
				CRYPTO_CIPHER_MODE_ECB);

	ZT_INFO("sm4_bad_algo", "algo=aes,ret=%d,ok=%d", ret, ret == -ENOTSUP);

	zassert_equal(ret, -ENOTSUP, "begin_session(AES) ret=%d, expected -ENOTSUP", ret);
}

/* ---- 错误 key 长度 → -ENOTSUP ----
 * 保持 O-55 方案② 的原始判断（session 级"不支持"用 -ENOTSUP）。
 * 驱动 2026-11-03 曾改为 -EINVAL；用户裁定测试不改、由驱动侧后续对齐。 */
ZTEST(sm4_err, sm4_bad_keylen)
{
	int ret = err_sm4_begin(CRYPTO_CIPHER_ALGO_SM4, 24, ERR_VALID_FLAGS,
				CRYPTO_CIPHER_MODE_ECB);

	ZT_INFO("sm4_bad_keylen", "keylen=24,ret=%d,ok=%d", ret, ret == -ENOTSUP);

	zassert_equal(ret, -ENOTSUP, "begin_session(keylen=24) ret=%d, expected -ENOTSUP", ret);
}

/* ---- 不支持的 flags（ASYNC，驱动只有同步实现）→ -ENOTSUP ---- */
ZTEST(sm4_err, sm4_bad_flags)
{
	int ret = err_sm4_begin(CRYPTO_CIPHER_ALGO_SM4, 16, ERR_ASYNC_FLAGS,
				CRYPTO_CIPHER_MODE_ECB);

	ZT_INFO("sm4_bad_flags", "flags=0x%lx,ret=%d,ok=%d",
		(unsigned long)ERR_ASYNC_FLAGS, ret, ret == -ENOTSUP);

	zassert_equal(ret, -ENOTSUP, "begin_session(CAP_ASYNC_OPS) ret=%d, expected -ENOTSUP",
		      ret);
}

/* ---- 不支持的模式 → -ENOTSUP ---- */
ZTEST(sm4_err, sm4_bad_mode)
{
	int ret = err_sm4_begin(CRYPTO_CIPHER_ALGO_SM4, 16, ERR_VALID_FLAGS,
				(enum cipher_mode)0);

	ZT_INFO("sm4_bad_mode", "mode=0,ret=%d,ok=%d", ret, ret == -ENOTSUP);

	zassert_equal(ret, -ENOTSUP, "begin_session(mode=0) ret=%d, expected -ENOTSUP", ret);
}

/* ---- CCM 参数越界 → -EINVAL；输出缓冲不足 → -EMSGSIZE（先做正对照） ---- */
static int err_ccm_call(struct cipher_ctx *ctx, uint8_t *nonce,
			uint8_t *in, int in_len, uint8_t *out, int out_max,
			uint8_t *ad, uint32_t ad_len, uint8_t *tag)
{
	struct cipher_pkt pkt = {
		.in_buf = in,
		.in_len = in_len,
		.out_buf = out,
		.out_buf_max = out_max,
	};
	struct cipher_aead_pkt aead = {
		.pkt = &pkt,
		.ad = ad,
		.ad_len = ad_len,
		.tag = tag,
	};

	return cipher_ccm_op(ctx, &aead, nonce);
}

ZTEST(sm4_err, sm4_ccm_params)
{
	struct cipher_ctx ctx = {
		.keylen = 16,
		.key.bit_stream = err_sm4_key,
		.flags = ERR_VALID_FLAGS,
	};
	uint8_t nonce[ERR_NONCE_LEN] = {
		0x00, 0x01, 0x02, 0x03, 0x04, 0x05,
		0x06, 0x07, 0x08, 0x09, 0x0A, 0x0B,
	};
	uint8_t aad[ERR_AAD_LEN] = { 0, 1, 2, 3, 4, 5, 6, 7 };
	uint8_t in[ERR_MSG_LEN];
	uint8_t out[ERR_MSG_LEN];
	uint8_t tag[ERR_TAG_LEN];
	int ret_null_out, ret_null_in, ret_null_ad, ret_small_out;
	int ret_tag_short, ret_tag_odd, ret_tag_big;
	int ret_base, ret_begin;
	bool base_ok;

	for (size_t i = 0; i < sizeof(in); i++) {
		in[i] = (uint8_t)i;
	}
	memset(out, 0, sizeof(out));
	memset(tag, 0, sizeof(tag));

	ctx.mode_params.ccm_info.nonce_len = ERR_NONCE_LEN;
	ctx.mode_params.ccm_info.tag_len = ERR_TAG_LEN;

	ret_begin = cipher_begin_session(err_sm4_dev, &ctx, CRYPTO_CIPHER_ALGO_SM4,
					 CRYPTO_CIPHER_MODE_CCM,
					 CRYPTO_CIPHER_OP_ENCRYPT);

	/* begin 失败时不能继续调 op（ops 未填，调用会踩空）。先断言、就此收尾。 */
	if (ret_begin != 0) {
		ZT_INFO("sm4_ccm_params", "begin=%d,aborted=1", ret_begin);
		zassert_equal(ret_begin, 0, "ccm begin_session ret=%d", ret_begin);
		return;
	}

	/* 正对照：合法参数必须成功。没有它，下面的 -EINVAL 可能来自"整个会话坏掉" */
	ret_base = err_ccm_call(&ctx, nonce, in, sizeof(in), out, sizeof(out),
				aad, sizeof(aad), tag);
	base_ok = (ret_base == 0);

	/* 逐项：只改一个非法字段 */
	ret_null_out = err_ccm_call(&ctx, nonce, in, sizeof(in), NULL, sizeof(out),
				    aad, sizeof(aad), tag);
	ret_null_in = err_ccm_call(&ctx, nonce, NULL, sizeof(in), out, sizeof(out),
				   aad, sizeof(aad), tag);
	ret_null_ad = err_ccm_call(&ctx, nonce, in, sizeof(in), out, sizeof(out),
				   NULL, ERR_AAD_LEN, tag);
	ret_small_out = err_ccm_call(&ctx, nonce, in, sizeof(in), out,
				     sizeof(out) / 2, aad, sizeof(aad), tag);

	ctx.mode_params.ccm_info.tag_len = 3;      /* < 4 */
	ret_tag_short = err_ccm_call(&ctx, nonce, in, sizeof(in), out, sizeof(out),
				     aad, sizeof(aad), tag);
	ctx.mode_params.ccm_info.tag_len = 5;      /* 奇数 */
	ret_tag_odd = err_ccm_call(&ctx, nonce, in, sizeof(in), out, sizeof(out),
				   aad, sizeof(aad), tag);
	ctx.mode_params.ccm_info.tag_len = 18;     /* > 16 */
	ret_tag_big = err_ccm_call(&ctx, nonce, in, sizeof(in), out, sizeof(out),
				   aad, sizeof(aad), tag);
	ctx.mode_params.ccm_info.tag_len = ERR_TAG_LEN;

	(void)cipher_free_session(err_sm4_dev, &ctx);

	ZT_INFO("sm4_ccm_params",
		"base=%d,null_out=%d,null_in=%d,null_ad=%d,small_out=%d,"
		"tag3=%d,tag5=%d,tag18=%d",
		ret_base, ret_null_out, ret_null_in, ret_null_ad, ret_small_out,
		ret_tag_short, ret_tag_odd, ret_tag_big);

	zassert_true(base_ok, "ccm positive control ret=%d (session broken, negatives meaningless)",
		     ret_base);
	zassert_equal(ret_null_out, -EINVAL, "ccm out_buf=NULL ret=%d", ret_null_out);
	zassert_equal(ret_null_in, -EINVAL, "ccm in_buf=NULL ret=%d", ret_null_in);
	zassert_equal(ret_null_ad, -EINVAL, "ccm ad=NULL ret=%d", ret_null_ad);
	/* 保持原始判断 -EINVAL；驱动 2026-11-03 曾改 -EMSGSIZE，由驱动侧后续对齐 */
	zassert_equal(ret_small_out, -EINVAL,
		      "ccm out_buf_max<in_len ret=%d, expected -EINVAL", ret_small_out);
	zassert_equal(ret_tag_short, -EINVAL, "ccm tag_len=3 ret=%d", ret_tag_short);
	zassert_equal(ret_tag_odd, -EINVAL, "ccm tag_len=5 (odd) ret=%d", ret_tag_odd);
	zassert_equal(ret_tag_big, -EINVAL, "ccm tag_len=18 ret=%d", ret_tag_big);
}

#endif /* CONFIG_CRYPTO_LINKEDSEMI_SM4 */

/* ============================ hash ============================ */
#if defined(CONFIG_CRYPTO_LINKEDSEMI_SHA256) || \
	defined(CONFIG_CRYPTO_LINKEDSEMI_SHA512)

ZTEST_SUITE(hash_err, NULL, NULL, NULL, NULL, NULL);

static int err_hash_begin(const struct device *dev, enum hash_algo algo,
			  uint16_t flags)
{
	struct hash_ctx ctx = { .flags = flags };

	return hash_begin_session(dev, &ctx, algo);
}

#endif /* SHA256 || SHA512 */

#if defined(CONFIG_CRYPTO_LINKEDSEMI_SHA256)
static const struct device *err_hash_sha256_dev =
	DEVICE_DT_GET(DT_NODELABEL(sha256));

ZTEST(hash_err, hash_caps_sha256)
{
	int caps = crypto_query_hwcaps(err_hash_sha256_dev);
	bool ready = device_is_ready(err_hash_sha256_dev);
	bool raw = (caps & CAP_RAW_KEY) != 0;
	bool sync = (caps & CAP_SYNC_OPS) != 0;
	bool sep = (caps & CAP_SEPARATE_IO_BUFS) != 0;

	ZT_INFO("hash_caps_sha256", "ready=%d,caps=0x%x,raw_key=%d,sync=%d,sep_io=%d",
		ready, caps, raw, sync, sep);

	zassert_true(ready, "sha256 device not ready");
	/* hash 不取 key，但 crypto_query_hwcaps() 要求至少声明一种 key 类型，
	 * 缺了会在 CONFIG_ASSERT 下 panic（KNOWN_ISSUES #158），故显式锁住。 */
	zassert_true(raw, "sha256 caps missing CAP_RAW_KEY (0x%x)", caps);
	zassert_true(sync, "sha256 caps missing CAP_SYNC_OPS (0x%x)", caps);
	zassert_true(sep, "sha256 caps missing CAP_SEPARATE_IO_BUFS (0x%x)", caps);
}

/* ---- sha256 引擎只支持 SHA224/256/SM3：SHA384/SHA512 → -ENOTSUP ---- */
ZTEST(hash_err, hash_bad_algo_sha256)
{
	int ret_384 = err_hash_begin(err_hash_sha256_dev, CRYPTO_HASH_ALGO_SHA384,
				     CAP_SYNC_OPS | CAP_SEPARATE_IO_BUFS);
	int ret_512 = err_hash_begin(err_hash_sha256_dev, CRYPTO_HASH_ALGO_SHA512,
				     CAP_SYNC_OPS | CAP_SEPARATE_IO_BUFS);

	ZT_INFO("hash_bad_algo_sha256", "sha384=%d,sha512=%d", ret_384, ret_512);

	zassert_equal(ret_384, -ENOTSUP, "sha256 dev begin(SHA384) ret=%d, expected -ENOTSUP",
		      ret_384);
	zassert_equal(ret_512, -ENOTSUP, "sha256 dev begin(SHA512) ret=%d, expected -ENOTSUP",
		      ret_512);
}
#endif /* CONFIG_CRYPTO_LINKEDSEMI_SHA256 */

#if defined(CONFIG_CRYPTO_LINKEDSEMI_SHA512)
static const struct device *err_hash_sha512_dev =
	DEVICE_DT_GET(DT_NODELABEL(sha512));

ZTEST(hash_err, hash_caps_sha512)
{
	int caps = crypto_query_hwcaps(err_hash_sha512_dev);
	bool ready = device_is_ready(err_hash_sha512_dev);
	bool raw = (caps & CAP_RAW_KEY) != 0;
	bool sync = (caps & CAP_SYNC_OPS) != 0;
	bool sep = (caps & CAP_SEPARATE_IO_BUFS) != 0;

	ZT_INFO("hash_caps_sha512", "ready=%d,caps=0x%x,raw_key=%d,sync=%d,sep_io=%d",
		ready, caps, raw, sync, sep);

	zassert_true(ready, "sha512 device not ready");
	/* 同 sha256：hash 不取 key，但 crypto_query_hwcaps() 要求至少声明一种
	 * key 类型，缺了会在 CONFIG_ASSERT 下 panic（KNOWN_ISSUES #158）。 */
	zassert_true(raw, "sha512 caps missing CAP_RAW_KEY (0x%x)", caps);
	zassert_true(sync, "sha512 caps missing CAP_SYNC_OPS (0x%x)", caps);
	zassert_true(sep, "sha512 caps missing CAP_SEPARATE_IO_BUFS (0x%x)", caps);
}

/* ---- sha512 引擎只支持 SHA384/512：SHA224/SHA256/SM3 → -ENOTSUP ---- */
ZTEST(hash_err, hash_bad_algo_sha512)
{
	int ret_224 = err_hash_begin(err_hash_sha512_dev, CRYPTO_HASH_ALGO_SHA224,
				     CAP_SYNC_OPS | CAP_SEPARATE_IO_BUFS);
	int ret_256 = err_hash_begin(err_hash_sha512_dev, CRYPTO_HASH_ALGO_SHA256,
				     CAP_SYNC_OPS | CAP_SEPARATE_IO_BUFS);
	int ret_sm3 = err_hash_begin(err_hash_sha512_dev, CRYPTO_HASH_ALGO_SM3,
				     CAP_SYNC_OPS | CAP_SEPARATE_IO_BUFS);

	ZT_INFO("hash_bad_algo_sha512", "sha224=%d,sha256=%d,sm3=%d",
		ret_224, ret_256, ret_sm3);

	zassert_equal(ret_224, -ENOTSUP, "sha512 dev begin(SHA224) ret=%d, expected -ENOTSUP",
		      ret_224);
	zassert_equal(ret_256, -ENOTSUP, "sha512 dev begin(SHA256) ret=%d, expected -ENOTSUP",
		      ret_256);
	zassert_equal(ret_sm3, -ENOTSUP, "sha512 dev begin(SM3) ret=%d, expected -ENOTSUP",
		      ret_sm3);
}
#endif /* CONFIG_CRYPTO_LINKEDSEMI_SHA512 */

#if defined(CONFIG_CRYPTO_LINKEDSEMI_SHA256)
/* ---- 不支持的 flags（ASYNC）→ -ENOTSUP ---- */
ZTEST(hash_err, hash_bad_flags)
{
	int ret = err_hash_begin(err_hash_sha256_dev, CRYPTO_HASH_ALGO_SHA256,
				 CAP_ASYNC_OPS | CAP_SEPARATE_IO_BUFS);

	ZT_INFO("hash_bad_flags", "flags=async|sep_io,ret=%d,ok=%d", ret, ret == -ENOTSUP);

	zassert_equal(ret, -ENOTSUP, "hash begin(CAP_ASYNC_OPS) ret=%d, expected -ENOTSUP",
		      ret);
}
#endif /* CONFIG_CRYPTO_LINKEDSEMI_SHA256 */

#endif /* 任一 crypto 驱动使能 */
```

## src/hash_crypto_test.c
```c
/*
 * SPDX-License-Identifier: Apache-2.0
 *
 * Hash 驱动测试 —— 走 Zephyr crypto 驱动 API（hash_begin_session /
 * hash_update / hash_compute），不是 mbedtls 的 sha*_alt。
 *
 * DUT:
 *   zephyr/drivers/crypto/crypto_linkedsemi_sha256.c  （SHA224 / SHA256 / SM3）
 *   zephyr/drivers/crypto/crypto_linkedsemi_sha512.c  （SHA384 / SHA512）
 * 使能：CONFIG_CRYPTO_LINKEDSEMI_SHA256 / _SHA512 + DT 节点 &sha256 / &sha512
 * status=okay。
 *
 * 覆盖：
 *   - 5 个算法各一条短报文 KAT（"abc"，单次 hash_compute）
 *   - 5 个算法各一条分段喂入（hash_update ×3 + hash_compute）等价性
 *   - SHA256 / SHA512 各一条 padding 边界（长度跨块头/块尾：0/55/56/64 与
 *     0/111/112/128），覆盖驱动 sha_byte_update + 填充分支
 *
 * 期望值全部由 Python hashlib（sha224/256/384/512）与 OpenSSL
 * （openssl dgst -sm3）离线生成，见 tests/expected/hash_crypto_vectors.h。
 */

#include <stdbool.h>
#include <string.h>

#include <zephyr/kernel.h>
#include <zephyr/device.h>
#include <zephyr/ztest.h>
#include <zephyr/crypto/crypto.h>

#include "ztest_glue.h"

#if defined(CONFIG_CRYPTO_LINKEDSEMI_SHA256) || \
	defined(CONFIG_CRYPTO_LINKEDSEMI_SHA512)

#include "hash_crypto_vectors.h"

ZTEST_SUITE(hash_api, NULL, NULL, NULL, NULL, NULL);

#define CAPI_HASH_FLAGS (CAP_SYNC_OPS | CAP_SEPARATE_IO_BUFS)
#define CAPI_HASH_MAX_DIGEST 64
#define CAPI_PAD_BUF_LEN 128

#if defined(CONFIG_CRYPTO_LINKEDSEMI_SHA256)
static const struct device *capi_hash_sha256_dev =
	DEVICE_DT_GET(DT_NODELABEL(sha256));
#endif

#if defined(CONFIG_CRYPTO_LINKEDSEMI_SHA512)
static const struct device *capi_hash_sha512_dev =
	DEVICE_DT_GET(DT_NODELABEL(sha512));
#endif

/* 输入报文（NIST FIPS 180-2 示例报文） */
static const uint8_t capi_msg_abc[3] = { 'a', 'b', 'c' };

static const uint8_t capi_msg_448[56] = {
	'a', 'b', 'c', 'd', 'b', 'c', 'd', 'e', 'c', 'd', 'e', 'f', 'd', 'e',
	'f', 'g', 'e', 'f', 'g', 'h', 'f', 'g', 'h', 'i', 'g', 'h', 'i', 'j',
	'h', 'i', 'j', 'k', 'i', 'j', 'k', 'l', 'j', 'k', 'l', 'm', 'k', 'l',
	'm', 'n', 'l', 'm', 'n', 'o', 'm', 'n', 'o', 'p', 'n', 'o', 'p', 'q',
};

static const uint8_t capi_msg_896[112] = {
	'a', 'b', 'c', 'd', 'e', 'f', 'g', 'h', 'b', 'c', 'd', 'e', 'f', 'g',
	'h', 'i', 'c', 'd', 'e', 'f', 'g', 'h', 'i', 'j', 'd', 'e', 'f', 'g',
	'h', 'i', 'j', 'k', 'e', 'f', 'g', 'h', 'i', 'j', 'k', 'l', 'f', 'g',
	'h', 'i', 'j', 'k', 'l', 'm', 'g', 'h', 'i', 'j', 'k', 'l', 'm', 'n',
	'h', 'i', 'j', 'k', 'l', 'm', 'n', 'o', 'i', 'j', 'k', 'l', 'm', 'n',
	'o', 'p', 'j', 'k', 'l', 'm', 'n', 'o', 'p', 'q', 'k', 'l', 'm', 'n',
	'o', 'p', 'q', 'r', 'l', 'm', 'n', 'o', 'p', 'q', 'r', 's', 'm', 'n',
	'o', 'p', 'q', 'r', 's', 't', 'n', 'o', 'p', 'q', 'r', 's', 't', 'u',
};

/* padding 边界用：内容 = 下标 mod 256（与生成期望值时 byte(i) 的构造一致） */
static uint8_t capi_pad_buf[CAPI_PAD_BUF_LEN];

static void capi_pad_buf_init(void)
{
	for (size_t i = 0; i < sizeof(capi_pad_buf); i++) {
		capi_pad_buf[i] = (uint8_t)i;
	}
}

/* 单次会话：begin → compute → free */
static int capi_hash_once(const struct device *dev, enum hash_algo algo,
			  const uint8_t *msg, size_t len, uint8_t *out)
{
	struct hash_ctx ctx = { .flags = CAPI_HASH_FLAGS };
	struct hash_pkt pkt = {
		.in_buf = (uint8_t *)msg,
		.in_len = len,
		.out_buf = out,
	};
	int ret = hash_begin_session(dev, &ctx, algo);

	if (ret != 0) {
		return ret;
	}
	ret = hash_compute(&ctx, &pkt);
	(void)hash_free_session(dev, &ctx);
	return ret;
}

/* 分段会话：begin → update×N → compute → free */
static int capi_hash_split(const struct device *dev, enum hash_algo algo,
			   const uint8_t *msg, size_t len,
			   const size_t *cuts, size_t ncuts, uint8_t *out)
{
	struct hash_ctx ctx = { .flags = CAPI_HASH_FLAGS };
	struct hash_pkt pkt = { 0 };
	size_t off = 0;
	int ret = hash_begin_session(dev, &ctx, algo);

	if (ret != 0) {
		return ret;
	}

	for (size_t i = 0; i < ncuts && ret == 0; i++) {
		pkt.in_buf = (uint8_t *)msg + off;
		pkt.in_len = cuts[i];
		ret = hash_update(&ctx, &pkt);
		off += cuts[i];
	}

	if (ret == 0) {
		pkt.in_buf = (uint8_t *)msg + off;
		pkt.in_len = len - off;
		pkt.out_buf = out;
		ret = hash_compute(&ctx, &pkt);
	}

	(void)hash_free_session(dev, &ctx);
	return ret;
}

/* 单算法 KAT：短报文单次 calc */
static void capi_hash_kat(const struct device *dev, enum hash_algo algo,
			  const char *alg_name, const char *info_name,
			  const uint8_t *exp, size_t exp_len)
{
	uint8_t out[CAPI_HASH_MAX_DIGEST] = { 0 };
	uint32_t t0, us;
	int ret;
	bool ok;

	t0 = k_cycle_get_32();
	ret = capi_hash_once(dev, algo, capi_msg_abc, sizeof(capi_msg_abc), out);
	us = (uint32_t)k_cyc_to_us_floor64(k_cycle_get_32() - t0);

	ok = (ret == 0) && (memcmp(out, exp, exp_len) == 0);

	ZT_INFO(info_name, "algo=%s,bytes=%u,kat=%d,ret=%d,us=%u",
		alg_name, (unsigned int)sizeof(capi_msg_abc), ok, ret, us);

	zassert_equal(ret, 0, "%s KAT ret=%d", alg_name, ret);
	zassert_mem_equal(out, exp, exp_len, "%s digest != reference vector", alg_name);
}

/* 单算法分段等价：hash_update 分三段喂入，结果须与单次 calc 一致 */
static void capi_hash_split_case(const struct device *dev, enum hash_algo algo,
				 const char *alg_name, const char *info_name,
				 const uint8_t *msg, size_t len,
				 const size_t *cuts, size_t ncuts,
				 const uint8_t *exp, size_t exp_len)
{
	uint8_t out[CAPI_HASH_MAX_DIGEST] = { 0 };
	uint32_t t0, us;
	int ret;
	bool ok;

	t0 = k_cycle_get_32();
	ret = capi_hash_split(dev, algo, msg, len, cuts, ncuts, out);
	us = (uint32_t)k_cyc_to_us_floor64(k_cycle_get_32() - t0);

	ok = (ret == 0) && (memcmp(out, exp, exp_len) == 0);

	ZT_INFO(info_name, "algo=%s,bytes=%u,segments=%u,split_eq_kat=%d,ret=%d,us=%u",
		alg_name, (unsigned int)len, (unsigned int)(ncuts + 1), ok, ret, us);

	zassert_equal(ret, 0, "%s split ret=%d", alg_name, ret);
	zassert_mem_equal(out, exp, exp_len,
			  "%s digest with segmented hash_update != reference vector",
			  alg_name);
}

#if defined(CONFIG_CRYPTO_LINKEDSEMI_SHA256)
/* ---- SHA224 / SHA256 / SM3：同一颗 sha256 引擎 ---- */
ZTEST(hash_api, sha224_kat)
{
	capi_hash_kat(capi_hash_sha256_dev, CRYPTO_HASH_ALGO_SHA224, "sha224",
		      "sha224_kat", h_sha224_abc, sizeof(h_sha224_abc));
}

ZTEST(hash_api, sha256_kat)
{
	capi_hash_kat(capi_hash_sha256_dev, CRYPTO_HASH_ALGO_SHA256, "sha256",
		      "sha256_kat", h_sha256_abc, sizeof(h_sha256_abc));
}

ZTEST(hash_api, sm3_kat)
{
	capi_hash_kat(capi_hash_sha256_dev, CRYPTO_HASH_ALGO_SM3, "sm3",
		      "sm3_kat", h_sm3_abc, sizeof(h_sm3_abc));
}

ZTEST(hash_api, sha224_split)
{
	static const size_t cuts[] = { 13, 20 };

	capi_hash_split_case(capi_hash_sha256_dev, CRYPTO_HASH_ALGO_SHA224,
			     "sha224", "sha224_split",
			     capi_msg_448, sizeof(capi_msg_448),
			     cuts, ARRAY_SIZE(cuts),
			     h_sha224_m448, sizeof(h_sha224_m448));
}

ZTEST(hash_api, sha256_split)
{
	static const size_t cuts[] = { 13, 20 };

	capi_hash_split_case(capi_hash_sha256_dev, CRYPTO_HASH_ALGO_SHA256,
			     "sha256", "sha256_split",
			     capi_msg_448, sizeof(capi_msg_448),
			     cuts, ARRAY_SIZE(cuts),
			     h_sha256_m448, sizeof(h_sha256_m448));
}

ZTEST(hash_api, sm3_split)
{
	static const size_t cuts[] = { 13, 20 };

	capi_hash_split_case(capi_hash_sha256_dev, CRYPTO_HASH_ALGO_SM3,
			     "sm3", "sm3_split",
			     capi_msg_448, sizeof(capi_msg_448),
			     cuts, ARRAY_SIZE(cuts),
			     h_sm3_m448, sizeof(h_sm3_m448));
}

/* ---- SHA256 padding 边界：0 / 55 / 56 / 64 字节 ---- */
ZTEST(hash_api, sha256_pad_boundary)
{
	static const struct {
		size_t len;
		const uint8_t *exp;
		size_t exp_len;
	} vec[] = {
		{ 0, h_sha256_pad_0, sizeof(h_sha256_pad_0) },
		{ 55, h_sha256_pad_55, sizeof(h_sha256_pad_55) },
		{ 56, h_sha256_pad_56, sizeof(h_sha256_pad_56) },
		{ 64, h_sha256_pad_64, sizeof(h_sha256_pad_64) },
	};
	uint8_t out[CAPI_HASH_MAX_DIGEST];
	bool ok[ARRAY_SIZE(vec)];
	int ret[ARRAY_SIZE(vec)];
	size_t i;

	capi_pad_buf_init();

	for (i = 0; i < ARRAY_SIZE(vec); i++) {
		memset(out, 0, sizeof(out));
		ret[i] = capi_hash_once(capi_hash_sha256_dev,
					CRYPTO_HASH_ALGO_SHA256,
					capi_pad_buf, vec[i].len, out);
		ok[i] = (ret[i] == 0) &&
			(memcmp(out, vec[i].exp, vec[i].exp_len) == 0);
	}

	ZT_INFO("sha256_pad_boundary",
		"algo=sha256,lens=0_55_56_64,len0=%d,len55=%d,len56=%d,len64=%d",
		ok[0], ok[1], ok[2], ok[3]);

	for (i = 0; i < ARRAY_SIZE(vec); i++) {
		zassert_equal(ret[i], 0, "sha256 padding len=%u ret=%d",
			      (unsigned int)vec[i].len, ret[i]);
		zassert_true(ok[i],
			     "sha256 digest wrong at padding boundary len=%u",
			     (unsigned int)vec[i].len);
	}
}
#endif /* CONFIG_CRYPTO_LINKEDSEMI_SHA256 */

#if defined(CONFIG_CRYPTO_LINKEDSEMI_SHA512)
/* ---- SHA384 / SHA512 ---- */
ZTEST(hash_api, sha384_kat)
{
	capi_hash_kat(capi_hash_sha512_dev, CRYPTO_HASH_ALGO_SHA384, "sha384",
		      "sha384_kat", h_sha384_abc, sizeof(h_sha384_abc));
}

ZTEST(hash_api, sha512_kat)
{
	capi_hash_kat(capi_hash_sha512_dev, CRYPTO_HASH_ALGO_SHA512, "sha512",
		      "sha512_kat", h_sha512_abc, sizeof(h_sha512_abc));
}

ZTEST(hash_api, sha384_split)
{
	static const size_t cuts[] = { 32, 48 };

	capi_hash_split_case(capi_hash_sha512_dev, CRYPTO_HASH_ALGO_SHA384,
			     "sha384", "sha384_split",
			     capi_msg_896, sizeof(capi_msg_896),
			     cuts, ARRAY_SIZE(cuts),
			     h_sha384_m896, sizeof(h_sha384_m896));
}

ZTEST(hash_api, sha512_split)
{
	static const size_t cuts[] = { 32, 48 };

	capi_hash_split_case(capi_hash_sha512_dev, CRYPTO_HASH_ALGO_SHA512,
			     "sha512", "sha512_split",
			     capi_msg_896, sizeof(capi_msg_896),
			     cuts, ARRAY_SIZE(cuts),
			     h_sha512_m896, sizeof(h_sha512_m896));
}

/* ---- SHA512 padding 边界：0 / 111 / 112 / 128 字节 ---- */
ZTEST(hash_api, sha512_pad_boundary)
{
	static const struct {
		size_t len;
		const uint8_t *exp;
		size_t exp_len;
	} vec[] = {
		{ 0, h_sha512_pad_0, sizeof(h_sha512_pad_0) },
		{ 111, h_sha512_pad_111, sizeof(h_sha512_pad_111) },
		{ 112, h_sha512_pad_112, sizeof(h_sha512_pad_112) },
		{ 128, h_sha512_pad_128, sizeof(h_sha512_pad_128) },
	};
	uint8_t out[CAPI_HASH_MAX_DIGEST];
	bool ok[ARRAY_SIZE(vec)];
	int ret[ARRAY_SIZE(vec)];
	size_t i;

	capi_pad_buf_init();

	for (i = 0; i < ARRAY_SIZE(vec); i++) {
		memset(out, 0, sizeof(out));
		ret[i] = capi_hash_once(capi_hash_sha512_dev,
					CRYPTO_HASH_ALGO_SHA512,
					capi_pad_buf, vec[i].len, out);
		ok[i] = (ret[i] == 0) &&
			(memcmp(out, vec[i].exp, vec[i].exp_len) == 0);
	}

	ZT_INFO("sha512_pad_boundary",
		"algo=sha512,lens=0_111_112_128,len0=%d,len111=%d,len112=%d,len128=%d",
		ok[0], ok[1], ok[2], ok[3]);

	for (i = 0; i < ARRAY_SIZE(vec); i++) {
		zassert_equal(ret[i], 0, "sha512 padding len=%u ret=%d",
			      (unsigned int)vec[i].len, ret[i]);
		zassert_true(ok[i],
			     "sha512 digest wrong at padding boundary len=%u",
			     (unsigned int)vec[i].len);
	}
}
#endif /* CONFIG_CRYPTO_LINKEDSEMI_SHA512 */

#endif /* CONFIG_CRYPTO_LINKEDSEMI_SHA256 || CONFIG_CRYPTO_LINKEDSEMI_SHA512 */
```

## src/sm4_crypto_test.c
```c
/*
 * SPDX-License-Identifier: Apache-2.0
 *
 * SM4 驱动测试 —— 走 Zephyr crypto 驱动 API（zephyr/crypto/crypto.h 的
 * cipher_begin_session / cipher_*_op），不是 mbedtls 的 sm4_alt。
 *
 * DUT: zephyr/drivers/crypto/crypto_linkedsemi_sm4.c
 *      由 CONFIG_CRYPTO_LINKEDSEMI_SM4 + DT 节点 &sm4 status=okay 使能。
 *
 * 覆盖模式：ECB / CBC / CTR / CCM / GCM，每项 = 标准向量加密 +
 * 解密回环（AEAD 项额外校验 tag）。
 *
 * 向量来源（全部离线复核，与被测驱动无关）：
 *   ECB / CBC / CTR : OpenSSL 3.2（openssl enc -sm4-{ecb,cbc,ctr} -nopad）
 *   GCM             : pyca/cryptography（algorithms.SM4 + modes.GCM）
 *   CCM             : RFC 3610 参考实现（以 OpenSSL SM4-ECB 为块函数）
 *   复核用 key      : FFEEDDCCBBAA99887766554433221100（**as-is，标准字节序**）
 *
 * ★ key 字节序（2026-11-03 驱动更新后）：
 *   驱动的 `sm4_linkedsemi_key_expansion()` 已去掉 sys_memcpy_swap，改为与
 *   HAL 一致的 memcpy（等价 `u8tou32`）⇒ key 按调用方字节序原样使用，
 *   与 mbedtls `sm4_alt` / HAL 路径一致。向量因此从"反序 key"版本换成
 *   "as-is key"版本（见 tests/expected/sm4_crypto_vectors.h 头注释）。
 *
 * 注：`ctx->ops.cipher_mode` 由通用封装 `cipher_begin_session()` 统一写入
 *   （`zephyr/include/zephyr/crypto/crypto.h:168`），随后 `cipher_*_op()` 里
 *   的 `__ASSERT(ctx->ops.cipher_mode == <mode>)` 才能成立 —— 驱动与测试
 *   两侧都不需要再赋值。
 */

#include <stdbool.h>
#include <string.h>

#include <zephyr/kernel.h>
#include <zephyr/device.h>
#include <zephyr/ztest.h>
#include <zephyr/crypto/crypto.h>

#include "ztest_glue.h"

#if defined(CONFIG_CRYPTO_LINKEDSEMI_SM4)

#include "sm4_crypto_vectors.h"

ZTEST_SUITE(sm4_api, NULL, NULL, NULL, NULL, NULL);

#define CAPI_SM4_KEYLEN   16
#define CAPI_SM4_MSGLEN   64
#define CAPI_SM4_NONCELEN 12
#define CAPI_SM4_AADLEN   8
#define CAPI_SM4_TAGLEN   16
#define CAPI_SM4_CTRLEN   32   /* ivlen + ctrlen = 128，故 ctrlen = 32 */

#define CAPI_SM4_FLAGS \
	(CAP_RAW_KEY | CAP_SYNC_OPS | CAP_SEPARATE_IO_BUFS)

static const struct device *capi_sm4_dev = DEVICE_DT_GET(DT_NODELABEL(sm4));

/* 与 samples/crypto/sm4/src/main.c 完全一致的输入（见文件头 key 字节序说明） */
static const uint8_t capi_sm4_key[CAPI_SM4_KEYLEN] = {
	0xFF, 0xEE, 0xDD, 0xCC, 0xBB, 0xAA, 0x99, 0x88,
	0x77, 0x66, 0x55, 0x44, 0x33, 0x22, 0x11, 0x00,
};

static const uint8_t capi_sm4_pt[CAPI_SM4_MSGLEN] = {
	0x00, 0x01, 0x02, 0x03, 0x04, 0x05, 0x06, 0x07,
	0x08, 0x09, 0x0A, 0x0B, 0x0C, 0x0D, 0x0E, 0x0F,
	0x10, 0x11, 0x12, 0x13, 0x14, 0x15, 0x16, 0x17,
	0x18, 0x19, 0x1A, 0x1B, 0x1C, 0x1D, 0x1E, 0x1F,
	0x20, 0x21, 0x22, 0x23, 0x24, 0x25, 0x26, 0x27,
	0x28, 0x29, 0x2A, 0x2B, 0x2C, 0x2D, 0x2E, 0x2F,
	0x30, 0x31, 0x32, 0x33, 0x34, 0x35, 0x36, 0x37,
	0x38, 0x39, 0x3A, 0x3B, 0x3C, 0x3D, 0x3E, 0x3F,
};

static const uint8_t capi_sm4_iv[CAPI_SM4_KEYLEN] = {
	0x00, 0x01, 0x02, 0x03, 0x04, 0x05, 0x06, 0x07,
	0x08, 0x09, 0x0A, 0x0B, 0x0C, 0x0D, 0x0E, 0x0F,
};

static const uint8_t capi_sm4_nonce[CAPI_SM4_NONCELEN] = {
	0x00, 0x01, 0x02, 0x03, 0x04, 0x05,
	0x06, 0x07, 0x08, 0x09, 0x0A, 0x0B,
};

static const uint8_t capi_sm4_aad[CAPI_SM4_AADLEN] = {
	0x00, 0x01, 0x02, 0x03, 0x04, 0x05, 0x06, 0x07,
};

/*
 * begin_session（cipher_mode 由封装写入，见文件头）。
 * 失败时返回非 0，调用方据此跳过后续 op。
 */
static int capi_sm4_session(struct cipher_ctx *ctx, enum cipher_mode mode,
			    enum cipher_op op)
{
	return cipher_begin_session(capi_sm4_dev, ctx, CRYPTO_CIPHER_ALGO_SM4,
				    mode, op);
}

static struct cipher_ctx capi_sm4_ctx(void)
{
	struct cipher_ctx ctx = {
		.keylen = CAPI_SM4_KEYLEN,
		.key.bit_stream = capi_sm4_key,
		.flags = CAPI_SM4_FLAGS,
	};

	return ctx;
}

/* ---- ECB：样例向量 + 解密回环 ---- */
ZTEST(sm4_api, ecb)
{
	struct cipher_ctx ctx = capi_sm4_ctx();
	uint8_t enc[CAPI_SM4_MSGLEN] = { 0 };
	uint8_t dec[CAPI_SM4_MSGLEN] = { 0 };
	struct cipher_pkt pkt_enc = {
		.in_buf = (uint8_t *)capi_sm4_pt,
		.in_len = CAPI_SM4_MSGLEN,
		.out_buf = enc,
		.out_buf_max = sizeof(enc),
	};
	struct cipher_pkt pkt_dec = {
		.in_buf = enc,
		.in_len = CAPI_SM4_MSGLEN,
		.out_buf = dec,
		.out_buf_max = sizeof(dec),
	};
	uint32_t t0, us;
	int ret_be, ret_enc, ret_bd, ret_dec;
	bool kat_ok, rt_ok;

	t0 = k_cycle_get_32();

	ret_be = capi_sm4_session(&ctx, CRYPTO_CIPHER_MODE_ECB,
				  CRYPTO_CIPHER_OP_ENCRYPT);
	ret_enc = (ret_be == 0) ? cipher_block_op(&ctx, &pkt_enc) : ret_be;
	(void)cipher_free_session(capi_sm4_dev, &ctx);

	ret_bd = capi_sm4_session(&ctx, CRYPTO_CIPHER_MODE_ECB,
				  CRYPTO_CIPHER_OP_DECRYPT);
	ret_dec = (ret_bd == 0) ? cipher_block_op(&ctx, &pkt_dec) : ret_bd;
	(void)cipher_free_session(capi_sm4_dev, &ctx);

	us = (uint32_t)k_cyc_to_us_floor64(k_cycle_get_32() - t0);
	kat_ok = (ret_enc == 0) && (pkt_enc.out_len == CAPI_SM4_MSGLEN) &&
		 (memcmp(enc, sm4_ecb_ct, sizeof(sm4_ecb_ct)) == 0);
	rt_ok = (ret_dec == 0) && (pkt_dec.out_len == CAPI_SM4_MSGLEN) &&
		(memcmp(dec, capi_sm4_pt, sizeof(capi_sm4_pt)) == 0);

	ZT_INFO("ecb",
		"algo=sm4-ecb,bytes=%u,kat=%d,roundtrip=%d,enc_ret=%d,dec_ret=%d,us=%u",
		(unsigned int)CAPI_SM4_MSGLEN, kat_ok, rt_ok, ret_enc, ret_dec, us);

	zassert_equal(ret_be, 0, "sm4-ecb begin(encrypt) ret=%d", ret_be);
	zassert_equal(ret_enc, 0, "sm4-ecb encrypt ret=%d", ret_enc);
	zassert_equal(pkt_enc.out_len, CAPI_SM4_MSGLEN,
		      "sm4-ecb encrypt out_len=%d", pkt_enc.out_len);
	zassert_true(kat_ok, "sm4-ecb ciphertext != sample vector");
	zassert_equal(ret_bd, 0, "sm4-ecb begin(decrypt) ret=%d", ret_bd);
	zassert_equal(ret_dec, 0, "sm4-ecb decrypt ret=%d", ret_dec);
	zassert_true(rt_ok, "sm4-ecb decrypt round trip != plaintext");
}

/* ---- CBC：样例向量 + 解密回环 ---- */
ZTEST(sm4_api, cbc)
{
	struct cipher_ctx ctx = capi_sm4_ctx();
	uint8_t iv_enc[CAPI_SM4_KEYLEN];
	uint8_t iv_dec[CAPI_SM4_KEYLEN];
	uint8_t enc[CAPI_SM4_MSGLEN] = { 0 };
	uint8_t dec[CAPI_SM4_MSGLEN] = { 0 };
	struct cipher_pkt pkt_enc = {
		.in_buf = (uint8_t *)capi_sm4_pt,
		.in_len = CAPI_SM4_MSGLEN,
		.out_buf = enc,
		.out_buf_max = sizeof(enc),
	};
	struct cipher_pkt pkt_dec = {
		.in_buf = enc,
		.in_len = CAPI_SM4_MSGLEN,
		.out_buf = dec,
		.out_buf_max = sizeof(dec),
	};
	uint32_t t0, us;
	int ret_be, ret_enc, ret_bd, ret_dec;
	bool kat_ok, rt_ok;

	memcpy(iv_enc, capi_sm4_iv, sizeof(iv_enc));
	memcpy(iv_dec, capi_sm4_iv, sizeof(iv_dec));

	t0 = k_cycle_get_32();

	ret_be = capi_sm4_session(&ctx, CRYPTO_CIPHER_MODE_CBC,
				  CRYPTO_CIPHER_OP_ENCRYPT);
	ret_enc = (ret_be == 0) ? cipher_cbc_op(&ctx, &pkt_enc, iv_enc) : ret_be;
	(void)cipher_free_session(capi_sm4_dev, &ctx);

	ret_bd = capi_sm4_session(&ctx, CRYPTO_CIPHER_MODE_CBC,
				  CRYPTO_CIPHER_OP_DECRYPT);
	ret_dec = (ret_bd == 0) ? cipher_cbc_op(&ctx, &pkt_dec, iv_dec) : ret_bd;
	(void)cipher_free_session(capi_sm4_dev, &ctx);

	us = (uint32_t)k_cyc_to_us_floor64(k_cycle_get_32() - t0);
	kat_ok = (ret_enc == 0) && (pkt_enc.out_len == CAPI_SM4_MSGLEN) &&
		 (memcmp(enc, sm4_cbc_ct, sizeof(sm4_cbc_ct)) == 0);
	rt_ok = (ret_dec == 0) && (pkt_dec.out_len == CAPI_SM4_MSGLEN) &&
		(memcmp(dec, capi_sm4_pt, sizeof(capi_sm4_pt)) == 0);

	ZT_INFO("cbc",
		"algo=sm4-cbc,bytes=%u,kat=%d,roundtrip=%d,enc_ret=%d,dec_ret=%d,us=%u",
		(unsigned int)CAPI_SM4_MSGLEN, kat_ok, rt_ok, ret_enc, ret_dec, us);

	zassert_equal(ret_be, 0, "sm4-cbc begin(encrypt) ret=%d", ret_be);
	zassert_equal(ret_enc, 0, "sm4-cbc encrypt ret=%d", ret_enc);
	zassert_true(kat_ok, "sm4-cbc ciphertext != sample vector");
	zassert_equal(ret_bd, 0, "sm4-cbc begin(decrypt) ret=%d", ret_bd);
	zassert_equal(ret_dec, 0, "sm4-cbc decrypt ret=%d", ret_dec);
	zassert_true(rt_ok, "sm4-cbc decrypt round trip != plaintext");
}

/* ---- CTR：样例向量（12B nonce + 32bit counter）+ 解密回环 ---- */
ZTEST(sm4_api, ctr)
{
	struct cipher_ctx ctx = capi_sm4_ctx();
	uint8_t nonce_enc[CAPI_SM4_NONCELEN];
	uint8_t nonce_dec[CAPI_SM4_NONCELEN];
	uint8_t enc[CAPI_SM4_MSGLEN] = { 0 };
	uint8_t dec[CAPI_SM4_MSGLEN] = { 0 };
	struct cipher_pkt pkt_enc = {
		.in_buf = (uint8_t *)capi_sm4_pt,
		.in_len = CAPI_SM4_MSGLEN,
		.out_buf = enc,
		.out_buf_max = sizeof(enc),
	};
	struct cipher_pkt pkt_dec = {
		.in_buf = enc,
		.in_len = CAPI_SM4_MSGLEN,
		.out_buf = dec,
		.out_buf_max = sizeof(dec),
	};
	uint32_t t0, us;
	int ret_be, ret_enc, ret_bd, ret_dec;
	bool kat_ok, rt_ok;

	ctx.mode_params.ctr_info.ctr_len = CAPI_SM4_CTRLEN;
	memcpy(nonce_enc, capi_sm4_nonce, sizeof(nonce_enc));
	memcpy(nonce_dec, capi_sm4_nonce, sizeof(nonce_dec));

	t0 = k_cycle_get_32();

	ret_be = capi_sm4_session(&ctx, CRYPTO_CIPHER_MODE_CTR,
				  CRYPTO_CIPHER_OP_ENCRYPT);
	ret_enc = (ret_be == 0) ? cipher_ctr_op(&ctx, &pkt_enc, nonce_enc) : ret_be;
	(void)cipher_free_session(capi_sm4_dev, &ctx);

	ret_bd = capi_sm4_session(&ctx, CRYPTO_CIPHER_MODE_CTR,
				  CRYPTO_CIPHER_OP_DECRYPT);
	ret_dec = (ret_bd == 0) ? cipher_ctr_op(&ctx, &pkt_dec, nonce_dec) : ret_bd;
	(void)cipher_free_session(capi_sm4_dev, &ctx);

	us = (uint32_t)k_cyc_to_us_floor64(k_cycle_get_32() - t0);
	kat_ok = (ret_enc == 0) && (pkt_enc.out_len == CAPI_SM4_MSGLEN) &&
		 (memcmp(enc, sm4_ctr_ct, sizeof(sm4_ctr_ct)) == 0);
	rt_ok = (ret_dec == 0) && (pkt_dec.out_len == CAPI_SM4_MSGLEN) &&
		(memcmp(dec, capi_sm4_pt, sizeof(capi_sm4_pt)) == 0);

	ZT_INFO("ctr",
		"algo=sm4-ctr,bytes=%u,ctr_len=%u,kat=%d,roundtrip=%d,enc_ret=%d,dec_ret=%d,us=%u",
		(unsigned int)CAPI_SM4_MSGLEN, (unsigned int)CAPI_SM4_CTRLEN,
		kat_ok, rt_ok, ret_enc, ret_dec, us);

	zassert_equal(ret_be, 0, "sm4-ctr begin(encrypt) ret=%d", ret_be);
	zassert_equal(ret_enc, 0, "sm4-ctr encrypt ret=%d", ret_enc);
	zassert_true(kat_ok, "sm4-ctr ciphertext != sample vector");
	zassert_equal(ret_bd, 0, "sm4-ctr begin(decrypt) ret=%d", ret_bd);
	zassert_equal(ret_dec, 0, "sm4-ctr decrypt ret=%d", ret_dec);
	zassert_true(rt_ok, "sm4-ctr decrypt round trip != plaintext");
}

/* ---- AEAD 公共流程（CCM / GCM 结构一致：nonce 12B + AAD 8B + tag 16B） ---- */
static void capi_sm4_aead_run(enum cipher_mode mode, bool ccm,
			      const uint8_t *exp_ct, size_t exp_ct_len,
			      const uint8_t *exp_tag, size_t exp_tag_len)
{
	struct cipher_ctx ctx = capi_sm4_ctx();
	uint8_t enc[CAPI_SM4_MSGLEN] = { 0 };
	uint8_t dec[CAPI_SM4_MSGLEN] = { 0 };
	uint8_t tag_enc[CAPI_SM4_TAGLEN] = { 0 };
	uint8_t tag_dec[CAPI_SM4_TAGLEN] = { 0 };
	struct cipher_pkt pkt_enc = {
		.in_buf = (uint8_t *)capi_sm4_pt,
		.in_len = CAPI_SM4_MSGLEN,
		.out_buf = enc,
		.out_buf_max = sizeof(enc),
	};
	struct cipher_pkt pkt_dec = {
		.in_buf = enc,
		.in_len = CAPI_SM4_MSGLEN,
		.out_buf = dec,
		.out_buf_max = sizeof(dec),
	};
	struct cipher_aead_pkt aead_enc = {
		.pkt = &pkt_enc,
		.ad = (uint8_t *)capi_sm4_aad,
		.ad_len = CAPI_SM4_AADLEN,
		.tag = tag_enc,
	};
	struct cipher_aead_pkt aead_dec = {
		.pkt = &pkt_dec,
		.ad = (uint8_t *)capi_sm4_aad,
		.ad_len = CAPI_SM4_AADLEN,
		.tag = tag_dec,
	};
	const char *name = ccm ? "ccm" : "gcm";
	uint32_t t0, us;
	int ret_be, ret_enc, ret_bd, ret_dec;
	bool kat_ok, tag_ok, rt_ok;

	if (ccm) {
		ctx.mode_params.ccm_info.nonce_len = CAPI_SM4_NONCELEN;
		ctx.mode_params.ccm_info.tag_len = CAPI_SM4_TAGLEN;
	} else {
		ctx.mode_params.gcm_info.nonce_len = CAPI_SM4_NONCELEN;
		ctx.mode_params.gcm_info.tag_len = CAPI_SM4_TAGLEN;
	}

	t0 = k_cycle_get_32();

	ret_be = capi_sm4_session(&ctx, mode, CRYPTO_CIPHER_OP_ENCRYPT);
	if (ret_be == 0) {
		ret_enc = ccm ? cipher_ccm_op(&ctx, &aead_enc, (uint8_t *)capi_sm4_nonce)
			      : cipher_gcm_op(&ctx, &aead_enc, (uint8_t *)capi_sm4_nonce);
	} else {
		ret_enc = ret_be;
	}
	(void)cipher_free_session(capi_sm4_dev, &ctx);

	ret_bd = capi_sm4_session(&ctx, mode, CRYPTO_CIPHER_OP_DECRYPT);
	if (ret_bd == 0) {
		/* 解密侧 tag 由调用方给出：先放入 KAT 期望 tag（错误 tag 会被驱动拒绝） */
		memcpy(tag_dec, exp_tag, MIN(exp_tag_len, sizeof(tag_dec)));
		ret_dec = ccm ? cipher_ccm_op(&ctx, &aead_dec, (uint8_t *)capi_sm4_nonce)
			      : cipher_gcm_op(&ctx, &aead_dec, (uint8_t *)capi_sm4_nonce);
	} else {
		ret_dec = ret_bd;
	}
	(void)cipher_free_session(capi_sm4_dev, &ctx);

	us = (uint32_t)k_cyc_to_us_floor64(k_cycle_get_32() - t0);

	kat_ok = (ret_enc == 0) && (pkt_enc.out_len == CAPI_SM4_MSGLEN) &&
		 (memcmp(enc, exp_ct, exp_ct_len) == 0);
	tag_ok = (ret_enc == 0) && (memcmp(tag_enc, exp_tag, exp_tag_len) == 0);
	rt_ok = (ret_dec == 0) && (pkt_dec.out_len == CAPI_SM4_MSGLEN) &&
		(memcmp(dec, capi_sm4_pt, sizeof(capi_sm4_pt)) == 0);

	ZT_INFO(name,
		"algo=sm4-%s,bytes=%u,aad=%u,kat=%d,tag=%d,roundtrip=%d,enc_ret=%d,dec_ret=%d,us=%u",
		name, (unsigned int)CAPI_SM4_MSGLEN, (unsigned int)CAPI_SM4_AADLEN,
		kat_ok, tag_ok, rt_ok, ret_enc, ret_dec, us);

	zassert_equal(ret_be, 0, "sm4-%s begin(encrypt) ret=%d", name, ret_be);
	zassert_equal(ret_enc, 0, "sm4-%s encrypt ret=%d", name, ret_enc);
	zassert_equal(pkt_enc.out_len, CAPI_SM4_MSGLEN,
		      "sm4-%s encrypt out_len=%d", name, pkt_enc.out_len);
	zassert_true(kat_ok, "sm4-%s ciphertext != reference vector", name);
	zassert_true(tag_ok, "sm4-%s tag != reference vector", name);
	zassert_equal(ret_bd, 0, "sm4-%s begin(decrypt) ret=%d", name, ret_bd);
	zassert_equal(ret_dec, 0, "sm4-%s decrypt(with KAT tag) ret=%d", name, ret_dec);
	zassert_true(rt_ok, "sm4-%s decrypt round trip != plaintext", name);
}

/* ---- CCM：RFC 3610 参考实现复核的向量 + tag + 解密回环 ---- */
ZTEST(sm4_api, ccm)
{
	capi_sm4_aead_run(CRYPTO_CIPHER_MODE_CCM, true,
			  sm4_ccm_ct, sizeof(sm4_ccm_ct),
			  sm4_ccm_tag, sizeof(sm4_ccm_tag));
}

/* ---- GCM：pyca/cryptography 复核的向量 + tag + 解密回环 ---- */
ZTEST(sm4_api, gcm)
{
	capi_sm4_aead_run(CRYPTO_CIPHER_MODE_GCM, false,
			  sm4_gcm_ct, sizeof(sm4_gcm_ct),
			  sm4_gcm_tag, sizeof(sm4_gcm_tag));
}

#endif /* CONFIG_CRYPTO_LINKEDSEMI_SM4 */
```
