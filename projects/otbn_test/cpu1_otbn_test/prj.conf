## CMakeLists.txt
```
# SPDX-License-Identifier: Apache-2.0

cmake_minimum_required(VERSION 3.20.0)
find_package(Zephyr REQUIRED HINTS $ENV{ZEPHYR_BASE})
project(cpu1_otbn_test)

# RSA keygen suite merged from projects/otbn_keygen_test.  The sources stay in
# place (also referenced by integrated/sets/itest_crypto_otbn) so there is one
# copy of the test bodies; this project only adds them to its own build.
set(KEYGEN_SRC ${CMAKE_CURRENT_SOURCE_DIR}/../../otbn_keygen_test/cpu1_otbn_keygen_test/src)
set(KEYGEN_EXP ${CMAKE_CURRENT_SOURCE_DIR}/../../otbn_keygen_test/tests/expected)

# 项目特定源文件
target_sources(app PRIVATE
    src/main.c
    src/otbn_test.c
    src/otbn_api_test.c
    src/mix_test.c
    ${KEYGEN_SRC}/otbn_keygen_test.c
    ${KEYGEN_SRC}/otbn_modexp_kat.c
    ${KEYGEN_SRC}/otbn_bench.c
    ${KEYGEN_SRC}/trial_div_bench.c)

# 项目特定include目录
target_include_directories(app PRIVATE
    ${CMAKE_CURRENT_SOURCE_DIR}/../tests/include
    ${KEYGEN_SRC}
    ${KEYGEN_EXP})

# The merged image pays for both suites.  The standalone keygen project keeps
# TD_CANDIDATES=1000 (128 KB); shrink it here as the integrated set does.
target_compile_definitions(app PRIVATE TD_CANDIDATES=100)

# 包含公共源文件和配置（test_results.c, ztest_glue.c, gpio_toggle.c）
include(${CMAKE_CURRENT_SOURCE_DIR}/../../../common/common_sources.cmake)
```

## prj.conf
```kconfig
# OTBN 单核测试（cpu1 安全域）：OTBN 适配接口 KAT + RSA/SHA256 混用复现
# 配置来源：samples/mbedtls_test（boards/lsqsh_evb_cpu1.conf）+ mbedtls_throughput 的并集。
# selftest 广谱套件已拆到兄弟工程 projects/otbn_selftest/（本工程不开 MBEDTLS_TEST）。

CONFIG_LOG=y
CONFIG_LOG_MODE_MINIMAL=y
# 测试主体改跑 ztest 线程（CONFIG_ZTEST_STACK_SIZE 承载原 40KB 测试栈需求），
# main 线程只跑 zt_init + ztest_run_all 框架，10KB 足够（rtc 工程同款）。
CONFIG_MAIN_STACK_SIZE=10240
CONFIG_PICOLIBC=y
CONFIG_NEWLIB_LIBC=n
CONFIG_MINIMAL_LIBC=n
CONFIG_TIMING_FUNCTIONS=y

# ztest 原生逐项输出（START - <name> / " PASS - <name> in X.XXX seconds"）是
# common/ztest_report.parse_ztest 的数据源（ztest 框架内由 CONFIG_ZTEST_VERBOSE_OUTPUT
# 门控，必须打开；=n 时 harness 只见 PROJECT EXECUTION 一行，逐项结果全 MISSING）。
CONFIG_ZTEST=y
CONFIG_ZTEST_ASSERT_VERBOSE=1
CONFIG_ZTEST_VERBOSE_OUTPUT=y
CONFIG_ZTEST_SUMMARY=n
# 迁移前测试体全部跑在 40KB main 栈上，迁移后改跑 ztest 栈 → 保持 40KB
# 测试栈容量不变（RSA-4096 keygen 等深栈测试项），main 栈相应降到 10KB。
CONFIG_ZTEST_STACK_SIZE=40960

# TRNG（RSA keygen 的真随机源，entropy_get_entropy_isr BUSYWAIT）
CONFIG_ENTROPY_GENERATOR=y
CONFIG_DMA=y

# mbedtls 核心
CONFIG_MBEDTLS=y
CONFIG_MBEDTLS_BUILTIN=y
CONFIG_MBEDTLS_ENABLE_HEAP=y
CONFIG_MBEDTLS_HEAP_SIZE=65536
CONFIG_MBEDTLS_THREADING_LINKEDSEMI_ALT=y
CONFIG_CRYPTO_MBEDTLS_SHIM=y

# ---- 算法套件（mbedtls_test 样本同款） ----
CONFIG_MBEDTLS_CIPHER_AES_ENABLED=y
CONFIG_MBEDTLS_CIPHER_MODE_CBC_ENABLED=y
CONFIG_MBEDTLS_CIPHER_MODE_CFB_ENABLED=y
CONFIG_MBEDTLS_CIPHER_MODE_OFB_ENABLED=y
CONFIG_MBEDTLS_CIPHER_MODE_CTR_ENABLED=y
CONFIG_MBEDTLS_CIPHER_MODE_XTS_ENABLED=y
CONFIG_MBEDTLS_CIPHER_CCM_ENABLED=y
CONFIG_MBEDTLS_CIPHER_GCM_ENABLED=y
CONFIG_MBEDTLS_SHA224=y
CONFIG_MBEDTLS_SHA256=y
CONFIG_MBEDTLS_SHA384=y
CONFIG_MBEDTLS_SHA512=y
CONFIG_MBEDTLS_ECP_C=y
CONFIG_MBEDTLS_ECDSA_C=y
CONFIG_MBEDTLS_ECP_ALL_ENABLED=y
CONFIG_MBEDTLS_KEY_EXCHANGE_RSA_ENABLED=y
CONFIG_MBEDTLS_GENPRIME_ENABLED=y

# ---- 硬件加速（AES/SM4 走硬件引擎，与 OTBN 无关） ----
CONFIG_MBEDTLS_CIPHER_AES_LINKEDSEMI=y
CONFIG_MBEDTLS_SM4_LINKEDSEMI_HARDWARE_ALT=y
CONFIG_SM4_CLOCK_RESET=y
CONFIG_AES_CLOCK_RESET=y
CONFIG_SHA512_CLOCK_RESET=y
CONFIG_SHA256_CLOCK_RESET=y

# ---- OTBN 适配（本工程主角：SHA/RSA/ECDSA 全走 OTBN） ----
CONFIG_MBEDTLS_SHA224_SHA256_LINKEDSEMI_OTBN_ALT=y
CONFIG_MBEDTLS_SM3_LINKEDSEMI_OTBN_ALT=y
CONFIG_MBEDTLS_SHA384_SHA512_LINKEDSEMI_OTBN_ALT=y
CONFIG_MBEDTLS_ECDSA_SECP256R1_SECP384R1_SM2_LINKEDSEMI_OTBN_ALT=y
CONFIG_MBEDTLS_RSA_LINKEDSEMI_OTBN_ALT=y

# RSA keygen suite (merged from projects/otbn_keygen_test): the OTBN keygen
# backend and its hooks must be compiled into this image explicitly.
CONFIG_LS_OTBN_RSA_KEYGEN=y
CONFIG_LS_OTBN_OPERATION_TIMEOUT_MS=60000
CONFIG_MBEDTLS_LINKEDSEMI_OTBN_DELEGATION_CLIENT=n
CONFIG_MBEDTLS_LINKEDSEMI_OTBN_DELEGATION_SERVER=n

# GPIO support for PA05/PA07 toggle threads
CONFIG_GPIO=y
```

## app.overlay
```dts
/*
 * SPDX-License-Identifier: Apache-2.0
 *
 * OTBN 单核测试 overlay：指定 zephyr,entropy = trng1 并使能
 * （RSA keygen 候选素数生成必须真随机源，见 otbn-rsa-keygen-record.md §6）。
 * dmac2 供带 DMA 的硬件路径使用。
 */

/ {
	chosen {
		zephyr,entropy = &trng1;
	};
};

&trng1 {
	status = "okay";
};

&dmac2 {
	status = "okay";
};

/* GPIO toggle 使能块统一走公共层（SPEC_REFERENCE §6.1.9 复用收敛）：
 * 使能 GPIOA（PA05/PA07 翻转线程所在端口），label 调整只改公共文件。
 * GPIO toggle 仅 cpu1 使用，cpu2 侧固件不编入 gpio_toggle.c、不 include 本片段。 */
#include "../../../common/gpio_toggle.dtsi"
```

## src/main.c
```c
/*
 * SPDX-License-Identifier: Apache-2.0
 *
 * OTBN 单核测试入口（cpu1 安全域）。
 * 纯 ztest：test_main 打印角色 banner 后 zt_init + zt_run_all
 * （common/ztest_glue），不返回（同 ztest 语义）。
 */

#include <zephyr/kernel.h>

#include "ztest_glue.h"

void test_main(void)
{
	printk("[CPU1 OTBN] OTBN test started\n");   /* 角色 banner（harness 依赖） */

	zt_init("TGT");
	zt_run_all();
}
```

## src/mix_test.c
```c
/*
 * SPDX-License-Identifier: Apache-2.0
 *
 * Phase 3：OTBN 固件混用复现测试（已知问题：RSA 密钥生成与 SHA256 来回混用
 * 会导致结果出错）。
 *
 * 背景：OTBN 是独占式协处理器，hash（otbn_hash.c）与 RSA（rsa_alt.c）/
 * ECDSA（ecdsa_alt.c）各自加载不同 IMEM 固件、共用同一块 DMEM。混用场景的
 * 正确性依赖两层状态恢复：
 *   1. hash 中间态保存在 CPU 侧 ctx->state_bytes，每次 update/final 前
 *      restore_state() 写回 DMEM；
 *   2. IMEM 固件加载用 s_last_firmware_id 静态缓存跳过重复加载——
 *      若 RSA keygen 在两次 hash 操作之间改写了 IMEM 而缓存未失效，
 *      后续 hash 会在 RSA 固件上执行，结果出错（本组测试的复现目标）。
 *
 * 每个 mix 测试都自带独立基准（同一消息先单独算出 KAT/参考值），混用后的
 * 结果必须与基准逐字节一致，差异即判 FAIL 并给出可归因 reason（§13.5）。
 *
 * 纯 ztest：每项 mix 场景是一个 ZTEST(mix, <name>)，断言 zassert_*，数值
 * 上报 ZT_INFO（§13.4，断言之前）；结果记账由 common/ztest_glue 自动完成。
 * "mix" 套件按链接段 SORT_BY_NAME 升序排在 api 之后、perf/z_keygen 之前
 * （字母序 api < mix < perf < z_keygen，与原始阶段序 api → mix → 后续 一致）。
 */

#include "otbn_test.h"
#include "ztest_glue.h"

#include <string.h>

#include <zephyr/kernel.h>
#include <zephyr/ztest.h>

#include "mbedtls/sha256.h"
#include "mbedtls/sha512.h"
#include "mbedtls/sm3_alt.h"

#if defined(CONFIG_MBEDTLS_RSA_LINKEDSEMI_OTBN_ALT)
#include "mbedtls/rsa.h"
#endif

#if defined(CONFIG_MBEDTLS_ECDSA_SECP256R1_SECP384R1_SM2_LINKEDSEMI_OTBN_ALT)
#include "mbedtls/ecdsa.h"
#include "mbedtls/ecp.h"
#endif

ZTEST_SUITE(mix, NULL, NULL, NULL, NULL, NULL);

#define SHA256_DIGEST_SIZE 32
#define SHA512_DIGEST_SIZE 64
#define SM3_DIGEST_SIZE 32

/* 混用测试统一消息：56 字节经典向量输入（覆盖多块/填充边界） */
static const char mix_msg[] =
    "abcdbcdecdefdefgefghfghighijhijkijkljklmklmnlmnomnopnopq";

/* sha256(mix_msg) 官方 KAT */
static const uint8_t mix_msg_sha256[SHA256_DIGEST_SIZE] = {
    0x24, 0x8d, 0x6a, 0x61, 0xd2, 0x06, 0x38, 0xb8,
    0xe5, 0xc0, 0x26, 0x93, 0x0c, 0x3e, 0x60, 0x39,
    0xa3, 0x3c, 0xe4, 0x59, 0x64, 0xff, 0x21, 0x67,
    0xf6, 0xec, 0xed, 0xd4, 0x19, 0xdb, 0x06, 0xc1
};

/* sha512(mix_msg) —— 同输入的 128 字节块算法对照 */
static const uint8_t mix_msg_sha512[SHA512_DIGEST_SIZE] = {
    0x20, 0x4a, 0x8f, 0xc6, 0xdd, 0xa8, 0x2f, 0x0a,
    0x0c, 0xed, 0x7b, 0xeb, 0x8e, 0x08, 0xa4, 0x16,
    0x57, 0xc1, 0x6e, 0xf4, 0x68, 0xb2, 0x28, 0xa8,
    0x27, 0x9b, 0xe3, 0x31, 0xa7, 0x03, 0xc3, 0x35,
    0x96, 0xfd, 0x15, 0xc1, 0x3b, 0x1b, 0x07, 0xf9,
    0xaa, 0x1d, 0x3b, 0xea, 0x57, 0x78, 0x9c, 0xa0,
    0x31, 0xad, 0x85, 0xc7, 0xa7, 0x1d, 0xd7, 0x03,
    0x54, 0xec, 0x63, 0x12, 0x38, 0xca, 0x34, 0x45
};

/* sm3(mix_msg) 官方 KAT */
static const uint8_t mix_msg_sm3[SM3_DIGEST_SIZE] = {
    0x63, 0x9b, 0x6c, 0xc5, 0xe6, 0x4d, 0x9e, 0x37,
    0xa3, 0x90, 0xb1, 0x92, 0xdf, 0x4f, 0xa1, 0xea,
    0x07, 0x20, 0xab, 0x74, 0x7f, 0xf6, 0x92, 0xb9,
    0xf3, 0x8c, 0x4e, 0x66, 0xad, 0x7b, 0x8c, 0x05
};

#if defined(CONFIG_MBEDTLS_RSA_LINKEDSEMI_OTBN_ALT)

/* 一次性 sha256（one-shot 基准/混用后用例共用） */
static int sha256_oneshot(const uint8_t *data, size_t len, uint8_t out[SHA256_DIGEST_SIZE])
{
    mbedtls_sha256_context ctx;
    int ret;

    mbedtls_sha256_init(&ctx);
    ret = mbedtls_sha256_starts(&ctx, 0);
    if (ret == 0) {
        ret = mbedtls_sha256_update(&ctx, data, len);
    }
    if (ret == 0) {
        ret = mbedtls_sha256_finish(&ctx, out);
    }
    mbedtls_sha256_free(&ctx);
    return ret;
}

/*
 * mix 1：sha256 KAT → RSA-2048 keygen → sha256 KAT。
 * 复现点：keygen 把 OTBN IMEM 换成 RSA 固件；其后首个 hash 若因
 * s_last_firmware_id 缓存未失效而跳过固件重载，第二次 sha256 结果出错。
 */
ZTEST(mix, mix_sha256_keygen_seq)
{
    uint8_t h1[SHA256_DIGEST_SIZE], h2[SHA256_DIGEST_SIZE];
    uint32_t keygen_ms = 0;
    int ret;

    ret = sha256_oneshot((const uint8_t *)mix_msg, sizeof(mix_msg) - 1, h1);
    zassert_equal(ret, 0, "sha256#1 ret=%d", ret);
    zassert_hash_eq(h1, mix_msg_sha256, SHA256_DIGEST_SIZE, "sha256#1");

    ret = otbn_rsa_keygen_check(2048, &keygen_ms);
    zassert_equal(ret, 0, "keygen2048 ret=%d", ret);

    ret = sha256_oneshot((const uint8_t *)mix_msg, sizeof(mix_msg) - 1, h2);
    zassert_equal(ret, 0, "sha256#2 ret=%d", ret);
    zassert_hash_eq(h2, mix_msg_sha256, SHA256_DIGEST_SIZE, "sha256#2");

    ZT_INFO("mix_sha256_keygen_seq", "keygen_ms=%u", keygen_ms);

    zassert_hash_eq(h2, h1, SHA256_DIGEST_SIZE, "sha256#1vs#2");
}

/*
 * mix 2：sha256 流式（update 一半）→ RSA-2048 keygen → update 完 → finish。
 * 复现点：流式 hash 的中间态/DMEM 消息缓冲被 keygen 的 DMEM 写入覆盖，
 * 或 keygen 后固件未重载，finish 结果与 KAT 不符。
 */
ZTEST(mix, mix_sha256_stream_keygen)
{
    mbedtls_sha256_context ctx;
    uint8_t hash[SHA256_DIGEST_SIZE];
    uint32_t keygen_ms = 0;
    size_t half = (sizeof(mix_msg) - 1) / 2;
    int ret;

    mbedtls_sha256_init(&ctx);
    ret = mbedtls_sha256_starts(&ctx, 0);
    zassert_equal(ret, 0, "stream starts ret=%d", ret);

    ret = mbedtls_sha256_update(&ctx, (const uint8_t *)mix_msg, half);
    zassert_equal(ret, 0, "stream update#1 ret=%d", ret);

    /* 流式 hash 上下文挂着，插入完整 keygen（含 OTBN session/固件切换） */
    {
        int kret = otbn_rsa_keygen_check(2048, &keygen_ms);

        zassert_equal(kret, 0, "keygen2048 ret=%d", kret);
    }

    ret = mbedtls_sha256_update(&ctx, (const uint8_t *)mix_msg + half,
                                (sizeof(mix_msg) - 1) - half);
    zassert_equal(ret, 0, "stream update#2 ret=%d", ret);

    ret = mbedtls_sha256_finish(&ctx, hash);
    zassert_equal(ret, 0, "stream finish ret=%d", ret);
    mbedtls_sha256_free(&ctx);

    ZT_INFO("mix_sha256_stream_keygen", "keygen_ms=%u", keygen_ms);

    zassert_hash_eq(hash, mix_msg_sha256, SHA256_DIGEST_SIZE, "stream_digest");
}

/*
 * mix 3：keygen → sha256 KAT → keygen。
 * 复现点（反向）：keygen 之后跑 hash 再 keygen，第二次 keygen 的
 * DMEM/IMEM 现场被 hash 固件破坏，生成密钥应仍能通过 check_privkey +
 * sign/verify 全流程校验。
 */
ZTEST(mix, mix_keygen_sha256_keygen)
{
    uint8_t h[SHA256_DIGEST_SIZE];
    uint32_t kg1_ms = 0, kg2_ms = 0;
    int ret;

    ret = otbn_rsa_keygen_check(2048, &kg1_ms);
    zassert_equal(ret, 0, "keygen#1 ret=%d", ret);

    ret = sha256_oneshot((const uint8_t *)mix_msg, sizeof(mix_msg) - 1, h);
    zassert_equal(ret, 0, "sha256 ret=%d", ret);
    zassert_hash_eq(h, mix_msg_sha256, SHA256_DIGEST_SIZE, "sha256");

    /* keygen_check 内含 check_privkey + sign + verify */
    ret = otbn_rsa_keygen_check(2048, &kg2_ms);
    zassert_equal(ret, 0, "keygen#2 ret=%d", ret);

    ZT_INFO("mix_keygen_sha256_keygen", "keygen1_ms=%u,keygen2_ms=%u",
            kg1_ms, kg2_ms);
}

/*
 * mix 4：sha256 流式中插入 RSA modexp（sign/verify，固定导入 key）。
 * 复现点：RSA_MODEXP 固件与 hash 固件切换时 hash 流式上下文应无损。
 */
ZTEST(mix, mix_sign_sha256_stream)
{
    mbedtls_sha256_context ctx;
    mbedtls_rsa_context rsa;
    uint8_t hash[SHA256_DIGEST_SIZE];
    uint8_t sig[512];
    const unsigned char sign_msg[] = "mix sign sha256 stream";
    uint8_t sign_hash[SHA256_DIGEST_SIZE];
    size_t half = (sizeof(mix_msg) - 1) / 2;
    int ret;

    ret = otbn_rsa_import_test_key(&rsa);
    zassert_equal(ret, 0, "rsa import ret=%d", ret);

    /* 签名用的 digest 先行 one-shot 算出 */
    ret = sha256_oneshot(sign_msg, sizeof(sign_msg) - 1, sign_hash);
    zassert_equal(ret, 0, "sign_hash ret=%d", ret);

    mbedtls_sha256_init(&ctx);
    ret = mbedtls_sha256_starts(&ctx, 0);
    zassert_equal(ret, 0, "stream starts ret=%d", ret);

    ret = mbedtls_sha256_update(&ctx, (const uint8_t *)mix_msg, half);
    zassert_equal(ret, 0, "stream update#1 ret=%d", ret);

    /* 流式 hash 挂着，插入 RSA modexp sign + verify */
    {
        int sret = mbedtls_rsa_pkcs1_sign(&rsa, otbn_test_rng, NULL,
                                          MBEDTLS_MD_SHA256, 32, sign_hash, sig);

        zassert_equal(sret, 0, "rsa sign ret=%d", sret);

        sret = mbedtls_rsa_pkcs1_verify(&rsa, MBEDTLS_MD_SHA256, 32,
                                        sign_hash, sig);
        zassert_equal(sret, 0, "rsa verify ret=%d", sret);
    }

    ret = mbedtls_sha256_update(&ctx, (const uint8_t *)mix_msg + half,
                                (sizeof(mix_msg) - 1) - half);
    zassert_equal(ret, 0, "stream update#2 ret=%d", ret);

    ret = mbedtls_sha256_finish(&ctx, hash);
    zassert_equal(ret, 0, "stream finish ret=%d", ret);
    mbedtls_sha256_free(&ctx);
    mbedtls_rsa_free(&rsa);

    zassert_hash_eq(hash, mix_msg_sha256, SHA256_DIGEST_SIZE, "stream_digest");
}

/*
 * mix 5：sha512 流式中插入 RSA-2048 keygen（128 字节块算法同款场景）。
 */
ZTEST(mix, mix_sha512_stream_keygen)
{
    mbedtls_sha512_context ctx;
    uint8_t hash[SHA512_DIGEST_SIZE];
    uint32_t keygen_ms = 0;
    size_t half = (sizeof(mix_msg) - 1) / 2;
    int ret;

    mbedtls_sha512_init(&ctx);
    ret = mbedtls_sha512_starts(&ctx, 0);
    zassert_equal(ret, 0, "sha512 starts ret=%d", ret);

    ret = mbedtls_sha512_update(&ctx, (const uint8_t *)mix_msg, half);
    zassert_equal(ret, 0, "sha512 update#1 ret=%d", ret);

    {
        int kret = otbn_rsa_keygen_check(2048, &keygen_ms);

        zassert_equal(kret, 0, "keygen2048 ret=%d", kret);
    }

    ret = mbedtls_sha512_update(&ctx, (const uint8_t *)mix_msg + half,
                                (sizeof(mix_msg) - 1) - half);
    zassert_equal(ret, 0, "sha512 update#2 ret=%d", ret);

    ret = mbedtls_sha512_finish(&ctx, hash);
    zassert_equal(ret, 0, "sha512 finish ret=%d", ret);
    mbedtls_sha512_free(&ctx);

    ZT_INFO("mix_sha512_stream_keygen", "keygen_ms=%u", keygen_ms);

    zassert_hash_eq(hash, mix_msg_sha512, SHA512_DIGEST_SIZE, "sha512_digest");
}

/*
 * mix 6：sm3 流式中插入 RSA-2048 keygen（国密 hash 同款场景）。
 */
ZTEST(mix, mix_sm3_stream_keygen)
{
    mbedtls_sm3_context ctx;
    uint8_t hash[SM3_DIGEST_SIZE];
    uint32_t keygen_ms = 0;
    size_t half = (sizeof(mix_msg) - 1) / 2;
    int ret;

    mbedtls_sm3_init(&ctx);
    ret = mbedtls_sm3_starts(&ctx);
    zassert_equal(ret, 0, "sm3 starts ret=%d", ret);

    ret = mbedtls_sm3_update(&ctx, (const uint8_t *)mix_msg, half);
    zassert_equal(ret, 0, "sm3 update#1 ret=%d", ret);

    {
        int kret = otbn_rsa_keygen_check(2048, &keygen_ms);

        zassert_equal(kret, 0, "keygen2048 ret=%d", kret);
    }

    ret = mbedtls_sm3_update(&ctx, (const uint8_t *)mix_msg + half,
                             (sizeof(mix_msg) - 1) - half);
    zassert_equal(ret, 0, "sm3 update#2 ret=%d", ret);

    ret = mbedtls_sm3_finish(&ctx, hash);
    zassert_equal(ret, 0, "sm3 finish ret=%d", ret);
    mbedtls_sm3_free(&ctx);

    ZT_INFO("mix_sm3_stream_keygen", "keygen_ms=%u", keygen_ms);

    zassert_hash_eq(hash, mix_msg_sm3, SM3_DIGEST_SIZE, "sm3_digest");
}
#endif /* CONFIG_MBEDTLS_RSA_LINKEDSEMI_OTBN_ALT */

#if defined(CONFIG_MBEDTLS_ECDSA_SECP256R1_SECP384R1_SM2_LINKEDSEMI_OTBN_ALT)
/*
 * mix 7：sha256 流式中插入 ECDSA P-256 genkey+sign+verify。
 * 复现点：ECDSA 固件与 hash 固件切换时 hash 流式上下文应无损。
 */
ZTEST(mix, mix_ecdsa_sha256_stream)
{
    mbedtls_sha256_context ctx;
    uint8_t hash[SHA256_DIGEST_SIZE];
    size_t half = (sizeof(mix_msg) - 1) / 2;
    int ret;

    mbedtls_sha256_init(&ctx);
    ret = mbedtls_sha256_starts(&ctx, 0);
    zassert_equal(ret, 0, "stream starts ret=%d", ret);

    ret = mbedtls_sha256_update(&ctx, (const uint8_t *)mix_msg, half);
    zassert_equal(ret, 0, "stream update#1 ret=%d", ret);

    {
        int eret = otbn_ecdsa_curve_once(MBEDTLS_ECP_DP_SECP256R1);

        zassert_equal(eret, 0, "ecdsa p256 ret=%d", eret);
    }

    ret = mbedtls_sha256_update(&ctx, (const uint8_t *)mix_msg + half,
                                (sizeof(mix_msg) - 1) - half);
    zassert_equal(ret, 0, "stream update#2 ret=%d", ret);

    ret = mbedtls_sha256_finish(&ctx, hash);
    zassert_equal(ret, 0, "stream finish ret=%d", ret);
    mbedtls_sha256_free(&ctx);

    zassert_hash_eq(hash, mix_msg_sha256, SHA256_DIGEST_SIZE, "stream_digest");
}
#endif /* CONFIG_MBEDTLS_ECDSA_SECP256R1_SECP384R1_SM2_LINKEDSEMI_OTBN_ALT */
```

## src/otbn_test.c
```c
/*
 * SPDX-License-Identifier: Apache-2.0
 *
 * OTBN 单核测试公共 RNG（cpu1 安全域）。
 *
 * 测试为纯 ztest：main.c 打印角色 banner 后 zt_init + zt_run_all（ztest 原生
 * 框架按链接顺序跑完所有 ZTEST 套件），结果记账由 common/ztest_glue 自动完成。
 * 本文件只保留各测试共用的 RNG 回调。
 * selftest 广谱套件在兄弟工程 projects/otbn_selftest/（镜像体积拆分）。
 */

#include "otbn_test.h"

#include <stdarg.h>
#include <stdio.h>
#include <string.h>

#include <zephyr/kernel.h>
#include <zephyr/device.h>
#include <zephyr/drivers/entropy.h>
#include <zephyr/ztest.h>

void zassert_hash_eq(const uint8_t *act, const uint8_t *exp, size_t len,
		     const char *where_fmt, ...)
{
	size_t i;

	for (i = 0; i < len && act[i] == exp[i]; i++) {
	}
	if (i == len) {
		return;
	}

	char where[64];
	va_list ap;

	va_start(ap, where_fmt);
	vsnprintf(where, sizeof(where), where_fmt, ap);
	va_end(ap);

	/* 4th 参是消息格式串（本树 ztest_assert.h）：reason 形如
	 * "hash not equal to exp: sha256 KAT[0]: byte[3] 0x12 != 0x34" */
	zassert_mem_equal(act, exp, len,
			  "%s: byte[%u] 0x%02x != 0x%02x",
			  where, (unsigned int)i, act[i], exp[i]);
}

static const struct device *trng_dev;

static int trng_init(void)
{
	if (trng_dev != NULL) {
		return 0;
	}

	trng_dev = DEVICE_DT_GET(DT_NODELABEL(trng1));
	if (!device_is_ready(trng_dev)) {
		printk("TRNG device not ready\n");
		trng_dev = NULL;
		return -ENODEV;
	}

	return 0;
}

static volatile uint32_t keygen_rng_call_count;

int otbn_rsa_keygen_get_rng(void *ctx, unsigned char *buf, size_t len)
{
	int rc;

	(void)ctx;

	keygen_rng_call_count++;

	if (trng_init() != 0) {
		return -ENODEV;
	}

	rc = entropy_get_entropy_isr(trng_dev, buf, len, ENTROPY_BUSYWAIT);
	return (rc < 0) ? rc : 0;
}

uint32_t otbn_keygen_rng_calls(void)
{
	return keygen_rng_call_count;
}

int otbn_test_rng(void *ctx, unsigned char *out, size_t len)
{
	static uint32_t state = 0x12345678;

	(void)ctx;

	for (size_t i = 0; i < len; i++) {
		state = state * 1103515245U + 12345U;
		/* PKCS#1 v1.5 padding requires non-zero random bytes. */
		out[i] = (unsigned char)(state | 0x01U);
	}
	return 0;
}

int otbn_get_random(void *ctx, unsigned char *buf, size_t size)
{
	(void)ctx;

	if (trng_init() != 0) {
		return -ENODEV;
	}
	return entropy_get_entropy(trng_dev, buf, size);
}

int otbn_get_fixed(void *ctx, unsigned char *buf, size_t size)
{
	static const uint8_t fixed[3] = { 0xcc, 0xbb, 0xaa };

	(void)ctx;

	/* 循环填充固定 pattern（deterministic ECDSA k） */
	for (size_t i = 0; i < size; i++) {
		buf[i] = fixed[i % sizeof(fixed)];
	}
	return 0;
}

int otbn_rnd_buf(void *ctx, unsigned char *buf, size_t size)
{
	/* 从 ctx 指明的固定 buffer 读 k（ECDSA 定 k KAT）：
	 * 与 samples/mbedtls_test 的 ls_mbedtls_get_fixed 同语义
	 * （memcpy(buf, fix_trng_output, size)）。 */
	memcpy(buf, ctx, size);
	return 0;
}
```

## src/otbn_test.h
```c
/*
 * SPDX-License-Identifier: Apache-2.0
 *
 * OTBN 单核测试公共头：公共 RNG + api 导出给 mix 复用的操作。
 *
 * 测试函数为纯 ztest：每项测试是 ZTEST(suite, name) 原生测试，断言用
 * zassert_*（失败详情 file:line+msg 由 zassert 自身 printk，harness 归因进
 * 报告 reason 列）；数值上报用 ZT_INFO 约定行（§13.4，断言之前）。结果记账
 * 由 common/ztest_glue 的 zt_run_all 自动完成。
 */

#ifndef OTBN_TEST_H
#define OTBN_TEST_H

#include <stdbool.h>
#include <stddef.h>
#include <stdint.h>

/* §13.5 可归因逐字节比对：定位首个不同字节后交 zassert 打印
 * "byte[i] 0x实际 != 0x期望"（断言失败 = 本测试 FAIL，ztest 原生语义）。
 * where_fmt 是场景格式串（如 "sha256 KAT[%d]"），供归因定位向量下标。 */
void zassert_hash_eq(const uint8_t *act, const uint8_t *exp, size_t len,
		     const char *where_fmt, ...);

/* ---- 公共 RNG（api/mix 测试共用） ---- */

/* RSA keygen 专用：TRNG 真随机（entropy_get_entropy_isr BUSYWAIT）。
 * 候选素数生成不能用确定性 LCG（分布有偏找不到素数）。 */
int otbn_rsa_keygen_get_rng(void *ctx, unsigned char *buf, size_t len);

/* PKCS#1 v1.5 padding 用确定性 LCG（每字节强制非零）。 */
int otbn_test_rng(void *ctx, unsigned char *out, size_t len);

/* TRNG 阻塞取熵（ECDSA genkey 用）。 */
int otbn_get_random(void *ctx, unsigned char *buf, size_t size);

/* 固定输出（ECDSA 签名确定性 k，KAT 比对 r/s 用）。 */
int otbn_get_fixed(void *ctx, unsigned char *buf, size_t size);
int otbn_rnd_buf(void *ctx, unsigned char *buf, size_t size);   /* 从 ctx buffer 读定 k（KAT） */

/* ---- api 导出给 mix 复用的操作（混用测试的"另一侧"） ---- */
struct mbedtls_rsa_context;
int otbn_rsa_import_test_key(struct mbedtls_rsa_context *rsa);
int otbn_rsa_keygen_check(unsigned int nbits, uint32_t *elapsed_ms);
int otbn_ecdsa_curve_once(int curve);
uint32_t otbn_keygen_rng_calls(void);

#endif /* OTBN_TEST_H */
```
