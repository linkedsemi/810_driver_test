## CMakeLists.txt
```
# SPDX-License-Identifier: Apache-2.0

cmake_minimum_required(VERSION 3.20.0)
find_package(Zephyr REQUIRED HINTS $ENV{ZEPHYR_BASE})
project(cpu1_mbedtls_test)

# 项目特定源文件
target_sources(app PRIVATE
    src/main.c
    src/mbedtls_test_common.c
    src/hash_test.c
    src/cipher_test.c
    src/ecc_test.c
    src/rsa_test.c
    src/pointops_test.c
    src/thread_test.c
    src/concurrency_test.c
    src/robustness_test.c)

# 项目特定include目录
# 注：../tests/expected 必须保留（protocol.h 引用的 *_vectors.h 向量本体在该目录）。
target_include_directories(app PRIVATE
    ${CMAKE_CURRENT_SOURCE_DIR}/../tests/include
    ${CMAKE_CURRENT_SOURCE_DIR}/../tests/expected)

# 包含公共源文件和配置（test_results.c, ztest_glue.c, gpio_toggle.c）
include(${CMAKE_CURRENT_SOURCE_DIR}/../../../common/common_sources.cmake)
```

## prj.conf
```kconfig
# mbedtls 单核测试基座配置（cpu1 安全域，lsqsh_evb@1os/lsqsh/cpu1）。
# 本文件只放全 case 公共项；被测 Kconfig 路由（LINKEDSEMI ALT / OTBN / SM4 HW）
# 由各 case 的 case.conf 差异注入（tests/case_*/case.conf，CONF_FILE 合并）。
# 配置来源：projects/otbn_test/cpu1_otbn_test/prj.conf +
# samples/mbedtls_test（boards/lsqsh_evb_cpu1.conf）的算法套件并集，
# 去掉全部路由项（默认 n）。

# ---- log 输出规范（CLAUDE.md §4.7：统一 LOG_INF，deferred buf 模式） ----
CONFIG_LOG=y
CONFIG_LOG_MODE_DEFERRED=y
CONFIG_LOG_BUFFER_SIZE=16384
CONFIG_LOG_PROCESS_THREAD_SLEEP_MS=10
CONFIG_LOG_BACKEND_UART=y
CONFIG_LOG_PRINTK=n
CONFIG_SERIAL=y

# ztest 原生框架：测试主体跑 ztest 线程（CONFIG_ZTEST_STACK_SIZE 承载 RSA/
# 大缓冲测试栈需求），main 线程只跑 zt_init + zt_run_all 框架。
# CONFIG_ZTEST_VERBOSE_OUTPUT 是逐项 START/PASS/FAIL 行的门控（§10.26，
# =n 时 harness 只见 PROJECT EXECUTION 一行，逐项结果全 MISSING）。
CONFIG_ZTEST=y
CONFIG_ZTEST_ASSERT_VERBOSE=1
CONFIG_ZTEST_VERBOSE_OUTPUT=y
CONFIG_ZTEST_SUMMARY=n
CONFIG_ZTEST_STACK_SIZE=40960
CONFIG_MAIN_STACK_SIZE=10240

CONFIG_PICOLIBC=y
CONFIG_NEWLIB_LIBC=n
CONFIG_MINIMAL_LIBC=n
CONFIG_TIMING_FUNCTIONS=y

# TRNG（RSA keygen 真随机源 + ECDSA genkey，entropy_get_entropy_isr BUSYWAIT）
CONFIG_ENTROPY_GENERATOR=y
CONFIG_DMA=y

# ---- mbedtls 核心 ----
CONFIG_MBEDTLS=y
CONFIG_MBEDTLS_BUILTIN=y
CONFIG_MBEDTLS_ENABLE_HEAP=y
CONFIG_MBEDTLS_HEAP_SIZE=65536
CONFIG_MBEDTLS_THREADING_LINKEDSEMI_ALT=y
# P1a 新增配置项（2026-09-17）：打开 buffer allocator 的用量计数
# （total_used/header_count/maximum_used）与 cur_get/max_get API，
# 供 robustness 套件的 heap_stress_keygen 监控堆水位（MBED-04）。
# 该开关只加计数，不改变分配行为（库源码 memory_buffer_alloc.c 内均在
# MBEDTLS_MEMORY_DEBUG 之下）。
CONFIG_MBEDTLS_MEMORY_DEBUG=y

# ---- 算法套件（全 case 公共；路由项在各 case.conf） ----
CONFIG_MBEDTLS_CIPHER_AES_ENABLED=y
CONFIG_MBEDTLS_CIPHER_MODE_CBC_ENABLED=y
CONFIG_MBEDTLS_CIPHER_MODE_CTR_ENABLED=y
CONFIG_MBEDTLS_CIPHER_GCM_ENABLED=y
CONFIG_MBEDTLS_SHA224=y
CONFIG_MBEDTLS_SHA256=y
CONFIG_MBEDTLS_SHA384=y
CONFIG_MBEDTLS_SHA512=y
CONFIG_MBEDTLS_ECP_C=y
CONFIG_MBEDTLS_ECDSA_C=y
CONFIG_MBEDTLS_ECP_ALL_ENABLED=y
CONFIG_MBEDTLS_KEY_EXCHANGE_RSA_ENABLED=y
CONFIG_MBEDTLS_GENPRIME_ENABLED=y

# GPIO support for PA05/PA07 toggle threads
CONFIG_GPIO=y
```

## app.overlay
```dts
/*
 * SPDX-License-Identifier: Apache-2.0
 *
 * mbedtls 单核测试 overlay（cpu1 安全域）：指定 zephyr,entropy = trng1 并使能
 * （RSA keygen 候选素数生成与 ECDSA genkey 必须真随机源）。dmac2 供带 DMA
 * 的硬件加密路径使用。
 */

/ {
	chosen {
		zephyr,entropy = &trng1;
	};
};

&trng1 {
	status = "okay";
};

&dmac2 {
	status = "okay";
};

/* GPIO toggle 使能块统一走公共层（SPEC_REFERENCE §6.1.9 复用收敛）：
 * 使能 GPIOA（PA05/PA07 翻转线程所在端口），label 调整只改公共文件。
 * GPIO toggle 仅 cpu1 使用，cpu2 侧固件不编入 gpio_toggle.c、不 include 本片段。 */
#include "../../../common/gpio_toggle.dtsi"
```

## src/main.c
```c
/*
 * SPDX-License-Identifier: Apache-2.0
 *
 * mbedtls 单核测试入口（cpu1 安全域）。
 * 纯 ztest：test_main 打印角色 banner 后 zt_init + zt_run_all
 * （common/ztest_glue），不返回（同 ztest 语义）。
 */

#include <zephyr/kernel.h>
#include <zephyr/logging/log.h>

#include "ztest_glue.h"

LOG_MODULE_REGISTER(mbedtls, CONFIG_MBEDTLS_LOG_LEVEL);

void test_main(void)
{
	printk("[CPU1 MBEDTLS] mbedtls test started\n");   /* 角色 banner（harness 依赖） */

	zt_init("TGT");
	zt_run_all();
}
```

## src/concurrency_test.c
```c
/*
 * SPDX-License-Identifier: Apache-2.0
 *
 * 全 case 公共并发线程安全测试。
 *
 * THREADING_ALT 是基座配置（prj.conf 全局开启）。
 * 本 suite 在每个 case 都编译，线程 A/B 各自使用独立上下文，
 * 同时调用当前 case 已启用的算法路径，验证互斥不崩溃、输出完整。
 */

#include "mbedtls_test_protocol.h"
#include "mbedtls_test.h"
#include "ztest_glue.h"

#include <string.h>

#include <zephyr/kernel.h>
#include <zephyr/ztest.h>

#include <mbedtls/sha256.h>
#include <mbedtls/ecdsa.h>
#include <mbedtls/ecp.h>

ZTEST_SUITE(mbedtls_thread_safety, NULL, NULL, NULL, NULL, NULL);

#define MT_CONC_LOOPS     5
#define MT_CONC_STACK     8192
#define MT_CONC_PRIO      K_PRIO_PREEMPT(-1)

static K_THREAD_STACK_DEFINE(conc_sha_stack, MT_CONC_STACK);
static K_THREAD_STACK_DEFINE(conc_ecdsa_stack, MT_CONC_STACK);
static struct k_thread conc_sha_thread;
static struct k_thread conc_ecdsa_thread;
static volatile int conc_sha_ret;
static volatile int conc_ecdsa_ret;

static const unsigned char conc_msg[] = "concurrent hash payload";

static void conc_sha_thread_fn(void *a, void *b, void *c)
{
	ARG_UNUSED(a); ARG_UNUSED(b); ARG_UNUSED(c);

	int ret = 0;
	unsigned char md[32];

	for (int i = 0; i < MT_CONC_LOOPS && ret == 0; i++) {
		mbedtls_sha256_context ctx;

		mbedtls_sha256_init(&ctx);
		ret = mbedtls_sha256_starts(&ctx, 0);
		if (ret == 0) {
			ret = mbedtls_sha256_update(&ctx, conc_msg, sizeof(conc_msg) - 1);
		}
		if (ret == 0) {
			ret = mbedtls_sha256_finish(&ctx, md);
		}
		mbedtls_sha256_free(&ctx);
	}

	conc_sha_ret = ret;
}

static void conc_ecdsa_thread_fn(void *a, void *b, void *c)
{
	ARG_UNUSED(a); ARG_UNUSED(b); ARG_UNUSED(c);

	int ret = 0;
	mbedtls_ecp_group grp;
	mbedtls_ecp_point Q;
	mbedtls_mpi d, r, s;
	unsigned char hash[32];

	mbedtls_ecp_group_init(&grp);
	mbedtls_ecp_point_init(&Q);
	mbedtls_mpi_init(&d);
	mbedtls_mpi_init(&r);
	mbedtls_mpi_init(&s);

	ret = mbedtls_ecp_group_load(&grp, MBEDTLS_ECP_DP_SECP256R1);
	if (ret == 0) {
		ret = mbedtls_ecp_gen_keypair(&grp, &d, &Q, mt_rng_trng, NULL);
	}

	memset(hash, 0xcc, sizeof(hash));

	for (int i = 0; i < MT_CONC_LOOPS && ret == 0; i++) {
		ret = mbedtls_ecdsa_sign(&grp, &r, &s, &d, hash, sizeof(hash),
					 mt_rng_fixed, NULL);
		if (ret == 0) {
			ret = mbedtls_ecdsa_verify(&grp, hash, sizeof(hash), &Q, &r, &s);
		}
	}

	mbedtls_ecp_group_free(&grp);
	mbedtls_ecp_point_free(&Q);
	mbedtls_mpi_free(&d);
	mbedtls_mpi_free(&r);
	mbedtls_mpi_free(&s);

	conc_ecdsa_ret = ret;
}

ZTEST(mbedtls_thread_safety, concurrent_hash_ecdsa)
{
	conc_sha_ret = -1;
	conc_ecdsa_ret = -1;

	k_thread_create(&conc_sha_thread, conc_sha_stack,
			K_THREAD_STACK_SIZEOF(conc_sha_stack),
			conc_sha_thread_fn, NULL, NULL, NULL,
			MT_CONC_PRIO, 0, K_NO_WAIT);
	k_thread_create(&conc_ecdsa_thread, conc_ecdsa_stack,
			K_THREAD_STACK_SIZEOF(conc_ecdsa_stack),
			conc_ecdsa_thread_fn, NULL, NULL, NULL,
			MT_CONC_PRIO, 0, K_NO_WAIT);

	k_thread_join(&conc_sha_thread, K_FOREVER);
	k_thread_join(&conc_ecdsa_thread, K_FOREVER);

	ZT_INFO("concurrent_hash_ecdsa", "loops=%d,sha_ret=%d,ecdsa_ret=%d",
		MT_CONC_LOOPS, conc_sha_ret, conc_ecdsa_ret);
	zassert_equal(conc_sha_ret, 0, "sha thread ret=%d", conc_sha_ret);
	zassert_equal(conc_ecdsa_ret, 0, "ecdsa thread ret=%d", conc_ecdsa_ret);
}
```

## src/ecc_test.c
```c
/*
 * SPDX-License-Identifier: Apache-2.0
 *
 * ecc 套件：ECDSA P-256 / P-384 / SM2。
 *   - p256_kat：固定 d/Q/k/hash → sign 比对黄金 r/s → verify（标准向量）
 *   - p256/p384/sm2 keygen：genkey（TRNG）→ sign（固定 k）→ verify 回环
 *
 * 曲线/签名实现落在软件还是 OTBN（MBEDTLS_ECDSA_..._LINKEDSEMI_OTBN_ALT）
 * 由 case Kconfig 路由决定；SM2 曲线仅在 CONFIG_MBEDTLS_ECP_DP_SM2_ENABLED
 * 的 case 编译（otbn 两个 case）。genkey 内部经 mbedtls_ecp_mul 语义得到
 * 仿射公钥 Q（OTBN 返回 Montgomery 形式由 ecp 层负责映射，回环 verify
 * 用同一 Q 校验——wolfSSL 侧需手工 map=1 的坑在 mbedtls 侧由 ecp 层消化，
 * otbn_test 同模式已在硬件验证）。
 */

#include "mbedtls_test_protocol.h"
#include "mbedtls_test.h"
#include "ztest_glue.h"

#include <string.h>

#include <zephyr/kernel.h>
#include <zephyr/ztest.h>

#include <mbedtls/bignum.h>
#include <mbedtls/ecdsa.h>
#include <mbedtls/ecp.h>

ZTEST_SUITE(ecc, NULL, NULL, NULL, NULL, NULL);

#define MT_ECC_MAX_HASH  66

/* ---- P-256 定 k 签名 KAT：向量见 expected/ecdsa_vectors.h ---- */
static int ecdsa_p256_kat(void)
{
	mbedtls_ecp_group grp;
	mbedtls_ecp_point Q;
	mbedtls_mpi d, r, s, r_exp, s_exp;
	unsigned char k_buf[66];
	unsigned char hash[MT_ECC_MAX_HASH];
	size_t hlen;
	int klen;
	int ret = 0;

	mbedtls_ecp_group_init(&grp);
	mbedtls_ecp_point_init(&Q);
	mbedtls_mpi_init(&d);
	mbedtls_mpi_init(&r);
	mbedtls_mpi_init(&s);
	mbedtls_mpi_init(&r_exp);
	mbedtls_mpi_init(&s_exp);

	ret = mbedtls_ecp_group_load(&grp, MBEDTLS_ECP_DP_SECP256R1);
	if (ret == 0) {
		ret = mbedtls_ecp_point_read_string(&Q, 16,
						    MT_P256_QX_HEX, MT_P256_QY_HEX);
	}
	if (ret == 0) {
		ret = mbedtls_mpi_read_string(&d, 16, MT_P256_D_HEX);
	}
	if (ret == 0) {
		ret = mbedtls_mpi_read_string(&r_exp, 16, MT_P256_R_HEX);
	}
	if (ret == 0) {
		ret = mbedtls_mpi_read_string(&s_exp, 16, MT_P256_S_HEX);
	}
	if (ret != 0) {
		goto exit;
	}

	memset(k_buf, 0, sizeof(k_buf));
	klen = mt_unhexify(k_buf, MT_P256_K_HEX);
	if (klen <= 0) {
		zassert_true(false, "p256 kat k hex invalid");
		ret = -1;
		goto exit;
	}
	hlen = (size_t)mt_unhexify(hash, MT_P256_HASH_HEX);
	if (hlen == 0) {
		zassert_true(false, "p256 kat hash hex invalid");
		ret = -1;
		goto exit;
	}

	/* 定 k 签名（黄金 r/s 按此 k 算出） */
	ret = mbedtls_ecdsa_sign(&grp, &r, &s, &d, hash, hlen, mt_rng_kbuf, k_buf);
	if (ret != 0) {
		goto exit;
	}
	mt_assert_mpi_eq(&r, &r_exp, sizeof(k_buf), "p256 kat r");
	mt_assert_mpi_eq(&s, &s_exp, sizeof(k_buf), "p256 kat s");

	ret = mbedtls_ecdsa_verify(&grp, hash, hlen, &Q, &r_exp, &s_exp);

exit:
	mbedtls_ecp_group_free(&grp);
	mbedtls_ecp_point_free(&Q);
	mbedtls_mpi_free(&d);
	mbedtls_mpi_free(&r);
	mbedtls_mpi_free(&s);
	mbedtls_mpi_free(&r_exp);
	mbedtls_mpi_free(&s_exp);
	return ret;
}

ZTEST(ecc, p256_kat)
{
	uint32_t t0 = k_cycle_get_32();
	int ret = ecdsa_p256_kat();
	uint32_t us = (uint32_t)k_cyc_to_us_floor64(k_cycle_get_32() - t0);

	ZT_INFO("p256_kat", "curve=p256,mode=fixed_k_kat,us=%u", us);
	zassert_equal(ret, 0, "p256_kat ret=%d", ret);
}

/* ---- genkey(TRNG) → sign(固定 k) → verify 回环 ---- */
static int ecdsa_curve_once(int curve, const char *ztest_name)
{
	mbedtls_ecp_group grp;
	mbedtls_ecp_point Q;
	mbedtls_mpi d, r, s;
	unsigned char hash[MT_ECC_MAX_HASH];
	size_t hlen;
	uint32_t t0, t_sign, us_keygen = 0, us_sign = 0, us_verify = 0;
	int ret;

	hlen = (size_t)mt_unhexify(hash, MT_ECC_HASH_HEX);

	mbedtls_ecp_group_init(&grp);
	mbedtls_ecp_point_init(&Q);
	mbedtls_mpi_init(&d);
	mbedtls_mpi_init(&r);
	mbedtls_mpi_init(&s);

	ret = mbedtls_ecp_group_load(&grp, curve);
	if (ret == 0) {
		t0 = k_cycle_get_32();
		ret = mbedtls_ecp_gen_keypair(&grp, &d, &Q, mt_rng_trng, NULL);
		us_keygen = (uint32_t)k_cyc_to_us_floor64(k_cycle_get_32() - t0);
	}
	if (ret == 0) {
		t_sign = k_cycle_get_32();
		ret = mbedtls_ecdsa_sign(&grp, &r, &s, &d, hash, hlen,
					 mt_rng_fixed, NULL);
		us_sign = (uint32_t)k_cyc_to_us_floor64(k_cycle_get_32() - t_sign);
	}
	if (ret == 0) {
		t0 = k_cycle_get_32();
		ret = mbedtls_ecdsa_verify(&grp, hash, hlen, &Q, &r, &s);
		us_verify = (uint32_t)k_cyc_to_us_floor64(k_cycle_get_32() - t0);
	}

	ZT_INFO(ztest_name, "curve=%s,mode=keygen_sign_verify,keygen_us=%u,sign_us=%u,verify_us=%u",
		(curve == MBEDTLS_ECP_DP_SECP256R1) ? "p256" :
		(curve == MBEDTLS_ECP_DP_SECP384R1) ? "p384" : "sm2",
		us_keygen, us_sign, us_verify);

	mbedtls_ecp_group_free(&grp);
	mbedtls_ecp_point_free(&Q);
	mbedtls_mpi_free(&d);
	mbedtls_mpi_free(&r);
	mbedtls_mpi_free(&s);
	return ret;
}

ZTEST(ecc, p256_keygen)
{
	int ret = ecdsa_curve_once(MBEDTLS_ECP_DP_SECP256R1, "p256_keygen");

	zassert_equal(ret, 0, "p256_keygen ret=%d", ret);
}

ZTEST(ecc, p384_keygen)
{
	int ret = ecdsa_curve_once(MBEDTLS_ECP_DP_SECP384R1, "p384_keygen");

	zassert_equal(ret, 0, "p384_keygen ret=%d", ret);
}

#if defined(CONFIG_MBEDTLS_ECP_DP_SM2_ENABLED) && \
	defined(CONFIG_MBEDTLS_ECDSA_SECP256R1_SECP384R1_SM2_LINKEDSEMI_OTBN_ALT)
ZTEST(ecc, sm2_keygen)
{
	int ret = ecdsa_curve_once(MBEDTLS_ECP_DP_SM2, "sm2_keygen");

	zassert_equal(ret, 0, "sm2_keygen ret=%d", ret);
}
#endif /* SM2 keygen only with OTBN alt: software path does not generate valid SM2 keypair */
```

## src/hash_test.c
```c
/*
 * SPDX-License-Identifier: Apache-2.0
 *
 * hash 套件：SHA224/SHA256/SHA384/SHA512/SM3 KAT（短报文 + 跨块长报文）。
 *
 * 判定 = 标准向量逐字节比对（expected/hash_vectors.h：FIPS 180-4 /
 * GM/T 0004 官方向量 + hashlib 计算的百万 'a' 长报文黄金值）。
 * 走 mbedtls API（mbedtls_sha256/sha512/sm3），具体落在软件还是
 * LINKEDSEMI 硬件/OTBN 路径由 case 的 Kconfig 路由决定（本工程测试目标）。
 * 跨块长报文经 update 分片喂入（1000 x 1000B），覆盖分块累积路径。
 */

#include "mbedtls_test_protocol.h"
#include "mbedtls_test.h"
#include "ztest_glue.h"

#include <string.h>

#include <zephyr/kernel.h>
#include <zephyr/ztest.h>

#include <mbedtls/sha256.h>
#include <mbedtls/sha512.h>

/* SM3 本树只有 alt 实现（无软件 SM3）：仅在 case 路由了 SM3 OTBN/硬件 ALT
 * 时编译（sm3_alt.h 的原型随同一宏门控）。 */
#if defined(CONFIG_MBEDTLS_SM3_LINKEDSEMI_OTBN_ALT) || \
	defined(CONFIG_MBEDTLS_SM3_LINKEDSEMI_HARDWARE_ALT)
#include <mbedtls/sm3_alt.h>
#define MT_HAVE_SM3 1
#endif

ZTEST_SUITE(hash, NULL, NULL, NULL, NULL, NULL);

#define MT_MD_MAX      64
#define MT_LONG_CHUNK  1000U   /* 百万 'a' 分片：1000 x 1000B */

static uint8_t long_chunk[MT_LONG_CHUNK];

/* 通用向量运行器：variant 语义 sha 族 = is224/is384，sm3 忽略 */
struct mt_hash_ops {
	const char *name;
	size_t md_size;
	int variant;
	int (*starts)(void *ctx, int variant);
	int (*update)(void *ctx, const unsigned char *in, size_t len);
	int (*finish)(void *ctx, unsigned char *out);
};

static int sha256_starts(void *ctx, int variant)
{
	return mbedtls_sha256_starts((mbedtls_sha256_context *)ctx, variant);
}

static int sha256_update(void *ctx, const unsigned char *in, size_t len)
{
	return mbedtls_sha256_update((mbedtls_sha256_context *)ctx, in, len);
}

static int sha256_finish(void *ctx, unsigned char *out)
{
	return mbedtls_sha256_finish((mbedtls_sha256_context *)ctx, out);
}

static int sha512_starts(void *ctx, int variant)
{
	return mbedtls_sha512_starts((mbedtls_sha512_context *)ctx, variant);
}

static int sha512_update(void *ctx, const unsigned char *in, size_t len)
{
	return mbedtls_sha512_update((mbedtls_sha512_context *)ctx, in, len);
}

static int sha512_finish(void *ctx, unsigned char *out)
{
	return mbedtls_sha512_finish((mbedtls_sha512_context *)ctx, out);
}

#ifdef MT_HAVE_SM3
static int sm3_starts(void *ctx, int variant)
{
	(void)variant;
	return mbedtls_sm3_starts((mbedtls_sm3_context *)ctx);
}

static int sm3_update(void *ctx, const unsigned char *in, size_t len)
{
	return mbedtls_sm3_update((mbedtls_sm3_context *)ctx, in, len);
}

static int sm3_finish(void *ctx, unsigned char *out)
{
	return mbedtls_sm3_finish((mbedtls_sm3_context *)ctx, out);
}
#endif /* MT_HAVE_SM3 */

static int run_hash(const struct mt_hash_ops *ops,
		    const struct mt_hash_vector *vecs, size_t nvecs,
		    const char *ztest_name)
{
	mbedtls_sha256_context sha256_ctx;
	mbedtls_sha512_context sha512_ctx;
#ifdef MT_HAVE_SM3
	mbedtls_sm3_context sm3_ctx;
#endif
	void *ctx;
	uint8_t md[MT_MD_MAX];
	uint8_t exp_md[MT_MD_MAX];
	uint32_t t0, us;
	int ret = 0;

	if (ops->starts == sha256_starts) {
		mbedtls_sha256_init(&sha256_ctx);
		ctx = &sha256_ctx;
	} else {
		mbedtls_sha512_init(&sha512_ctx);
		ctx = &sha512_ctx;
	}
#ifdef MT_HAVE_SM3
	if (ops->starts == sm3_starts) {
		mbedtls_sm3_init(&sm3_ctx);
		ctx = &sm3_ctx;
	}
#endif

	memset(long_chunk, 'a', sizeof(long_chunk));
	t0 = k_cycle_get_32();

	for (size_t v = 0; v < nvecs && ret == 0; v++) {
		size_t in_len = (vecs[v].input == MT_HASH_MILLION_A)
				? MT_HASH_MILLION_A_LEN : strlen(vecs[v].input);
		const unsigned char *in = (vecs[v].input == MT_HASH_MILLION_A)
					  ? long_chunk
					  : (const unsigned char *)vecs[v].input;

		ret = ops->starts(ctx, ops->variant);
		if (ret != 0) {
			break;
		}

		if (vecs[v].input == MT_HASH_MILLION_A) {
			/* 百万 'a'：1000 次 x 1000B 分片，覆盖跨块累积路径 */
			for (size_t c = 0; c < MT_HASH_MILLION_A_LEN / MT_LONG_CHUNK
			     && ret == 0; c++) {
				ret = ops->update(ctx, in, MT_LONG_CHUNK);
			}
		} else {
			ret = ops->update(ctx, in, in_len);
		}
		if (ret != 0) {
			break;
		}

		ret = ops->finish(ctx, md);
		if (ret != 0) {
			break;
		}

		if (mt_unhexify(exp_md, vecs[v].md_hex) != (int)ops->md_size) {
			zassert_true(false, "%s vec=%u expected md hex invalid",
				     ops->name, (unsigned int)v);
			ret = -1;
			break;
		}
		mt_assert_mem_eq(md, exp_md, ops->md_size, "%s KAT[%u]",
				 ops->name, (unsigned int)v);
	}

	us = (uint32_t)k_cyc_to_us_floor64(k_cycle_get_32() - t0);
	ZT_INFO(ztest_name, "algo=%s,vecs=%u,long_bytes=%u,us=%u",
		ops->name, (unsigned int)nvecs, MT_HASH_MILLION_A_LEN, us);

	if (ops->starts == sha256_starts) {
		mbedtls_sha256_free(&sha256_ctx);
	} else {
		mbedtls_sha512_free(&sha512_ctx);
	}
#ifdef MT_HAVE_SM3
	if (ops->starts == sm3_starts) {
		mbedtls_sm3_free(&sm3_ctx);
	}
#endif
	return ret;
}

#define MT_RUN_HASH(suite_name, ops_ptr, vecs_arr, zt_name) \
	do { \
		/* 变量名避开 _ret：zassert 宏内部声明同名变量会遮蔽外层 */ \
		int mt_ret = run_hash((ops_ptr), (vecs_arr), \
				      ARRAY_SIZE(vecs_arr), (zt_name)); \
		zassert_equal(mt_ret, 0, "%s ret=%d", (zt_name), mt_ret); \
	} while (0)

static const struct mt_hash_ops mt_sha224_ops = {
	.name = "sha224", .md_size = 28, .variant = 1,
	.starts = sha256_starts, .update = sha256_update, .finish = sha256_finish,
};

static const struct mt_hash_ops mt_sha256_ops = {
	.name = "sha256", .md_size = 32, .variant = 0,
	.starts = sha256_starts, .update = sha256_update, .finish = sha256_finish,
};

static const struct mt_hash_ops mt_sha384_ops = {
	.name = "sha384", .md_size = 48, .variant = 1,
	.starts = sha512_starts, .update = sha512_update, .finish = sha512_finish,
};

static const struct mt_hash_ops mt_sha512_ops = {
	.name = "sha512", .md_size = 64, .variant = 0,
	.starts = sha512_starts, .update = sha512_update, .finish = sha512_finish,
};

#ifdef MT_HAVE_SM3
static const struct mt_hash_ops mt_sm3_ops = {
	.name = "sm3", .md_size = 32, .variant = 0,
	.starts = sm3_starts, .update = sm3_update, .finish = sm3_finish,
};
#endif

ZTEST(hash, sha224_kat)
{
	MT_RUN_HASH(hash, &mt_sha224_ops, mt_sha224_vecs, "sha224_kat");
}

ZTEST(hash, sha256_kat)
{
	MT_RUN_HASH(hash, &mt_sha256_ops, mt_sha256_vecs, "sha256_kat");
}

ZTEST(hash, sha384_kat)
{
	MT_RUN_HASH(hash, &mt_sha384_ops, mt_sha384_vecs, "sha384_kat");
}

ZTEST(hash, sha512_kat)
{
	MT_RUN_HASH(hash, &mt_sha512_ops, mt_sha512_vecs, "sha512_kat");
}

#ifdef MT_HAVE_SM3
ZTEST(hash, sm3_kat)
{
	MT_RUN_HASH(hash, &mt_sm3_ops, mt_sm3_vecs, "sm3_kat");
}
#endif /* MT_HAVE_SM3 */

/* ---- ALT NULL 入参加固（只在 LINKEDSEMI SHA ALT 下编入） ----
 *
 * 这是**超出 mbedtls 契约**的加固承诺：mbedtls 在头文件里逐函数写明哪些入参
 * 允许为 NULL（例如 `free` 明确写 may be NULL），而 `starts`/`update` 的 ctx
 * 写的是 "must not be NULL"；上游实现对 NULL ctx 不做检查、直接解引用。
 * 因此"NULL 入参返回错误码"只由 LINKEDSEMI 的 ALT 提供，跑在纯软件 case 上
 * 无意义 —— 故按 config-linkedsemi-alt.h 定义 MBEDTLS_SHA256_ALT /
 * MBEDTLS_SHA512_ALT 的同一条件门控。
 *
 * 覆盖原先混在 robustness_test.c 的 `sha*_bad_params` 里，导致纯软件 case 因
 * 一条它永远无法满足的断言而失败；现拆到此处（见该文件的说明注释）。
 *
 * 判据：每项必须**返回非 0**，而不是把测试线程打死。若驱动解引用 NULL，
 * 线程被内核杀掉、ztest 结果停在初值，由判定链 R9 兜住，不会假通过。
 */
#if defined(CONFIG_MBEDTLS_SHA224_SHA256_LINKEDSEMI_HARDWARE_ALT) || \
	defined(CONFIG_MBEDTLS_SHA224_SHA256_LINKEDSEMI_OTBN_ALT)
ZTEST(hash, sha256_alt_null_params)
{
	mbedtls_sha256_context ctx;
	int r_starts_null, r_update_null;

	r_starts_null = mbedtls_sha256_starts(NULL, 0);
	mbedtls_sha256_init(&ctx);
	r_update_null = mbedtls_sha256_update(&ctx, NULL, 4);
	mbedtls_sha256_free(&ctx);

	ZT_INFO("sha256_alt_null_params", "starts_null_ctx=%d,update_null_input=%d",
		r_starts_null, r_update_null);

	zassert_not_equal(r_starts_null, 0,
			  "sha256_starts(NULL) must return an error, not fault");
	zassert_not_equal(r_update_null, 0,
			  "sha256_update(NULL, ilen>0) must return an error, not fault");
}
#endif

#if defined(CONFIG_MBEDTLS_SHA384_SHA512_LINKEDSEMI_HARDWARE_ALT) || \
	defined(CONFIG_MBEDTLS_SHA384_SHA512_LINKEDSEMI_OTBN_ALT)
ZTEST(hash, sha512_alt_null_params)
{
	mbedtls_sha512_context ctx;
	int r_starts_null, r_update_null;

	r_starts_null = mbedtls_sha512_starts(NULL, 1);
	mbedtls_sha512_init(&ctx);
	r_update_null = mbedtls_sha512_update(&ctx, NULL, 4);
	mbedtls_sha512_free(&ctx);

	ZT_INFO("sha512_alt_null_params", "starts_null_ctx=%d,update_null_input=%d",
		r_starts_null, r_update_null);

	zassert_not_equal(r_starts_null, 0,
			  "sha512_starts(NULL) must return an error, not fault");
	zassert_not_equal(r_update_null, 0,
			  "sha512_update(NULL, ilen>0) must return an error, not fault");
}
#endif
```

## src/mbedtls_test.h
```c
/*
 * SPDX-License-Identifier: Apache-2.0
 *
 * mbedtls 单核测试公共头：断言辅助 + RNG 回调 + 测量。
 *
 * 测试函数为纯 ztest：每项测试是 ZTEST(suite, name) 原生测试，断言用
 * zassert_*（失败详情 file:line+msg 由 zassert 自身 printk，harness 归因进
 * 报告 reason 列，§13.5）；数值上报用 ZT_INFO 约定行（§13.4）。结果记账
 * 由 common/ztest_glue 的 zt_run_all 自动完成（测试函数零 tr_record 样板）。
 */

#ifndef MBEDTLS_TEST_H
#define MBEDTLS_TEST_H

#include <stddef.h>
#include <stdint.h>

struct mbedtls_mpi;

/* ---- §13.5 可归因逐字节比对 ---- */
/* 定位首个不同字节后交 zassert 打印 "byte[i] 0x实际 != 0x期望"；
 * where_fmt 是场景描述（如 "sha256 KAT[%d]"），供归因定位向量下标。 */
void mt_assert_mem_eq(const uint8_t *act, const uint8_t *exp, size_t len,
		      const char *where_fmt, ...);

/* mbedtls_mpi 大数比对（write_binary 后走 mt_assert_mem_eq 语义）。
 * mt 与 exp 不相等时断言失败并给出首个不同字节。 */
void mt_assert_mpi_eq(const struct mbedtls_mpi *mt, const struct mbedtls_mpi *exp,
		      size_t max_bytes, const char *where_fmt, ...);

/* hex 大写字符串 → 二进制；返回字节数，非法字符返回 -1 */
int mt_unhexify(unsigned char *obuf, const char *ibuf);

/* ---- RNG 回调 ---- */

/* TRNG 真随机（RSA keygen 候选素数生成 / ECDSA genkey）。
 * 候选素数生成不能用确定性 LCG（分布有偏找不到素数）。 */
int mt_rng_trng(void *ctx, unsigned char *buf, size_t len);

/* 固定 pattern（ECDSA keygen+sign+verify 回环的确定性 k，签名可复现） */
int mt_rng_fixed(void *ctx, unsigned char *buf, size_t size);

/* PKCS#1 v1.5 加密 padding 用确定性 LCG（每字节强制非零） */
int mt_rng_lcg(void *ctx, unsigned char *buf, size_t len);

/* 从 ctx 指明的固定 buffer 读（定 k KAT：k_buf 作 ctx 传入） */
int mt_rng_kbuf(void *ctx, unsigned char *buf, size_t size);

#endif /* MBEDTLS_TEST_H */
```

## src/mbedtls_test_common.c
```c
/*
 * SPDX-License-Identifier: Apache-2.0
 *
 * mbedtls 单核测试公共实现：断言辅助 + RNG 回调。
 */

#include "mbedtls_test.h"

#include <stdarg.h>
#include <stdio.h>
#include <string.h>

#include <zephyr/kernel.h>
#include <zephyr/device.h>
#include <zephyr/drivers/entropy.h>
#include <zephyr/ztest.h>

#include <mbedtls/bignum.h>

void mt_assert_mem_eq(const uint8_t *act, const uint8_t *exp, size_t len,
		      const char *where_fmt, ...)
{
	size_t i;

	for (i = 0; i < len && act[i] == exp[i]; i++) {
	}
	if (i == len) {
		return;
	}

	char where[64];
	va_list ap;

	va_start(ap, where_fmt);
	vsnprintf(where, sizeof(where), where_fmt, ap);
	va_end(ap);

	/* 4th 参是消息格式串（本树 ztest_assert.h）：reason 形如
	 * "hash not equal to exp: sha256 KAT[0]: byte[3] 0x12 != 0x34" */
	zassert_mem_equal(act, exp, len,
			  "%s: byte[%u] 0x%02x != 0x%02x",
			  where, (unsigned int)i, act[i], exp[i]);
}

void mt_assert_mpi_eq(const struct mbedtls_mpi *mt, const struct mbedtls_mpi *exp,
		      size_t max_bytes, const char *where_fmt, ...)
{
	unsigned char act_buf[80];
	unsigned char exp_buf[80];
	char where[64];
	va_list ap;
	size_t len;
	int ret_act, ret_exp;

	ret_act = mbedtls_mpi_write_binary(mt, act_buf, sizeof(act_buf));
	ret_exp = mbedtls_mpi_write_binary(exp, exp_buf, sizeof(exp_buf));
	if (ret_act != 0 || ret_exp != 0) {
		zassert_false(ret_act || ret_exp,
			      "mpi write_binary failed act=%d exp=%d", ret_act, ret_exp);
		return;
	}

	len = max_bytes;
	for (size_t i = 0; i < len; i++) {
		if (act_buf[i] != exp_buf[i]) {
			va_start(ap, where_fmt);
			vsnprintf(where, sizeof(where), where_fmt, ap);
			va_end(ap);
			zassert_mem_equal(act_buf, exp_buf, len,
					  "%s: byte[%u] 0x%02x != 0x%02x",
					  where, (unsigned int)i,
					  act_buf[i], exp_buf[i]);
			return;
		}
	}
}

int mt_unhexify(unsigned char *obuf, const char *ibuf)
{
	unsigned char c, c2;
	int len = (int)(strlen(ibuf) / 2);

	while (*ibuf != 0) {
		c = *ibuf++;
		if (c >= '0' && c <= '9') {
			c -= '0';
		} else if (c >= 'a' && c <= 'f') {
			c -= 'a' - 10;
		} else if (c >= 'A' && c <= 'F') {
			c -= 'A' - 10;
		} else {
			return -1;
		}

		c2 = *ibuf++;
		if (c2 >= '0' && c2 <= '9') {
			c2 -= '0';
		} else if (c2 >= 'a' && c2 <= 'f') {
			c2 -= 'a' - 10;
		} else if (c2 >= 'A' && c2 <= 'F') {
			c2 -= 'A' - 10;
		} else {
			return -1;
		}

		*obuf++ = (c << 4) | c2;
	}

	return len;
}

/* ---- RNG 回调 ---- */

static const struct device *trng_dev;

static int trng_init(void)
{
	if (trng_dev != NULL) {
		return 0;
	}

	trng_dev = DEVICE_DT_GET(DT_NODELABEL(trng1));
	if (!device_is_ready(trng_dev)) {
		printk("TRNG device not ready\n");
		trng_dev = NULL;
		return -ENODEV;
	}

	return 0;
}

int mt_rng_trng(void *ctx, unsigned char *buf, size_t len)
{
	int rc;

	(void)ctx;

	if (trng_init() != 0) {
		return -ENODEV;
	}

	rc = entropy_get_entropy_isr(trng_dev, buf, len, ENTROPY_BUSYWAIT);
	return (rc < 0) ? rc : 0;
}

int mt_rng_fixed(void *ctx, unsigned char *buf, size_t size)
{
	static const uint8_t fixed[3] = { 0xcc, 0xbb, 0xaa };

	(void)ctx;

	/* 循环填充固定 pattern（确定性 k，签名可复现） */
	for (size_t i = 0; i < size; i++) {
		buf[i] = fixed[i % sizeof(fixed)];
	}
	return 0;
}

int mt_rng_lcg(void *ctx, unsigned char *buf, size_t len)
{
	static uint32_t state = 0x12345678U;

	(void)ctx;

	for (size_t i = 0; i < len; i++) {
		state = state * 1103515245U + 12345U;
		/* PKCS#1 v1.5 加密 padding 要求非零随机字节 */
		buf[i] = (unsigned char)(state | 0x01U);
	}
	return 0;
}

int mt_rng_kbuf(void *ctx, unsigned char *buf, size_t size)
{
	/* ctx 指明固定 buffer（定 k KAT：黄金 r/s 按此 k 算出） */
	memcpy(buf, ctx, size);
	return 0;
}
```

## src/pointops_test.c
```c
/*
 * SPDX-License-Identifier: Apache-2.0
 *
 * OTBN ECC point operations 直接 API 测试（P-256/P-384/P-521）。
 *
 * 被测接口：ls_otbn_pointops_field_bytes / scalar_mult / base_mult / point_add。
 * 向量来源：linkedsemi_zephyr_project/samples/otbn_pointops/src/test_vectors.h
 * （little-endian，已硬件交叉验证）。
 *
 * 仅在 CONFIG_MBEDTLS_LINKEDSEMI_OTBN=y 的 case 编译；纯软 case 不链接。
 */

#include "mbedtls_test_protocol.h"
#include "mbedtls_test.h"
#include "ztest_glue.h"
#include "pointops_vectors.h"

#include <string.h>

#include <zephyr/kernel.h>
#include <zephyr/ztest.h>

#include <otbn_pointops.h>

#if defined(CONFIG_MBEDTLS_LINKEDSEMI_OTBN)
#define MT_HAVE_POINTOPS 1
#endif

#ifdef MT_HAVE_POINTOPS

ZTEST_SUITE(pointops, NULL, NULL, NULL, NULL, NULL);

struct mt_pointops_vector {
	enum ls_otbn_pointops_curve curve;
	const char *name;
	size_t n;
	const uint8_t *k;
	const uint8_t *px, *py;
	const uint8_t *gx, *gy;
	const uint8_t *bm_x, *bm_y;
	const uint8_t *sm_x, *sm_y;
	const uint8_t *pa_x, *pa_y;
};

static const struct mt_pointops_vector mt_pointops_vecs[] = {
	{
		.curve = LS_OTBN_POINTOPS_CURVE_P256,
		.name = "P-256", .n = 32,
		.k = p256_k,
		.px = p256_px, .py = p256_py,
		.gx = p256_gx, .gy = p256_gy,
		.bm_x = p256_bm_x, .bm_y = p256_bm_y,
		.sm_x = p256_sm_x, .sm_y = p256_sm_y,
		.pa_x = p256_pa_x, .pa_y = p256_pa_y,
	},
	{
		.curve = LS_OTBN_POINTOPS_CURVE_P384,
		.name = "P-384", .n = 48,
		.k = p384_k,
		.px = p384_px, .py = p384_py,
		.gx = p384_gx, .gy = p384_gy,
		.bm_x = p384_bm_x, .bm_y = p384_bm_y,
		.sm_x = p384_sm_x, .sm_y = p384_sm_y,
		.pa_x = p384_pa_x, .pa_y = p384_pa_y,
	},
	{
		.curve = LS_OTBN_POINTOPS_CURVE_P521,
		.name = "P-521", .n = 66,
		.k = p521_k,
		.px = p521_px, .py = p521_py,
		.gx = p521_gx, .gy = p521_gy,
		.bm_x = p521_bm_x, .bm_y = p521_bm_y,
		.sm_x = p521_sm_x, .sm_y = p521_sm_y,
		.pa_x = p521_pa_x, .pa_y = p521_pa_y,
	},
};

/* ---- field_bytes：各曲线返回正确字节数 ---- */
ZTEST(pointops, field_bytes)
{
	size_t b;
	int ret;

	ret = ls_otbn_pointops_field_bytes(LS_OTBN_POINTOPS_CURVE_P256, &b);
	zassert_equal(ret, 0, "field_bytes P256 ret=%d", ret);
	zassert_equal(b, 32, "P256 bytes=%u", (unsigned int)b);

	ret = ls_otbn_pointops_field_bytes(LS_OTBN_POINTOPS_CURVE_P384, &b);
	zassert_equal(ret, 0, "field_bytes P384 ret=%d", ret);
	zassert_equal(b, 48, "P384 bytes=%u", (unsigned int)b);

	ret = ls_otbn_pointops_field_bytes(LS_OTBN_POINTOPS_CURVE_P521, &b);
	zassert_equal(ret, 0, "field_bytes P521 ret=%d", ret);
	zassert_equal(b, 66, "P521 bytes=%u", (unsigned int)b);
}

/* ---- base_mult：R = k * G ---- */
ZTEST(pointops, base_mult)
{
	uint8_t rx[66], ry[66];
	int ret = 0;
	uint32_t t0 = k_cycle_get_32();

	for (size_t i = 0; i < ARRAY_SIZE(mt_pointops_vecs) && ret == 0; i++) {
		const struct mt_pointops_vector *v = &mt_pointops_vecs[i];

		ret = ls_otbn_pointops_base_mult(v->curve, v->k, rx, ry);
		if (ret == 0) {
			mt_assert_mem_eq(rx, v->bm_x, v->n,
					 "%s base_mult x", v->name);
			mt_assert_mem_eq(ry, v->bm_y, v->n,
					 "%s base_mult y", v->name);
		}
	}

	uint32_t us = (uint32_t)k_cyc_to_us_floor64(k_cycle_get_32() - t0);
	ZT_INFO("pointops_base_mult", "curves=%u,us=%u",
		(unsigned int)ARRAY_SIZE(mt_pointops_vecs), us);
	zassert_equal(ret, 0, "pointops base_mult ret=%d", ret);
}

/* ---- scalar_mult：R = k * P ---- */
ZTEST(pointops, scalar_mult)
{
	uint8_t rx[66], ry[66];
	int ret = 0;
	uint32_t t0 = k_cycle_get_32();

	for (size_t i = 0; i < ARRAY_SIZE(mt_pointops_vecs) && ret == 0; i++) {
		const struct mt_pointops_vector *v = &mt_pointops_vecs[i];

		ret = ls_otbn_pointops_scalar_mult(v->curve, v->k,
						   v->px, v->py, rx, ry);
		if (ret == 0) {
			mt_assert_mem_eq(rx, v->sm_x, v->n,
					 "%s scalar_mult x", v->name);
			mt_assert_mem_eq(ry, v->sm_y, v->n,
					 "%s scalar_mult y", v->name);
		}
	}

	uint32_t us = (uint32_t)k_cyc_to_us_floor64(k_cycle_get_32() - t0);
	ZT_INFO("pointops_scalar_mult", "curves=%u,us=%u",
		(unsigned int)ARRAY_SIZE(mt_pointops_vecs), us);
	zassert_equal(ret, 0, "pointops scalar_mult ret=%d", ret);
}

/* ---- point_add：R = G + P ---- */
ZTEST(pointops, point_add)
{
	uint8_t rx[66], ry[66];
	int ret = 0;
	uint32_t t0 = k_cycle_get_32();

	for (size_t i = 0; i < ARRAY_SIZE(mt_pointops_vecs) && ret == 0; i++) {
		const struct mt_pointops_vector *v = &mt_pointops_vecs[i];

		ret = ls_otbn_pointops_point_add(v->curve,
						 v->gx, v->gy,
						 v->px, v->py,
						 rx, ry);
		if (ret == 0) {
			mt_assert_mem_eq(rx, v->pa_x, v->n,
					 "%s point_add x", v->name);
			mt_assert_mem_eq(ry, v->pa_y, v->n,
					 "%s point_add y", v->name);
		}
	}

	uint32_t us = (uint32_t)k_cyc_to_us_floor64(k_cycle_get_32() - t0);
	ZT_INFO("pointops_point_add", "curves=%u,us=%u",
		(unsigned int)ARRAY_SIZE(mt_pointops_vecs), us);
	zassert_equal(ret, 0, "pointops point_add ret=%d", ret);
}

/* ---- 高强度组合：3 曲线 x 3 运算连续调用，验证 session 重入无状态污染 ---- */
ZTEST(pointops, stress_reentry)
{
	uint8_t rx[66], ry[66];
	int ret = 0;
	uint32_t t0 = k_cycle_get_32();

	for (int round = 0; round < 3 && ret == 0; round++) {
		for (size_t i = 0; i < ARRAY_SIZE(mt_pointops_vecs) && ret == 0; i++) {
			const struct mt_pointops_vector *v = &mt_pointops_vecs[i];

			ret = ls_otbn_pointops_base_mult(v->curve, v->k, rx, ry);
			if (ret == 0) {
				ret = ls_otbn_pointops_scalar_mult(v->curve, v->k,
								   v->px, v->py, rx, ry);
			}
			if (ret == 0) {
				ret = ls_otbn_pointops_point_add(v->curve,
								 v->gx, v->gy,
								 v->px, v->py,
								 rx, ry);
			}
		}
	}

	uint32_t us = (uint32_t)k_cyc_to_us_floor64(k_cycle_get_32() - t0);
	ZT_INFO("pointops_stress_reentry", "rounds=3,curves=%u,us=%u",
		(unsigned int)ARRAY_SIZE(mt_pointops_vecs), us);
	zassert_equal(ret, 0, "pointops stress_reentry ret=%d", ret);
}

#endif /* MT_HAVE_POINTOPS */
```

## src/robustness_test.c
```c
/*
 * SPDX-License-Identifier: Apache-2.0
 *
 * 鲁棒性测试：异常/临界输入、状态污染、并发共享上下文。
 *
 * 判定 = 不 HardFault、返回码符合文档或保持静默失败；
 * 不追求所有异常都返回 -EINVAL。
 */

#include "mbedtls_test_protocol.h"
#include "mbedtls_test.h"
#include "ztest_glue.h"
#include "pointops_vectors.h"

#include <string.h>

#include <zephyr/kernel.h>
#include <zephyr/ztest.h>

#include <mbedtls/sha256.h>
#include <mbedtls/sha512.h>
#include <mbedtls/aes.h>
#include <mbedtls/ecdsa.h>
#include <mbedtls/ecp.h>
#include <mbedtls/rsa.h>
#include <mbedtls/memory_buffer_alloc.h>   /* P1a：堆水位/泄漏监控（见 heap_stress_keygen） */

extern const unsigned char rsa_msg[];
extern int rsa_import_test_key(mbedtls_rsa_context *rsa);

#if defined(CONFIG_MBEDTLS_LINKEDSEMI_OTBN)
#include <otbn_pointops.h>
#define MT_HAVE_POINTOPS_ROBUST 1
#endif

#if defined(CONFIG_MBEDTLS_SM4_LINKEDSEMI_HARDWARE_ALT)
#include <mbedtls/sm4_alt.h>
#endif

ZTEST_SUITE(robustness, NULL, NULL, NULL, NULL, NULL);

/* ---- SHA-256 异常参数 ---- */
ZTEST(robustness, sha256_bad_params)
{
	mbedtls_sha256_context ctx;
	unsigned char md[32];
	int ret;

	/* An is224 flag that is neither 0 nor 1 is the documented bad-input case:
	 * mbedtls_sha256_starts() is specified to return
	 * MBEDTLS_ERR_SHA256_BAD_INPUT_DATA for it. */
	mbedtls_sha256_init(&ctx);
	ret = mbedtls_sha256_starts(&ctx, 2);
	zassert_not_equal(ret, 0,
			  "sha256_starts(is224=2) should fail (MBEDTLS_ERR_SHA256_BAD_INPUT_DATA)");

	/* len=0 合法（空 update） */
	ret = mbedtls_sha256_starts(&ctx, 0);
	zassert_equal(ret, 0, "sha256_starts init ret=%d", ret);
	ret = mbedtls_sha256_update(&ctx, NULL, 0);
	zassert_equal(ret, 0, "sha256_update len=0 ret=%d", ret);

	/* finish 前 reset 再 update */
	ret = mbedtls_sha256_starts(&ctx, 0);
	zassert_equal(ret, 0, "sha256 re-starts ret=%d", ret);
	ret = mbedtls_sha256_update(&ctx, (const unsigned char *)"abc", 3);
	zassert_equal(ret, 0, "sha256 update abc ret=%d", ret);
	ret = mbedtls_sha256_finish(&ctx, md);
	zassert_equal(ret, 0, "sha256 finish ret=%d", ret);

	mbedtls_sha256_free(&ctx);

	/* NOTE (2026-09-29): NULL-ctx / NULL-input assertions were removed from
	 * this shared case. mbedtls documents ctx as "must not be NULL"
	 * (include/mbedtls/sha256.h) and only whitelists NULL for the few
	 * functions that say so (e.g. free); upstream mbedtls_sha256_starts()
	 * therefore dereferences it unchecked, so the *software baseline* -- this
	 * suite's reference -- crashes rather than returning an error. The
	 * LinkedSemi ALT does reject NULL; that extra guarantee is covered by
	 * `sha_alt_null_params` in hash_test.c, compiled only when the ALT is on. */
}

/* ---- SHA-384 异常参数 ---- */
ZTEST(robustness, sha384_bad_params)
{
	mbedtls_sha512_context ctx;
	int ret;

	/* An is384 flag that is neither 0 nor 1 is the documented bad-input case
	 * for mbedtls_sha512_starts(). */
	mbedtls_sha512_init(&ctx);
	ret = mbedtls_sha512_starts(&ctx, 2);
	zassert_not_equal(ret, 0,
			  "sha384_starts(is384=2) should fail (MBEDTLS_ERR_SHA512_BAD_INPUT_DATA)");

	ret = mbedtls_sha512_starts(&ctx, 1);
	zassert_equal(ret, 0, "sha384_starts init ret=%d", ret);
	ret = mbedtls_sha512_update(&ctx, (const unsigned char *)"abc", 3);
	zassert_equal(ret, 0, "sha384 update abc ret=%d", ret);

	mbedtls_sha512_free(&ctx);

	/* NOTE (2026-09-29): the NULL-ctx / NULL-input assertions that used to be
	 * here were removed for the same reason as in sha256_bad_params -- mbedtls
	 * documents ctx as "must not be NULL", so the software baseline faults
	 * instead of returning an error. See sha_alt_null_params (hash_test.c). */
}

/* ---- AES 异常参数 ---- */
ZTEST(robustness, aes_bad_params)
{
	mbedtls_aes_context ctx;
	unsigned char key[16];
	int ret;

	memset(key, 0xab, sizeof(key));

	/* Wrong key length is the ONLY bad-input case mbedtls actually promises:
	 * mbedtls_aes_setkey_enc() is specified to return
	 * MBEDTLS_ERR_AES_INVALID_KEY_LENGTH for anything other than 128/192/256
	 * (include/mbedtls/aes.h). */
	mbedtls_aes_init(&ctx);
	ret = mbedtls_aes_setkey_enc(&ctx, key, 64);
	zassert_not_equal(ret, 0,
			  "aes setkey bad bits should fail (MBEDTLS_ERR_AES_INVALID_KEY_LENGTH)");

	/* A valid key length must still succeed. */
	ret = mbedtls_aes_setkey_enc(&ctx, key, 128);
	zassert_equal(ret, 0, "aes setkey ret=%d", ret);

	mbedtls_aes_free(&ctx);

	/* NOTE (2026-09-29): the previous version of this case also asserted
	 * NULL-pointer robustness here (NULL ctx to setkey_enc, NULL input to
	 * crypt_cbc). Those assertions were moved out, because they demand
	 * behaviour mbedtls does not specify: upstream mbedtls_aes_setkey_enc()
	 * dereferences ctx and key with no NULL check (library/aes.c), so the
	 * software baseline -- the reference this suite compares against --
	 * faults instead of returning an error. Asserting it here made the
	 * software case fail on a requirement it can never meet.
	 * The LinkedSemi ALT *does* guarantee NULL-safety; that stronger,
	 * ALT-specific guarantee is covered by `aes_alt_null_params` in
	 * cipher_test.c (compiled only when the ALT is enabled). */
}

/* ---- SM4 异常参数 ---- */
#if defined(CONFIG_MBEDTLS_SM4_LINKEDSEMI_HARDWARE_ALT)
ZTEST(robustness, sm4_bad_params)
{
	mbedtls_sm4_context ctx;
	unsigned char key[16] __attribute__((aligned(4)));
	unsigned char iv[16] __attribute__((aligned(4)));
	unsigned char pt[16] __attribute__((aligned(4)));
	unsigned char ct[16] __attribute__((aligned(4)));
	int ret;

	memset(key, 0xab, sizeof(key));
	memset(iv, 0, sizeof(iv));
	memset(pt, 0, sizeof(pt));

	mbedtls_sm4_init(&ctx);
	ret = mbedtls_sm4_setkey(key);
	zassert_equal(ret, 0, "sm4 setkey ret=%d", ret);
	ret = mbedtls_sm4_setiv(&ctx, iv);
	zassert_equal(ret, 0, "sm4 setiv ret=%d", ret);

	ret = mbedtls_sm4_ctr_crypto(&ctx, ct, NULL, 16);
	zassert_not_equal(ret, 0, "sm4 ctr NULL input should fail");

	/* ECB 原语走内联寄存器操作（不经 HAL），须自行拒绝非法入参 */
	ret = mbedtls_sm4_ecb_encrypt(NULL, ct, pt, 16);
	zassert_not_equal(ret, 0, "sm4 ecb NULL ctx should fail");
	ret = mbedtls_sm4_ecb_encrypt(&ctx, ct, NULL, 16);
	zassert_not_equal(ret, 0, "sm4 ecb NULL input should fail");
	ret = mbedtls_sm4_ecb_encrypt(&ctx, NULL, pt, 16);
	zassert_not_equal(ret, 0, "sm4 ecb NULL output should fail");
	ret = mbedtls_sm4_ecb_decrypt(&ctx, ct, NULL, 16);
	zassert_not_equal(ret, 0, "sm4 ecb dec NULL input should fail");
	ret = mbedtls_sm4_ecb_decrypt(&ctx, NULL, pt, 16);
	zassert_not_equal(ret, 0, "sm4 ecb dec NULL output should fail");

	/* 长度 0 与非 16 整块：进硬件前即须拒绝（CALC_LEN 下溢） */
	ret = mbedtls_sm4_ecb_encrypt(&ctx, ct, pt, 0);
	zassert_not_equal(ret, 0, "sm4 ecb len=0 should fail");
	ret = mbedtls_sm4_ecb_encrypt(&ctx, ct, pt, 20);
	zassert_not_equal(ret, 0, "sm4 ecb non-block len should fail");

	/* 合法入参仍须成功——确认校验未误伤正常路径 */
	ret = mbedtls_sm4_ecb_encrypt(&ctx, ct, pt, 16);
	zassert_equal(ret, 0, "sm4 ecb valid ret=%d", ret);
	ret = mbedtls_sm4_ecb_decrypt(&ctx, pt, ct, 16);
	zassert_equal(ret, 0, "sm4 ecb dec valid ret=%d", ret);

	mbedtls_sm4_free(&ctx);
}
#endif

/* ---- ECDSA 异常/负例 ---- */
ZTEST(robustness, ecdsa_tamper_verify)
{
	mbedtls_ecp_group grp;
	mbedtls_ecp_point Q;
	mbedtls_mpi d, r, s;
	unsigned char hash[32];
	int ret;

	mbedtls_ecp_group_init(&grp);
	mbedtls_ecp_point_init(&Q);
	mbedtls_mpi_init(&d);
	mbedtls_mpi_init(&r);
	mbedtls_mpi_init(&s);

	ret = mbedtls_ecp_group_load(&grp, MBEDTLS_ECP_DP_SECP256R1);
	if (ret == 0) {
		ret = mbedtls_ecp_gen_keypair(&grp, &d, &Q, mt_rng_trng, NULL);
	}
	memset(hash, 0x55, sizeof(hash));
	if (ret == 0) {
		ret = mbedtls_ecdsa_sign(&grp, &r, &s, &d, hash, sizeof(hash),
				       mt_rng_fixed, NULL);
	}
	if (ret == 0) {
		ret = mbedtls_ecdsa_verify(&grp, hash, sizeof(hash), &Q, &r, &s);
		zassert_equal(ret, 0, "ecdsa verify good ret=%d", ret);
	}

	/* 改消息后 verify 应失败 */
	if (ret == 0) {
		hash[0] ^= 0x01;
		ret = mbedtls_ecdsa_verify(&grp, hash, sizeof(hash), &Q, &r, &s);
		zassert_not_equal(ret, 0, "ecdsa verify tampered should fail");
		hash[0] ^= 0x01;
	}

	mbedtls_ecp_group_free(&grp);
	mbedtls_ecp_point_free(&Q);
	mbedtls_mpi_free(&d);
	mbedtls_mpi_free(&r);
	mbedtls_mpi_free(&s);

	/* NOTE (2026-09-29): a "verify with NULL group must fail" assertion used to
	 * be here. It was removed because mbedtls documents grp as an initialised
	 * group -- NULL is a caller contract violation, not an error path -- and
	 * upstream mbedtls_ecdsa_verify_restartable() dereferences it unchecked
	 * (library/ecdsa.c), so the software baseline faults instead of returning
	 * an error. The LinkedSemi OTBN ECDSA ALT does reject NULL; that extra
	 * guarantee belongs with the ALT-gated hardening coverage, not here. */
}

/* ---- RSA 异常/负例 ---- */
ZTEST(robustness, rsa_key_mismatch)
{
	mbedtls_rsa_context rsa_pub;
	unsigned char n[256];
	int ret;

	mbedtls_rsa_init(&rsa_pub);

	/* 构造只含公钥 (n,e) 的上下文 */
	memcpy(n, rsa2048_n, sizeof(rsa2048_n));
	ret = mbedtls_rsa_import_raw(&rsa_pub,
				     n, sizeof(n),
				     NULL, 0,
				     NULL, 0,
				     NULL, 0,
				     rsa2048_e, sizeof(rsa2048_e));
	if (ret == 0) {
		ret = mbedtls_rsa_complete(&rsa_pub);
	}
	zassert_equal(ret, 0, "rsa import pub ret=%d", ret);

	/* 公钥上下文缺少 d/p/q 等私钥分量，check_privkey 应失败 */
	ret = mbedtls_rsa_check_privkey(&rsa_pub);
	zassert_not_equal(ret, 0, "rsa check_privkey pub-only should fail");

	mbedtls_rsa_free(&rsa_pub);
}

/* ---- RSA keygen 非 F4 回退软件 ---- */
ZTEST(robustness, rsa_keygen_non_f4_fallback)
{
	mbedtls_rsa_context rsa;
	int ret;

	mbedtls_rsa_init(&rsa);
	/* public exponent = 3，应仍成功（可能回退软件路径） */
	ret = mbedtls_rsa_gen_key(&rsa, mt_rng_trng, NULL, 2048, 3);
	zassert_equal(ret, 0, "rsa genkey e=3 ret=%d", ret);

	if (ret == 0) {
		ret = mbedtls_rsa_check_privkey(&rsa);
		zassert_equal(ret, 0, "rsa check e=3 ret=%d", ret);
	}

	mbedtls_rsa_free(&rsa);
}

/* 双线程共享同一 SHA-256 ctx（THREADING_ALT 互斥生效）。
 * 仅在纯软件 SHA-256 路径下执行：HW/OTBN alt 驱动层在跨线程复用同一 ctx
 * 时会死锁（doneLock 快照/引擎状态与线程切换互锁，实测 case_hw_otbn_mix
 * 子线程 update 挂死），属驱动限制，非本测试目标；HW/OTBN 路径的线程安全
 * 由 concurrency_test.c 的独立上下文并发 suite 覆盖。
 */
#if defined(CONFIG_MBEDTLS_THREADING_LINKEDSEMI_ALT) && \
	!defined(CONFIG_MBEDTLS_SHA224_SHA256_LINKEDSEMI_HARDWARE_ALT) && \
	!defined(CONFIG_MBEDTLS_SHA224_SHA256_LINKEDSEMI_OTBN_ALT)
static K_THREAD_STACK_DEFINE(rb_sha_stack, 24576);
static struct k_thread rb_sha_thread;
static volatile int rb_sha_ret;
static mbedtls_sha256_context rb_sha_ctx;
static unsigned char rb_sha_md[32];

static void rb_sha_thread_fn(void *a, void *b, void *c)
{
	ARG_UNUSED(a); ARG_UNUSED(b); ARG_UNUSED(c);

	int ret = 0;
	for (int i = 0; i < 10 && ret == 0; i++) {
		ret = mbedtls_sha256_update(&rb_sha_ctx,
					    (const unsigned char *)"thread", 6);
	}
	rb_sha_ret = ret;
}

ZTEST(robustness, shared_sha256_ctx_thread)
{
	int ret;

	mbedtls_sha256_init(&rb_sha_ctx);
	ret = mbedtls_sha256_starts(&rb_sha_ctx, 0);
	zassert_equal(ret, 0, "shared sha starts ret=%d", ret);

	rb_sha_ret = -1;
	k_thread_create(&rb_sha_thread, rb_sha_stack,
			K_THREAD_STACK_SIZEOF(rb_sha_stack),
			rb_sha_thread_fn, NULL, NULL, NULL,
			K_PRIO_PREEMPT(-1), 0, K_NO_WAIT);

	/* 子线程优先级更高：先 yield 让子线程完成全部 update */
	k_yield();

	/* 主线程同步更新同一 ctx */
	for (int i = 0; i < 10 && ret == 0; i++) {
		ret = mbedtls_sha256_update(&rb_sha_ctx,
					    (const unsigned char *)"main", 4);
	}

	/* 10s 超时兜底：若驱动层锁嵌套死锁，不让整个 suite 挂死 */
	ret = k_thread_join(&rb_sha_thread, K_MSEC(10000));
	zassert_equal(ret, 0, "shared sha ctx thread join timed out (deadlock?)");

	/* 最后由主线程 finish（避免子线程在 finish 中触发引擎时与主线程互锁） */
	if (ret == 0) {
		ret = mbedtls_sha256_finish(&rb_sha_ctx, rb_sha_md);
	}

	/* 不崩溃即视为 THREADING_ALT 互斥生效；结果不具确定性 */
	zassert_true(ret == 0 || rb_sha_ret == 0,
		     "shared sha ctx crash/ret=%d/%d", ret, rb_sha_ret);
	mbedtls_sha256_free(&rb_sha_ctx);
}
#endif

/* ---- otbn_pointops 鲁棒性 ---- */
#ifdef MT_HAVE_POINTOPS_ROBUST

/* 非法 curve 值 */
#define MT_BAD_CURVE ((enum ls_otbn_pointops_curve)0xFF)

ZTEST(robustness, pointops_field_bytes_bad)
{
	size_t b;
	int ret;

	ret = ls_otbn_pointops_field_bytes(MT_BAD_CURVE, &b);
	zassert_not_equal(ret, 0, "field_bytes bad curve should fail");

	ret = ls_otbn_pointops_field_bytes(LS_OTBN_POINTOPS_CURVE_P256, NULL);
	zassert_not_equal(ret, 0, "field_bytes NULL bytes should fail");
}

ZTEST(robustness, pointops_scalar_mult_bad)
{
	uint8_t rx[32], ry[32];
	int ret;

	ret = ls_otbn_pointops_scalar_mult(LS_OTBN_POINTOPS_CURVE_P256,
					   NULL, p256_px, p256_py,
					   rx, ry);
	zassert_not_equal(ret, 0, "scalar_mult NULL scalar should fail");

	ret = ls_otbn_pointops_scalar_mult(MT_BAD_CURVE,
					   p256_k, p256_px, p256_py,
					   rx, ry);
	zassert_not_equal(ret, 0, "scalar_mult bad curve should fail");
}

ZTEST(robustness, pointops_base_mult_bad)
{
	uint8_t rx[32], ry[32];
	int ret;

	ret = ls_otbn_pointops_base_mult(LS_OTBN_POINTOPS_CURVE_P256, NULL,
					 rx, ry);
	zassert_not_equal(ret, 0, "base_mult NULL scalar should fail");

	ret = ls_otbn_pointops_base_mult(MT_BAD_CURVE, p256_k, rx, ry);
	zassert_not_equal(ret, 0, "base_mult bad curve should fail");
}

ZTEST(robustness, pointops_point_add_bad)
{
	uint8_t rx[32], ry[32];
	int ret;

	ret = ls_otbn_pointops_point_add(LS_OTBN_POINTOPS_CURVE_P256,
					 p256_gx, p256_gy, NULL, p256_py,
					 rx, ry);
	zassert_not_equal(ret, 0, "point_add NULL qx should fail");

	ret = ls_otbn_pointops_point_add(MT_BAD_CURVE,
					 p256_gx, p256_gy,
					 p256_px, p256_py,
					 rx, ry);
	zassert_not_equal(ret, 0, "point_add bad curve should fail");
}

/* 【已删除 2026-09-18】原 `pointops_scalar_edge`（scalar 全 0 / 全 0xFF）：
 * 其唯一断言是 `zassert_true(ret == 0 || ret != 0, ...)` —— 对任意 ret 恒真，
 * **永不可能 FAIL**（测试有效性审计 A 组 P0-2）。删除而非改写，理由：
 *   - `ls_otbn_pointops_base_mult()`（otbn_pointops.c:895-921）对 scalar=0
 *     不做校验，直接送 OTBN 固件执行；"k=0 ⇒ 无穷远点"的**编码形式**
 *     （全 0 / 带 flag / 固件直接报错）无驱动或固件契约可依，无法独立算出黄金值；
 *   - 按审计纪律"支撑不了就删，不要编一个假断言"，本项不保留替代断言。
 * 覆盖影响与依据见 tests/COVERAGE.md「pointops_scalar_edge」条目。 */

#endif /* MT_HAVE_POINTOPS_ROBUST */

/* ==================================================================
 * P1a 新增（2026-09-17）：MBED-04 —— 重复密钥生成的堆水位 / 泄漏监控
 *
 * 依赖（本工程 prj.conf 已加）：`CONFIG_MBEDTLS_ENABLE_HEAP=y` +
 * `CONFIG_MBEDTLS_MEMORY_DEBUG=y`。
 *   - 堆本体 = `CONFIG_MBEDTLS_HEAP_SIZE`(65536) 的静态 buffer，
 *     由 zephyr/modules/mbedtls/zephyr_init.c 在
 *     `MBEDTLS_ENABLE_HEAP && MBEDTLS_MEMORY_BUFFER_ALLOC_C` 下调
 *     `mbedtls_memory_buffer_alloc_init()` 建立。
 *   - `cur_get` / `max_get` / `verify` 的实现与计数字段
 *     （`total_used` / `header_count` / `maximum_used`）都在库源码
 *     `memory_buffer_alloc.c` 的 `MBEDTLS_MEMORY_DEBUG` 之下，
 *     故必须先开 `CONFIG_MBEDTLS_MEMORY_DEBUG`（它只加计数、不改分配行为）。
 *
 * 判据：完整跑「group_load → N 次 P-256 keygen（每次立即释放）→ group_free」
 * 之后，堆占用必须**回落到进入测试时的基线**（无净增长 = 无泄漏）；
 * 且逐轮占用不得单调上涨。
 * ================================================================== */
#if defined(MBEDTLS_MEMORY_BUFFER_ALLOC_C) && defined(MBEDTLS_MEMORY_DEBUG)

ZTEST(robustness, heap_stress_keygen)
{
	const int loops = 16;
	mbedtls_ecp_group grp;
	size_t pre_used = 0;
	size_t pre_blocks = 0;
	size_t base_used = 0;
	size_t base_blocks = 0;
	size_t post_used = 0;
	size_t post_blocks = 0;
	size_t first_after = 0;
	size_t max_after = 0;
	size_t peak_used = 0;
	size_t peak_blocks = 0;
	int ret;
	int i;

	zassert_equal(mbedtls_memory_buffer_alloc_verify(), 0,
		      "heap header chain broken before keygen stress");

	/* 进入测试时的堆基线 */
	mbedtls_memory_buffer_alloc_cur_get(&pre_used, &pre_blocks);

	mbedtls_ecp_group_init(&grp);
	ret = mbedtls_ecp_group_load(&grp, MBEDTLS_ECP_DP_SECP256R1);
	zassert_equal(ret, 0, "ecp_group_load ret %d", ret);

	/* group_load 之后的常驻占用（grp 自身持有的 P/A/B/G） */
	mbedtls_memory_buffer_alloc_cur_get(&base_used, &base_blocks);

	for (i = 0; i < loops; i++) {
		mbedtls_mpi d;
		mbedtls_ecp_point Q;
		size_t cur_used = 0;
		size_t cur_blocks = 0;

		mbedtls_mpi_init(&d);
		mbedtls_ecp_point_init(&Q);

		/* TRNG 真随机：私钥/候选生成不能用确定性 LCG */
		ret = mbedtls_ecp_gen_keypair(&grp, &d, &Q, mt_rng_trng, NULL);
		zassert_equal(ret, 0, "ecp_gen_keypair #%d ret %d", i, ret);

		mbedtls_mpi_free(&d);
		mbedtls_ecp_point_free(&Q);

		mbedtls_memory_buffer_alloc_cur_get(&cur_used, &cur_blocks);
		if (i == 0) {
			first_after = cur_used;
		}
		if (cur_used > max_after) {
			max_after = cur_used;
		}
	}

	mbedtls_memory_buffer_alloc_max_get(&peak_used, &peak_blocks);
	mbedtls_ecp_group_free(&grp);
	mbedtls_memory_buffer_alloc_cur_get(&post_used, &post_blocks);

	zassert_equal(mbedtls_memory_buffer_alloc_verify(), 0,
		      "heap header chain broken after keygen stress");

	ZT_INFO("heap_stress_keygen",
		"loops=%d,pre_used=%u,base_used=%u,first_after=%u,max_after=%u,"
		"post_used=%u,peak_used=%u,peak_blocks=%u,heap=%u",
		loops, (unsigned)pre_used, (unsigned)base_used,
		(unsigned)first_after, (unsigned)max_after, (unsigned)post_used,
		(unsigned)peak_used, (unsigned)peak_blocks,
		(unsigned)CONFIG_MBEDTLS_HEAP_SIZE);

	/* 判据 1：逐轮占用不得上涨（第 1 轮后允许一次性常驻，之后必须持平） */
	zassert_true(max_after <= first_after,
		     "heap grew across keygen rounds: max_after=%u > first_after=%u",
		     (unsigned)max_after, (unsigned)first_after);

	/* 判据 2（核心泄漏判据）：整个 group_load+keygen+group_free 周期结束后，
	 * 堆占用必须回落到进入测试时的基线，不得有净增长 */
	zassert_true(post_used <= pre_used,
		     "heap leak: post_used=%u > pre_used=%u (net growth %d bytes)",
		     (unsigned)post_used, (unsigned)pre_used,
		     (int)post_used - (int)pre_used);

	/* 判据 3：峰值必须留在堆容量之内（未触顶，测试本身有效） */
	zassert_true(peak_used < (size_t)CONFIG_MBEDTLS_HEAP_SIZE,
		     "heap peak %u reached capacity %u",
		     (unsigned)peak_used, (unsigned)CONFIG_MBEDTLS_HEAP_SIZE);
}

#endif /* MBEDTLS_MEMORY_BUFFER_ALLOC_C && MBEDTLS_MEMORY_DEBUG */
```
