## CMakeLists.txt
```
# SPDX-License-Identifier: Apache-2.0

cmake_minimum_required(VERSION 3.20.0)
find_package(Zephyr REQUIRED HINTS $ENV{ZEPHYR_BASE})
project(cpu1_rtc_test)

# 项目特定源文件
target_sources(app PRIVATE
    src/main.c
    src/rtc_test.c)

# 项目特定include目录
target_include_directories(app PRIVATE
    ${CMAKE_CURRENT_SOURCE_DIR}/../tests/include)

# 包含公共源文件（test_results.c / gpio_toggle.c / ztest_glue.c）
# ztest_glue.c 提供 zt_init()：本工程原先刻意不编入，是全仓**唯一不打印
# `ZT_BOOT`** 的工程（§6.9.5 B 级缺口）。补入后 test_main 首行调 zt_init
# 即可获得统一引导标记；本工程不调 zt_run_all()（rtc_test_run 自驱动），
# ztest_glue 的其余函数不参与本工程流程。
set(COMMON_DIR ${CMAKE_CURRENT_SOURCE_DIR}/../../../common)
target_sources(app PRIVATE
    ${COMMON_DIR}/test_results.c
    ${COMMON_DIR}/gpio_toggle.c
    ${COMMON_DIR}/ztest_glue.c)
target_include_directories(app PRIVATE ${COMMON_DIR})

# 选择性运行测试：1=编译进去跑，0=编译期裁掉。
# 日历边界专项：仅 RTC_EN_CALENDAR_ROLLOVER=1，其余 0。
target_compile_definitions(app PRIVATE
    RTC_EN_SET_GET_ROUNDTRIP=1
    RTC_EN_TIME_ADVANCES=1
    RTC_EN_INVALID_SET_ARGS=1
    RTC_EN_ALARM_SET_GET=1
    RTC_EN_ALARM_FIRES=1
    RTC_EN_ALARM_INVALID_ARGS=1
    RTC_EN_CALIBRATION_ROUNDTRIP=1
    RTC_EN_CALIBRATION_NEGATIVE=1
    RTC_EN_CALIBRATION_NULL_ARG=1
    RTC_EN_CALENDAR_ROLLOVER=1
)
```

## prj.conf
```kconfig
CONFIG_LOG=y
CONFIG_LOG_MODE_DEFERRED=y
CONFIG_LOG_BUFFER_SIZE=16384
CONFIG_LOG_PROCESS_THREAD_SLEEP_MS=10
CONFIG_SERIAL=y
CONFIG_SHELL=n
CONFIG_ZTEST=y
CONFIG_ZTEST_ASSERT_VERBOSE=1
CONFIG_ZTEST_VERBOSE_OUTPUT=y
CONFIG_ZTEST_SUMMARY=n
# libc 选择（与全部单核工程统一，CLAUDE.md §4.2）：minimal libc 不提供
# mktime()，而共享 HAL modules/hal/linkedsemi/soc/rv32/qsh/platform.c 的
# rtc_timer_set_time() 自 2026-09-16 起调用 mktime → 缺此配置则 1os 构建
# 报 implicit declaration of 'mktime' 直接失败。picolibc 提供 mktime。
CONFIG_PICOLIBC=y
CONFIG_NEWLIB_LIBC=n
CONFIG_MINIMAL_LIBC=n
# linkedsemi_ls_rtc 驱动（rtc_ls.c）：dts rtc status=okay 后
# CONFIG_RTC_LS default y + DT_HAS_LINKEDSEMI_LS_RTC_ENABLED 自动使能
CONFIG_RTC=y
CONFIG_RTC_LS=y
CONFIG_RTC_ALARM=y
CONFIG_RTC_CALIBRATION=y
# RTC update 事件回调（P1a 新增配置项）：开此项后 rtc_ls.c 的
# `#if defined(CONFIG_RTC_UPDATE)` 分支才编入（rtc_ls_update_set_callback
# 桩固定返回 -ENOTSUP），配套用例 update_callback_notsup。
CONFIG_RTC_UPDATE=y

# GPIO support for PA05/PA07 toggle threads
CONFIG_GPIO=y
```

## app.overlay
```dts
/*
 * SPDX-License-Identifier: Apache-2.0
 *
 * RTC 单核测试 overlay：使能 rtc@4006fc00（soc dtsi 默认 disabled）。
 */

&rtc {
	status = "okay";
};

/* GPIO toggle 使能块统一走公共层（SPEC_REFERENCE §6.1.9 复用收敛）：
 * 使能 GPIOA（PA05/PA07 翻转线程所在端口），label 调整只改公共文件。
 * GPIO toggle 仅 cpu1 使用，cpu2 侧固件不编入 gpio_toggle.c、不 include 本片段。 */
#include "../../../common/gpio_toggle.dtsi"
```

## src/main.c
```c
/*
 * SPDX-License-Identifier: Apache-2.0
 *
 * RTC 单核测试入口（cpu1 安全域）。
 *
 * 主动自驱动模式（同 trng_test controller 侧）：test_main() 里
 * 顺序跑完所有 ZTEST（ztest_run_all），结尾打 SUMMARY + DONE token。
 * ZTEST 框架线程即主线程，全程不返回，无 LOG_PANIC 死窗风险。
 */

#include "rtc_test.h"
#include "ztest_glue.h"

#include <zephyr/kernel.h>
#include <zephyr/device.h>
#include <zephyr/drivers/rtc.h>
#include <zephyr/logging/log.h>

LOG_MODULE_REGISTER(rtc_test, LOG_LEVEL_INF);

/* rtc@4006fc00（PMU 域硬件 RTC，cyc-1hz=32768，cpu1 安全域） */
const struct device *rtc_dev = DEVICE_DT_GET(DT_NODELABEL(rtc));

void test_main(void)
{
	/* BOOT 标记（§6.2.3 门禁 / §6.9.1 引导语义）：本工程原先唯一不调
	 * zt_init ⇒ 无 `ZT_BOOT`，是全仓最后一个缺引导标记的工程。zt_init
	 * 只打印一行，不注册/不记账，对 rtc_test_run() 的既有流程零影响。 */
	zt_init("TGT");

	LOG_INF("[CPU1 RTC] RTC test started");

	rtc_test_run();
}
```

## src/rtc_test.h
```c
/*
 * SPDX-License-Identifier: Apache-2.0
 */

#ifndef RTC_TEST_H
#define RTC_TEST_H

/* 被测 RTC 设备（app.overlay 使能 rtc@4006fc00） */
extern const struct device *rtc_dev;

/* 跑完全部 ZTEST 套件 + 汇总 + DONE token（test_main 入口调用） */
void rtc_test_run(void);

#endif /* RTC_TEST_H */
```
