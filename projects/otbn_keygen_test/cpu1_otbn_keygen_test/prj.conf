## CMakeLists.txt
```
# SPDX-License-Identifier: Apache-2.0

cmake_minimum_required(VERSION 3.20.0)
find_package(Zephyr REQUIRED HINTS $ENV{ZEPHYR_BASE})
project(cpu1_otbn_keygen_test)

# 项目特定源文件
target_sources(app PRIVATE
    src/main.c
    src/otbn_keygen_test.c
    src/otbn_modexp_kat.c
    src/otbn_bench.c
    src/trial_div_bench.c)

# 项目特定include目录
# 注：../tests/expected 保留——ref_vector.h（客户 TPM 参考向量）向量本体在该目录。
target_include_directories(app PRIVATE
    ${CMAKE_CURRENT_SOURCE_DIR}/../tests/include
    ${CMAKE_CURRENT_SOURCE_DIR}/../tests/expected)

# 包含公共源文件和配置（test_results.c, ztest_glue.c, gpio_toggle.c）
include(${CMAKE_CURRENT_SOURCE_DIR}/../../../common/common_sources.cmake)
```

## prj.conf
```kconfig
# OTBN RSA 密钥生成单核测试（cpu1 安全域，lsqsh_evb@1os/lsqsh/cpu1）
# 被测：zephyr/soc/linkedsemi/lsqsh/otbn/otbn_rsa_keygen.c
#       + 重构后的 mbedtls keygen hook（modules/crypto/mbedtls/library/rsa_alt.c）。

# ---- libc 三件套（全工程统一；缺一构建失败，KNOWN_ISSUES #58） ----
CONFIG_PICOLIBC=y
CONFIG_NEWLIB_LIBC=n
CONFIG_MINIMAL_LIBC=n

# ---- log 输出规范（810 CLAUDE.md §4.1：统一 LOG_INF，deferred buf 模式） ----
CONFIG_LOG=y
CONFIG_LOG_MODE_DEFERRED=y
CONFIG_LOG_BUFFER_SIZE=16384
CONFIG_LOG_PROCESS_THREAD_SLEEP_MS=10
CONFIG_LOG_BACKEND_UART=y
CONFIG_LOG_PRINTK=n

# ---- ztest 原生框架（verbose 逐项输出是 harness 数据源；=n 则逐项全 MISSING） ----
CONFIG_ZTEST=y
CONFIG_ZTEST_ASSERT_VERBOSE=1
CONFIG_ZTEST_VERBOSE_OUTPUT=y
CONFIG_ZTEST_SUMMARY=n
# keygen / CPU 侧 Miller-Rabin 大数运算栈需求
CONFIG_ZTEST_STACK_SIZE=40960
CONFIG_MAIN_STACK_SIZE=8192

# ---- 被测模块：OTBN RSA keygen（otbn_rsa_keygen.c 编入） ----
CONFIG_LS_OTBN_RSA_KEYGEN=y

# ---- mbedtls：keygen hook 路径 + CPU 侧独立复算（bignum） ----
CONFIG_MBEDTLS=y
CONFIG_MBEDTLS_BUILTIN=y
CONFIG_MBEDTLS_ENABLE_HEAP=y
CONFIG_MBEDTLS_HEAP_SIZE=65536
# 走 OTBN keygen hook（select LS_OTBN_RSA_KEYGEN）；
# 关掉它也编不出本路径 ⇒ 本工程用它覆盖 rsa_alt.c 重构。
CONFIG_MBEDTLS_RSA_LINKEDSEMI_OTBN_ALT=y
# CPU 侧 mbedtls_mpi_is_prime_ext（Miller-Rabin）门控
CONFIG_MBEDTLS_GENPRIME_ENABLED=y

CONFIG_DMA=y

# GPIO support for PA05/PA07 toggle threads
CONFIG_GPIO=y
```

## app.overlay
```dts
/*
 * SPDX-License-Identifier: Apache-2.0
 *
 * OTBN RSA 密钥生成单核测试 overlay（片内测试，无外部接线）。
 * 本工程的 keygen 候选源是测试内注入的确定性 RNG（非 TRNG），故不引 entropy、
 * 不使能 trng1；只需 dmac2（OTBN/mbedtls 硬件路径）。
 */

/ {
	chosen {
		zephyr,console = &uart1;   /* 串口输出（ztest token 采集源） */
	};
};

&dmac2 {
	status = "okay";
};

/* GPIO toggle 使能块统一走公共层（SPEC_REFERENCE §6.1.9 复用收敛）：
 * 使能 GPIOA（PA05/PA07 翻转线程所在端口），label 调整只改公共文件。
 * GPIO toggle 仅 cpu1 使用，cpu2 侧固件不编入 gpio_toggle.c、不 include 本片段。 */
#include "../../../common/gpio_toggle.dtsi"
```

## src/main.c
```c
/*
 * SPDX-License-Identifier: Apache-2.0
 *
 * OTBN RSA 密钥生成单核测试入口（cpu1 安全域）。
 * 纯 ztest：test_main 打印角色 banner 后 zt_init + zt_run_all
 * （common/ztest_glue），跑完不返回（同 ztest 语义）。
 */

#include <zephyr/kernel.h>

#include "ztest_glue.h"

void test_main(void)
{
	printk("[CPU1 OTBN_KEYGEN] OTBN RSA keygen test started\n");   /* 角色 banner（harness 依赖） */

	zt_init("TGT");
	zt_run_all();
}
```

## src/bench_small_primes.h
```c
/* AUTO-EXTRACTED from zephyr/soc/linkedsemi/lsqsh/otbn/otbn_rsa_keygen.c
 * (otbn_rsa_small_primes[]). Do not edit by hand.
 * Small primes up to 9973; 2 is omitted because candidates are forced odd. */
#ifndef BENCH_SMALL_PRIMES_H_
#define BENCH_SMALL_PRIMES_H_

#include <stdint.h>

static const uint16_t bench_small_primes[] = {
	3, 5, 7, 11, 13, 17, 19, 23, 29, 31,
	37, 41, 43, 47, 53, 59, 61, 67, 71, 73,
	79, 83, 89, 97, 101, 103, 107, 109, 113, 127,
	131, 137, 139, 149, 151, 157, 163, 167, 173, 179,
	181, 191, 193, 197, 199, 211, 223, 227, 229, 233,
	239, 241, 251, 257, 263, 269, 271, 277, 281, 283,
	293, 307, 311, 313, 317, 331, 337, 347, 349, 353,
	359, 367, 373, 379, 383, 389, 397, 401, 409, 419,
	421, 431, 433, 439, 443, 449, 457, 461, 463, 467,
	479, 487, 491, 499, 503, 509, 521, 523, 541, 547,
	557, 563, 569, 571, 577, 587, 593, 599, 601, 607,
	613, 617, 619, 631, 641, 643, 647, 653, 659, 661,
	673, 677, 683, 691, 701, 709, 719, 727, 733, 739,
	743, 751, 757, 761, 769, 773, 787, 797, 809, 811,
	821, 823, 827, 829, 839, 853, 857, 859, 863, 877,
	881, 883, 887, 907, 911, 919, 929, 937, 941, 947,
	953, 967, 971, 977, 983, 991, 997, 1009, 1013, 1019,
	1021, 1031, 1033, 1039, 1049, 1051, 1061, 1063, 1069, 1087,
	1091, 1093, 1097, 1103, 1109, 1117, 1123, 1129, 1151, 1153,
	1163, 1171, 1181, 1187, 1193, 1201, 1213, 1217, 1223, 1229,
	1231, 1237, 1249, 1259, 1277, 1279, 1283, 1289, 1291, 1297,
	1301, 1303, 1307, 1319, 1321, 1327, 1361, 1367, 1373, 1381,
	1399, 1409, 1423, 1427, 1429, 1433, 1439, 1447, 1451, 1453,
	1459, 1471, 1481, 1483, 1487, 1489, 1493, 1499, 1511, 1523,
	1531, 1543, 1549, 1553, 1559, 1567, 1571, 1579, 1583, 1597,
	1601, 1607, 1609, 1613, 1619, 1621, 1627, 1637, 1657, 1663,
	1667, 1669, 1693, 1697, 1699, 1709, 1721, 1723, 1733, 1741,
	1747, 1753, 1759, 1777, 1783, 1787, 1789, 1801, 1811, 1823,
	1831, 1847, 1861, 1867, 1871, 1873, 1877, 1879, 1889, 1901,
	1907, 1913, 1931, 1933, 1949, 1951, 1973, 1979, 1987, 1993,
	1997, 1999, 2003, 2011, 2017, 2027, 2029, 2039, 2053, 2063,
	2069, 2081, 2083, 2087, 2089, 2099, 2111, 2113, 2129, 2131,
	2137, 2141, 2143, 2153, 2161, 2179, 2203, 2207, 2213, 2221,
	2237, 2239, 2243, 2251, 2267, 2269, 2273, 2281, 2287, 2293,
	2297, 2309, 2311, 2333, 2339, 2341, 2347, 2351, 2357, 2371,
	2377, 2381, 2383, 2389, 2393, 2399, 2411, 2417, 2423, 2437,
	2441, 2447, 2459, 2467, 2473, 2477, 2503, 2521, 2531, 2539,
	2543, 2549, 2551, 2557, 2579, 2591, 2593, 2609, 2617, 2621,
	2633, 2647, 2657, 2659, 2663, 2671, 2677, 2683, 2687, 2689,
	2693, 2699, 2707, 2711, 2713, 2719, 2729, 2731, 2741, 2749,
	2753, 2767, 2777, 2789, 2791, 2797, 2801, 2803, 2819, 2833,
	2837, 2843, 2851, 2857, 2861, 2879, 2887, 2897, 2903, 2909,
	2917, 2927, 2939, 2953, 2957, 2963, 2969, 2971, 2999, 3001,
	3011, 3019, 3023, 3037, 3041, 3049, 3061, 3067, 3079, 3083,
	3089, 3109, 3119, 3121, 3137, 3163, 3167, 3169, 3181, 3187,
	3191, 3203, 3209, 3217, 3221, 3229, 3251, 3253, 3257, 3259,
	3271, 3299, 3301, 3307, 3313, 3319, 3323, 3329, 3331, 3343,
	3347, 3359, 3361, 3371, 3373, 3389, 3391, 3407, 3413, 3433,
	3449, 3457, 3461, 3463, 3467, 3469, 3491, 3499, 3511, 3517,
	3527, 3529, 3533, 3539, 3541, 3547, 3557, 3559, 3571, 3581,
	3583, 3593, 3607, 3613, 3617, 3623, 3631, 3637, 3643, 3659,
	3671, 3673, 3677, 3691, 3697, 3701, 3709, 3719, 3727, 3733,
	3739, 3761, 3767, 3769, 3779, 3793, 3797, 3803, 3821, 3823,
	3833, 3847, 3851, 3853, 3863, 3877, 3881, 3889, 3907, 3911,
	3917, 3919, 3923, 3929, 3931, 3943, 3947, 3967, 3989, 4001,
	4003, 4007, 4013, 4019, 4021, 4027, 4049, 4051, 4057, 4073,
	4079, 4091, 4093, 4099, 4111, 4127, 4129, 4133, 4139, 4153,
	4157, 4159, 4177, 4201, 4211, 4217, 4219, 4229, 4231, 4241,
	4243, 4253, 4259, 4261, 4271, 4273, 4283, 4289, 4297, 4327,
	4337, 4339, 4349, 4357, 4363, 4373, 4391, 4397, 4409, 4421,
	4423, 4441, 4447, 4451, 4457, 4463, 4481, 4483, 4493, 4507,
	4513, 4517, 4519, 4523, 4547, 4549, 4561, 4567, 4583, 4591,
	4597, 4603, 4621, 4637, 4639, 4643, 4649, 4651, 4657, 4663,
	4673, 4679, 4691, 4703, 4721, 4723, 4729, 4733, 4751, 4759,
	4783, 4787, 4789, 4793, 4799, 4801, 4813, 4817, 4831, 4861,
	4871, 4877, 4889, 4903, 4909, 4919, 4931, 4933, 4937, 4943,
	4951, 4957, 4967, 4969, 4973, 4987, 4993, 4999, 5003, 5009,
	5011, 5021, 5023, 5039, 5051, 5059, 5077, 5081, 5087, 5099,
	5101, 5107, 5113, 5119, 5147, 5153, 5167, 5171, 5179, 5189,
	5197, 5209, 5227, 5231, 5233, 5237, 5261, 5273, 5279, 5281,
	5297, 5303, 5309, 5323, 5333, 5347, 5351, 5381, 5387, 5393,
	5399, 5407, 5413, 5417, 5419, 5431, 5437, 5441, 5443, 5449,
	5471, 5477, 5479, 5483, 5501, 5503, 5507, 5519, 5521, 5527,
	5531, 5557, 5563, 5569, 5573, 5581, 5591, 5623, 5639, 5641,
	5647, 5651, 5653, 5657, 5659, 5669, 5683, 5689, 5693, 5701,
	5711, 5717, 5737, 5741, 5743, 5749, 5779, 5783, 5791, 5801,
	5807, 5813, 5821, 5827, 5839, 5843, 5849, 5851, 5857, 5861,
	5867, 5869, 5879, 5881, 5897, 5903, 5923, 5927, 5939, 5953,
	5981, 5987, 6007, 6011, 6029, 6037, 6043, 6047, 6053, 6067,
	6073, 6079, 6089, 6091, 6101, 6113, 6121, 6131, 6133, 6143,
	6151, 6163, 6173, 6197, 6199, 6203, 6211, 6217, 6221, 6229,
	6247, 6257, 6263, 6269, 6271, 6277, 6287, 6299, 6301, 6311,
	6317, 6323, 6329, 6337, 6343, 6353, 6359, 6361, 6367, 6373,
	6379, 6389, 6397, 6421, 6427, 6449, 6451, 6469, 6473, 6481,
	6491, 6521, 6529, 6547, 6551, 6553, 6563, 6569, 6571, 6577,
	6581, 6599, 6607, 6619, 6637, 6653, 6659, 6661, 6673, 6679,
	6689, 6691, 6701, 6703, 6709, 6719, 6733, 6737, 6761, 6763,
	6779, 6781, 6791, 6793, 6803, 6823, 6827, 6829, 6833, 6841,
	6857, 6863, 6869, 6871, 6883, 6899, 6907, 6911, 6917, 6947,
	6949, 6959, 6961, 6967, 6971, 6977, 6983, 6991, 6997, 7001,
	7013, 7019, 7027, 7039, 7043, 7057, 7069, 7079, 7103, 7109,
	7121, 7127, 7129, 7151, 7159, 7177, 7187, 7193, 7207, 7211,
	7213, 7219, 7229, 7237, 7243, 7247, 7253, 7283, 7297, 7307,
	7309, 7321, 7331, 7333, 7349, 7351, 7369, 7393, 7411, 7417,
	7433, 7451, 7457, 7459, 7477, 7481, 7487, 7489, 7499, 7507,
	7517, 7523, 7529, 7537, 7541, 7547, 7549, 7559, 7561, 7573,
	7577, 7583, 7589, 7591, 7603, 7607, 7621, 7639, 7643, 7649,
	7669, 7673, 7681, 7687, 7691, 7699, 7703, 7717, 7723, 7727,
	7741, 7753, 7757, 7759, 7789, 7793, 7817, 7823, 7829, 7841,
	7853, 7867, 7873, 7877, 7879, 7883, 7901, 7907, 7919, 7927,
	7933, 7937, 7949, 7951, 7963, 7993, 8009, 8011, 8017, 8039,
	8053, 8059, 8069, 8081, 8087, 8089, 8093, 8101, 8111, 8117,
	8123, 8147, 8161, 8167, 8171, 8179, 8191, 8209, 8219, 8221,
	8231, 8233, 8237, 8243, 8263, 8269, 8273, 8287, 8291, 8293,
	8297, 8311, 8317, 8329, 8353, 8363, 8369, 8377, 8387, 8389,
	8419, 8423, 8429, 8431, 8443, 8447, 8461, 8467, 8501, 8513,
	8521, 8527, 8537, 8539, 8543, 8563, 8573, 8581, 8597, 8599,
	8609, 8623, 8627, 8629, 8641, 8647, 8663, 8669, 8677, 8681,
	8689, 8693, 8699, 8707, 8713, 8719, 8731, 8737, 8741, 8747,
	8753, 8761, 8779, 8783, 8803, 8807, 8819, 8821, 8831, 8837,
	8839, 8849, 8861, 8863, 8867, 8887, 8893, 8923, 8929, 8933,
	8941, 8951, 8963, 8969, 8971, 8999, 9001, 9007, 9011, 9013,
	9029, 9041, 9043, 9049, 9059, 9067, 9091, 9103, 9109, 9127,
	9133, 9137, 9151, 9157, 9161, 9173, 9181, 9187, 9199, 9203,
	9209, 9221, 9227, 9239, 9241, 9257, 9277, 9281, 9283, 9293,
	9311, 9319, 9323, 9337, 9341, 9343, 9349, 9371, 9377, 9391,
	9397, 9403, 9413, 9419, 9421, 9431, 9433, 9437, 9439, 9461,
	9463, 9467, 9473, 9479, 9491, 9497, 9511, 9521, 9533, 9539,
	9547, 9551, 9587, 9601, 9613, 9619, 9623, 9629, 9631, 9643,
	9649, 9661, 9677, 9679, 9689, 9697, 9719, 9721, 9733, 9739,
	9743, 9749, 9767, 9769, 9781, 9787, 9791, 9803, 9811, 9817,
	9829, 9833, 9839, 9851, 9857, 9859, 9871, 9883, 9887, 9901,
	9907, 9923, 9929, 9931, 9941, 9949, 9967, 9973,
};

#define BENCH_NUM_SMALL_PRIMES (sizeof(bench_small_primes) / sizeof(bench_small_primes[0]))

#endif /* BENCH_SMALL_PRIMES_H_ */
```

## src/otbn_bench.c
```c
/*
 * SPDX-License-Identifier: Apache-2.0
 *
 * On-board measurements for the TPM routing decision.
 *
 *   Goal 1: single-call latency of mbedtls_ls_otbn_rsa_modexp() at 128 B / 192 B
 *           (N = 20 timed calls per width, median / p90 / min / max).
 *           Timed with the 64-bit hardware cycle counter, NOT ztest's own
 *           duration report (which wraps above ~7.158 s).
 *
 *   Goal 2: how many RND / URND words the RSA keygen firmware pulls through
 *           the OTBN EDN handshake during one otbn_rsa_keygen(). The EDN ISR
 *           fills 8 words per request, so words == callback invocations.
 *
 *   Goal 3: with a fixed EDN word stream and a fixed candidate RNG stream, run
 *           keygen twice and compare p/q/n/d byte for byte. Identical output =
 *           the firmware is a pure consumer of the supplied streams (no
 *           internal DRBG feeding the key material).
 *
 * Notes
 *   - The random callbacks are global state; every measurement restores them
 *     with ls_otbn_random_callback_register(NULL, NULL) BEFORE asserting, so a
 *     failed assertion cannot leak the fake source into later OTBN work.
 *   - All buffers are file scope: the ztest thread stack must not carry them.
 */

#include <errno.h>
#include <stdbool.h>
#include <stdint.h>
#include <stdio.h>
#include <string.h>

#include <zephyr/kernel.h>
#include <zephyr/ztest.h>

#include "ztest_glue.h"

#include "otbn_rsa_keygen.h"
#include "ls_otbn_config.h"
#include "mbedtls_otbn_rsa_mbox.h"

#include "modexp_vectors.h"
#include "bench_small_primes.h"

/* ------------------------------------------------------------------ timing */

#define BENCH_SAMPLES   20
#define CYCLES_PER_US   ((uint64_t)CONFIG_SYS_CLOCK_HW_CYCLES_PER_SEC / 1000000ULL)

static uint64_t cycles_to_us(uint64_t cycles)
{
	return (cycles + CYCLES_PER_US / 2) / CYCLES_PER_US;
}

static void sort_u64(uint64_t *v, size_t n)
{
	for (size_t i = 1; i < n; i++) {
		uint64_t x = v[i];
		size_t j = i;

		while (j > 0 && v[j - 1] > x) {
			v[j] = v[j - 1];
			j--;
		}
		v[j] = x;
	}
}

/* ---------------------------------------------------------- shared buffers */

#define BENCH_MAX_BYTES 512
#define BENCH_MAX_PRIME OTBN_RSA_KEYGEN_PRIME_BYTES_MAX

static uint8_t b_in[BENCH_MAX_BYTES] __aligned(4);
static uint8_t b_exp[BENCH_MAX_BYTES] __aligned(4);
static uint8_t b_n[BENCH_MAX_BYTES] __aligned(4);
static uint8_t b_out[BENCH_MAX_BYTES] __aligned(4);

static uint8_t b_p[BENCH_MAX_PRIME] __aligned(4);
static uint8_t b_q[BENCH_MAX_PRIME] __aligned(4);
static uint8_t b_mod[2 * BENCH_MAX_PRIME] __aligned(4);
static uint8_t b_d[2 * BENCH_MAX_PRIME] __aligned(4);

static uint8_t b_p2[BENCH_MAX_PRIME] __aligned(4);
static uint8_t b_q2[BENCH_MAX_PRIME] __aligned(4);
static uint8_t b_mod2[2 * BENCH_MAX_PRIME] __aligned(4);
static uint8_t b_d2[2 * BENCH_MAX_PRIME] __aligned(4);

/* ================================ Goal 1 ================================= */

static void bench_modexp_width(const char *tag, const modexp_vec_t *vec)
{
	uint64_t samples[BENCH_SAMPLES];
	char list[256];
	size_t len = vec->num_bytes;
	size_t pos = 0;
	int err = 0;
	int ret;

	zassert_true(len <= BENCH_MAX_BYTES, "vector too wide: %u", (unsigned)len);

	memcpy(b_in, vec->base, len);
	memcpy(b_exp, vec->exp, len);
	memcpy(b_n, vec->n, len);
	memset(b_out, 0, sizeof(b_out));

	/* Warm-up: the first call may load the MODEXP image into IMEM. The
	 * measurement below must see the steady-state cost only. */
	ret = mbedtls_ls_otbn_rsa_modexp(b_in, b_out, b_exp, b_n, len, true);
	zassert_equal(ret, 0, "warm-up modexp(%u B) ret=%d", (unsigned)len, ret);

	for (size_t i = 0; i < BENCH_SAMPLES; i++) {
		uint64_t t0, t1;

		memcpy(b_in, vec->base, len);
		memcpy(b_exp, vec->exp, len);
		memcpy(b_n, vec->n, len);
		memset(b_out, 0xA5, sizeof(b_out));   /* reset output each call */

		t0 = k_cycle_get_64();
		ret = mbedtls_ls_otbn_rsa_modexp(b_in, b_out, b_exp, b_n, len, true);
		t1 = k_cycle_get_64();

		if (ret != 0) {
			err++;
		}
		samples[i] = cycles_to_us(t1 - t0);
	}

	/* Keep the per-sample list so the numbers can be re-derived from the
	 * serial archive alone. */
	for (size_t i = 0; i < BENCH_SAMPLES; i++) {
		int n = snprintf(list + pos, sizeof(list) - pos, "%s%llu",
				 i ? "," : "", (unsigned long long)samples[i]);

		if (n < 0 || (size_t)n >= sizeof(list) - pos) {
			break;
		}
		pos += (size_t)n;
	}

	sort_u64(samples, BENCH_SAMPLES);
	uint64_t sum = 0;

	for (size_t i = 0; i < BENCH_SAMPLES; i++) {
		sum += samples[i];
	}

	/* Nearest-rank p90: ceil(0.9*N)-th smallest (1-based) => index 17 of 20. */
	size_t p90_idx = (BENCH_SAMPLES * 9 + 9) / 10 - 1;
	uint64_t median = (samples[BENCH_SAMPLES / 2 - 1] +
			   samples[BENCH_SAMPLES / 2] + 1) / 2;
	int byte_equal = 0;

	if (err == 0) {
		byte_equal = (memcmp(b_out, vec->out, len) == 0);
	}

	ZT_INFO(tag,
		"num_bytes=%u,samples=%d,median_us=%llu,p90_us=%llu,"
		"min_us=%llu,max_us=%llu,mean_us=%llu,byte_equal=%d,err=%d,us_list=%s",
		(unsigned)len, BENCH_SAMPLES,
		(unsigned long long)median, (unsigned long long)samples[p90_idx],
		(unsigned long long)samples[0],
		(unsigned long long)samples[BENCH_SAMPLES - 1],
		(unsigned long long)(sum / BENCH_SAMPLES),
		byte_equal, err, list);
}

ZTEST(keygen, zzz_bench_modexp_128b)
{
	bench_modexp_width("zzz_bench_modexp_128b", &modexp_vectors[0]);
}

ZTEST(keygen, zzz_bench_modexp_192b)
{
	bench_modexp_width("zzz_bench_modexp_192b", &modexp_vectors[1]);
}

/* ============================ deterministic RNG ========================== */

typedef struct {
	uint64_t state;
} bench_rng_t;

static uint64_t splitmix64(uint64_t *state)
{
	uint64_t z = (*state += 0x9E3779B97F4A7C15ULL);

	z = (z ^ (z >> 30)) * 0xBF58476D1CE4E5B9ULL;
	z = (z ^ (z >> 27)) * 0x94D049BB133111EBULL;
	return z ^ (z >> 31);
}

static int bench_rng(void *ctx, uint8_t *buf, size_t len)
{
	bench_rng_t *r = (bench_rng_t *)ctx;
	uint64_t cur = 0;

	for (size_t i = 0; i < len; i++) {
		if ((i & 7) == 0) {
			cur = splitmix64(&r->state);
		}
		buf[i] = (uint8_t)(cur >> ((i & 7) * 8));
	}
	return 0;
}

/* Mirror otbn_rsa_has_small_factor() from the module under test. Kept local
 * because that helper is static; the table is the same generated copy. */
static bool has_small_factor(const uint8_t *candidate_le, size_t prime_bytes)
{
	for (size_t idx = 0; idx < BENCH_NUM_SMALL_PRIMES; idx++) {
		uint32_t divisor = bench_small_primes[idx];
		uint32_t rem = 0;

		for (int i = (int)(prime_bytes - 1); i >= 0; i--) {
			rem = ((rem << 8) | candidate_le[i]) % divisor;
		}
		if (rem == 0) {
			return true;
		}
	}
	return false;
}

static void req_init(otbn_rsa_keygen_req_t *req, otbn_rsa_rng_cb rng, void *ctx,
		     uint8_t *p, uint8_t *q, uint8_t *n, uint8_t *d)
{
	req->size = OTBN_RSA_KEYGEN_2048;
	req->rng = rng;
	req->rng_ctx = ctx;
	req->p_le = p;
	req->q_le = q;
	req->n_le = n;
	req->d_le = d;
}

/* ================================ Goal 2 ================================= */

static volatile uint32_t g_rnd_calls;
static volatile uint32_t g_urnd_calls;
static uint64_t g_edn_state;

static uint32_t counting_rnd_cb(void)
{
	g_rnd_calls++;
	return (uint32_t)splitmix64(&g_edn_state);
}

static uint32_t counting_urnd_cb(void)
{
	g_urnd_calls++;
	return (uint32_t)splitmix64(&g_edn_state);
}

static uint32_t g_cand_calls;
static uint32_t g_sieve_pass;

static int counting_candidate_rng(void *ctx, uint8_t *buf, size_t len)
{
	uint8_t tmp[BENCH_MAX_PRIME];
	int ret = bench_rng(ctx, buf, len);

	if (ret != 0 || len > sizeof(tmp)) {
		return ret;
	}

	g_cand_calls++;

	/* Apply the same two fixups otbn_rsa_gen_candidate() applies after the
	 * callback returns, so the local verdict matches what CHECK_PRIME sees. */
	memcpy(tmp, buf, len);
	tmp[0] |= 0x03U;
	tmp[len - 1] |= 0xC0U;
	if (!has_small_factor(tmp, len)) {
		g_sieve_pass++;
	}
	return 0;
}

ZTEST(keygen, zzz_bench_random_counts)
{
	bench_rng_t rng = { .state = 0x0123456789ABCDEFULL };
	otbn_rsa_keygen_req_t req;
	int64_t t0, t1;
	int ret;

	g_rnd_calls = 0;
	g_urnd_calls = 0;
	g_edn_state = 0xDEADBEEFCAFEF00DULL;
	g_cand_calls = 0;
	g_sieve_pass = 0;

	req_init(&req, counting_candidate_rng, &rng, b_p, b_q, b_mod, b_d);

	ls_otbn_random_callback_register(counting_rnd_cb, counting_urnd_cb);
	t0 = k_uptime_get();
	ret = otbn_rsa_keygen(&req);
	t1 = k_uptime_get();
	/* Restore the built-in source before anything else (global state). */
	ls_otbn_random_callback_register(NULL, NULL);

	/* Runtime proof that the restore took effect: CHECK_PRIME is an EDN
	 * consumer (that is what the counters above measure). Run one after the
	 * restore; the counting callbacks must NOT fire again. */
	uint32_t rnd_after = g_rnd_calls;
	uint32_t urnd_after = g_urnd_calls;
	bool post_prime = false;
	int post_ret = otbn_rsa_check_prime(OTBN_RSA_KEYGEN_2048, b_p, &post_prime);

	ZT_INFO("zzz_bench_random_counts",
		"keygen_ret=%d,keygen_ms=%lld,rnd_cb_calls=%u,urnd_cb_calls=%u,"
		"rnd_words=%u,urnd_words=%u,rnd_isr_requests=%u,urnd_isr_requests=%u,"
		"candidates=%u,sieve_pass=%u,post_restore_check_prime_ret=%d,"
		"post_restore_prime=%d,post_rnd_delta=%u,post_urnd_delta=%u",
		ret, (long long)(t1 - t0),
		(unsigned)g_rnd_calls, (unsigned)g_urnd_calls,
		(unsigned)g_rnd_calls, (unsigned)g_urnd_calls,
		(unsigned)(g_rnd_calls / 8), (unsigned)(g_urnd_calls / 8),
		(unsigned)g_cand_calls, (unsigned)g_sieve_pass,
		post_ret, post_prime ? 1 : 0,
		(unsigned)(g_rnd_calls - rnd_after),
		(unsigned)(g_urnd_calls - urnd_after));

	zassert_equal(ret, 0, "keygen ret=%d", ret);
	zassert_true(g_cand_calls >= 2, "candidate RNG called %u times", g_cand_calls);
	zassert_equal(post_ret, 0, "post-restore check_prime ret=%d", post_ret);
	zassert_true(post_prime, "generated prime rejected after restore");
	zassert_equal(g_rnd_calls, rnd_after,
		      "RND counting callback still registered after restore");
	zassert_equal(g_urnd_calls, urnd_after,
		      "URND counting callback still registered after restore");
}

/* ================================ Goal 3 ================================= */

static uint64_t g_fixed_edn;
static uint32_t g_fixed_rnd_calls;
static uint32_t g_fixed_urnd_calls;

static uint32_t fixed_rnd_cb(void)
{
	g_fixed_rnd_calls++;
	return (uint32_t)splitmix64(&g_fixed_edn);
}

static uint32_t fixed_urnd_cb(void)
{
	g_fixed_urnd_calls++;
	return (uint32_t)splitmix64(&g_fixed_edn);
}

/* Run one keygen with reset stream states and copy out p/q/n/d. */
static int fixed_stream_keygen(uint64_t cand_seed, uint64_t edn_seed,
			       uint8_t *p, uint8_t *q, uint8_t *n, uint8_t *d,
			       uint32_t *rnd_calls, uint32_t *urnd_calls)
{
	bench_rng_t cand = { .state = cand_seed };
	otbn_rsa_keygen_req_t req;
	int ret;

	g_fixed_edn = edn_seed;
	g_fixed_rnd_calls = 0;
	g_fixed_urnd_calls = 0;

	req_init(&req, bench_rng, &cand, p, q, n, d);

	ls_otbn_random_callback_register(fixed_rnd_cb, fixed_urnd_cb);
	ret = otbn_rsa_keygen(&req);
	ls_otbn_random_callback_register(NULL, NULL);

	*rnd_calls = g_fixed_rnd_calls;
	*urnd_calls = g_fixed_urnd_calls;
	return ret;
}

static bool key_diffs(const uint8_t *p, const uint8_t *q, const uint8_t *n,
		      const uint8_t *d)
{
	return (memcmp(b_p, p, 128) != 0) || (memcmp(b_q, q, 128) != 0) ||
	       (memcmp(b_mod, n, 256) != 0) || (memcmp(b_d, d, 256) != 0);
}

ZTEST(keygen, zzz_bench_no_internal_drbg)
{
	const uint64_t cand_seed = 0x0BADF00D12345678ULL;
	const uint64_t edn_seed = 0x0000000011112222ULL;
	uint32_t rnd1, urnd1, rnd2, urnd2, rnd3, urnd3;
	int ret1, ret2, ret_ctrl, ret_edn;
	int same_p, same_q, same_n, same_d;
	int ctrl_diff, edn_diff;

	/* Run 1 and run 2: identical candidate stream and identical EDN stream. */
	ret1 = fixed_stream_keygen(cand_seed, edn_seed, b_p, b_q, b_mod, b_d,
				   &rnd1, &urnd1);
	ret2 = fixed_stream_keygen(cand_seed, edn_seed, b_p2, b_q2, b_mod2, b_d2,
				   &rnd2, &urnd2);
	same_p = (memcmp(b_p, b_p2, 128) == 0);
	same_q = (memcmp(b_q, b_q2, 128) == 0);
	same_n = (memcmp(b_mod, b_mod2, 256) == 0);
	same_d = (memcmp(b_d, b_d2, 256) == 0);

	/* Positive control: a different candidate seed must produce a different
	 * key, otherwise the byte comparison above would be vacuous. */
	ret_ctrl = fixed_stream_keygen(cand_seed ^ 0xFFFFFFFFFFFFFFFFULL, edn_seed,
				       b_p2, b_q2, b_mod2, b_d2, &rnd3, &urnd3);
	ctrl_diff = key_diffs(b_p2, b_q2, b_mod2, b_d2);

	/* Different EDN words, same candidate stream: shows whether the EDN
	 * stream participates in the key material at all. */
	ret_edn = fixed_stream_keygen(cand_seed, edn_seed ^ 0xA5A5A5A5A5A5A5A5ULL,
				      b_p2, b_q2, b_mod2, b_d2, &rnd3, &urnd3);
	edn_diff = key_diffs(b_p2, b_q2, b_mod2, b_d2);

	ZT_INFO("zzz_bench_no_internal_drbg",
		"ret=%d/%d/ctrl=%d,edn=%d,same_p=%d,same_q=%d,same_n=%d,same_d=%d,"
		"rnd_calls=%u/%u,urnd_calls=%u/%u,ctrl_diff=%d,edn_diff=%d",
		ret1, ret2, ret_ctrl, ret_edn,
		same_p, same_q, same_n, same_d,
		(unsigned)rnd1, (unsigned)rnd2,
		(unsigned)urnd1, (unsigned)urnd2,
		ctrl_diff, edn_diff);

	zassert_equal(ret1, 0, "run1 ret=%d", ret1);
	zassert_equal(ret2, 0, "run2 ret=%d", ret2);
	zassert_equal(ret_ctrl, 0, "control ret=%d", ret_ctrl);
	zassert_equal(ret_edn, 0, "edn-variant ret=%d", ret_edn);
	/* Same input streams => byte-identical key material. */
	zassert_true(same_p && same_q && same_n && same_d,
		     "identical streams produced different keys "
		     "(p=%d q=%d n=%d d=%d)", same_p, same_q, same_n, same_d);
	/* The comparison must be able to tell keys apart at all. */
	zassert_true(ctrl_diff, "different candidate seed produced the same key");
}
```

## src/otbn_keygen_test.c
```c
/*
 * SPDX-License-Identifier: Apache-2.0
 *
 * OTBN RSA 密钥生成测试套件。
 *
 * 被测：zephyr/soc/linkedsemi/lsqsh/otbn/otbn_rsa_keygen.c
 *   otbn_rsa_keygen() / otbn_rsa_check_prime() / otbn_rsa_key_from_pq() /
 *   otbn_rsa_gen_candidate() / otbn_rsa_modulus_bytes() / otbn_rsa_prime_bytes()
 * 并覆盖重构后的 mbedtls keygen hook：
 *   modules/crypto/mbedtls/library/rsa_alt.c::mbedtls_rsa_gen_key_otbn()，
 *   经 mbedtls_rsa_gen_key()（CONFIG_MBEDTLS_RSA_LINKEDSEMI_OTBN_ALT=y）。
 *
 * 判据独立性：密钥正确性一律由 CPU 侧 mbedtls bignum 独立复算
 * （n==p*q、p/q 素性用 CPU Miller-Rabin、e*d≡1 mod lcm），不依赖被测模块的
 * 返回值；"OTBN 真的被用到"由 ls_otbn_imem_firmware_get()==KEYGEN 断言（非软件回落）。
 *
 * 两条硬约束（被测模块 API）：
 *   ① 所有输入/输出缓冲必须 4 字节对齐（否则 -EINVAL）—— 由 aligned_* 用例覆盖；
 *   ② 候选值被强制 ≡ 3 (mod 4)（gen_candidate 内部 |= 0x03）⇒ p、q ≡ 3 (mod 4)。
 */

#include <string.h>
#include <stdio.h>
#include <errno.h>

#include <zephyr/kernel.h>
#include <zephyr/ztest.h>

#include "ztest_glue.h"

#include "otbn_rsa_keygen.h"
#include "ls_otbn_config.h"   /* ls_otbn_imem_firmware_get / OTBN_FIRMWARE_RSA_KEYGEN */

#include <mbedtls/bignum.h>
#include <mbedtls/rsa.h>

#include "ref_vector.h"       /* 客户 TPM 参考向量 KAT（tests/expected/ref_vector.h） */

/* 最大缓冲（4096 位：模数 512B / 素数 256B），文件级 static：不占 ztest 线程栈。 */
#define MAX_MOD  OTBN_RSA_KEYGEN_MODULUS_BYTES_MAX   /* 512 */
#define MAX_PRI  OTBN_RSA_KEYGEN_PRIME_BYTES_MAX     /* 256 */

static uint8_t g_p[MAX_PRI]  __aligned(4);
static uint8_t g_q[MAX_PRI]  __aligned(4);
static uint8_t g_n[MAX_MOD]  __aligned(4);
static uint8_t g_d[MAX_MOD]  __aligned(4);
static uint8_t g_n2[MAX_MOD] __aligned(4);
static uint8_t g_d2[MAX_MOD] __aligned(4);

ZTEST_SUITE(keygen, NULL, NULL, NULL, NULL, NULL);

/* ============================ 确定性 RNG ============================
 * 固定 seed 的 splitmix64 流：同一个 seed 复位后逐字节复现，用来验证
 * "固定 RNG 流 ⇒ 逐位相同的密钥对"（本模块存在的理由）。 */
typedef struct {
	uint64_t state;
} det_rng_t;

static void det_rng_reset(det_rng_t *r, uint64_t seed)
{
	r->state = seed;
}

static uint64_t det_rng_u64(det_rng_t *r)
{
	uint64_t z = (r->state += 0x9E3779B97F4A7C15ULL);

	z = (z ^ (z >> 30)) * 0xBF58476D1CE4E5B9ULL;
	z = (z ^ (z >> 27)) * 0x94D049BB133111EBULL;
	return z ^ (z >> 31);
}

static int det_rng(void *ctx, uint8_t *buf, size_t len)
{
	det_rng_t *r = (det_rng_t *)ctx;
	uint64_t cur = 0;

	for (size_t i = 0; i < len; i++) {
		if ((i & 7) == 0) {
			cur = det_rng_u64(r);
		}
		buf[i] = (uint8_t)(cur >> ((i & 7) * 8));
	}
	return 0;
}

/* 供 CPU 侧 Miller-Rabin 用的 RNG（内容不要求确定，只要合法非 NULL）。 */
static det_rng_t g_prime_rng;

/* ============================ 错误路径 RNG ============================ */
static int err_rng_eio(void *ctx, uint8_t *buf, size_t len)
{
	(void)ctx;
	(void)buf;
	(void)len;
	return -EIO;
}

static int err_rng_eperm(void *ctx, uint8_t *buf, size_t len)
{
	(void)ctx;
	(void)buf;
	(void)len;
	return -EPERM;
}

/* ============================ 请求构造 ============================ */
static void req_init(otbn_rsa_keygen_req_t *req, otbn_rsa_keygen_size_t size,
		     otbn_rsa_rng_cb rng, void *ctx)
{
	req->size = size;
	req->rng = rng;
	req->rng_ctx = ctx;
	req->p_le = g_p;
	req->q_le = g_q;
	req->n_le = g_n;
	req->d_le = g_d;
}

/* CPU 侧独立复算：n==p*q、p/q 素性（Miller-Rabin）、e*d≡1 mod lcm。
 * 期望来源：RSA 数学定义（③级推断），但复算完全独立于被测模块。 */
static void check_key_consistency(otbn_rsa_keygen_size_t size)
{
	uint32_t pb = otbn_rsa_prime_bytes(size);
	uint32_t mb = otbn_rsa_modulus_bytes(size);
	mbedtls_mpi P, Q, N, D, E, T, P1, Q1, G, L, T2;
	int rc;

	/* p、q ≡ 3 (mod 4)：LE 低字节低 2 位（gen_candidate 的 |= 0x03 约束） */
	zassert_equal(g_p[0] & 0x03, 0x03, "p %% 4 != 3 (low byte 0x%02x)", g_p[0]);
	zassert_equal(g_q[0] & 0x03, 0x03, "q %% 4 != 3 (low byte 0x%02x)", g_q[0]);

	mbedtls_mpi_init(&P);
	mbedtls_mpi_init(&Q);
	mbedtls_mpi_init(&N);
	mbedtls_mpi_init(&D);
	mbedtls_mpi_init(&E);
	mbedtls_mpi_init(&T);
	mbedtls_mpi_init(&P1);
	mbedtls_mpi_init(&Q1);
	mbedtls_mpi_init(&G);
	mbedtls_mpi_init(&L);
	mbedtls_mpi_init(&T2);

	rc = mbedtls_mpi_read_binary_le(&P, g_p, pb);
	rc |= mbedtls_mpi_read_binary_le(&Q, g_q, pb);
	rc |= mbedtls_mpi_read_binary_le(&N, g_n, mb);
	rc |= mbedtls_mpi_read_binary_le(&D, g_d, mb);
	zassert_equal(rc, 0, "mpi read failed rc=%d", rc);

	/* n == p*q */
	rc = mbedtls_mpi_mul_mpi(&T, &P, &Q);
	zassert_equal(rc, 0, "mul rc=%d", rc);
	zassert_equal(mbedtls_mpi_cmp_mpi(&T, &N), 0, "n != p*q");

	/* 素性：CPU 侧 Miller-Rabin（16 轮 ⇒ 误判概率 ≤ 2^-32） */
	det_rng_reset(&g_prime_rng, 0x0102030405060708ULL);
	zassert_equal(mbedtls_mpi_is_prime_ext(&P, 16, det_rng, &g_prime_rng), 0,
		      "p 被判为合数（CPU Miller-Rabin）");
	zassert_equal(mbedtls_mpi_is_prime_ext(&Q, 16, det_rng, &g_prime_rng), 0,
		      "q 被判为合数（CPU Miller-Rabin）");

	/* e*d ≡ 1 (mod lcm(p-1, q-1)) */
	rc = mbedtls_mpi_lset(&E, OTBN_RSA_KEYGEN_EXPONENT);
	rc |= mbedtls_mpi_sub_int(&P1, &P, 1);
	rc |= mbedtls_mpi_sub_int(&Q1, &Q, 1);
	rc |= mbedtls_mpi_gcd(&G, &P1, &Q1);
	rc |= mbedtls_mpi_mul_mpi(&L, &P1, &Q1);
	zassert_equal(rc, 0, "lcm prep rc=%d", rc);
	rc = mbedtls_mpi_div_mpi(&T2, NULL, &L, &G);       /* T2 = lcm */
	zassert_equal(rc, 0, "lcm div rc=%d", rc);
	rc = mbedtls_mpi_mul_mpi(&T, &E, &D);
	rc |= mbedtls_mpi_mod_mpi(&T, &T, &T2);
	zassert_equal(rc, 0, "e*d mod rc=%d", rc);
	zassert_equal(mbedtls_mpi_cmp_int(&T, 1), 0, "e*d mod lcm != 1");

	mbedtls_mpi_free(&P);
	mbedtls_mpi_free(&Q);
	mbedtls_mpi_free(&N);
	mbedtls_mpi_free(&D);
	mbedtls_mpi_free(&E);
	mbedtls_mpi_free(&T);
	mbedtls_mpi_free(&P1);
	mbedtls_mpi_free(&Q1);
	mbedtls_mpi_free(&G);
	mbedtls_mpi_free(&L);
	mbedtls_mpi_free(&T2);
}

/* 便捷：跑一次 keygen（det RNG，固定 seed 由调用方复位）并断言成功。 */
static int keygen_2048(det_rng_t *rng, uint64_t seed)
{
	otbn_rsa_keygen_req_t req;

	det_rng_reset(rng, seed);
	req_init(&req, OTBN_RSA_KEYGEN_2048, det_rng, rng);
	return otbn_rsa_keygen(&req);
}

/* ================================ 用例 ================================ */

/* 尺寸换算 + 候选生成约束（3 mod 4 / 最高两位置位）+ 生成器自身的确定性。 */
ZTEST(keygen, candidate_residue_and_topbits)
{
	det_rng_t rng;
	uint32_t pb = otbn_rsa_prime_bytes(OTBN_RSA_KEYGEN_2048);
	int ret;

	zassert_equal(otbn_rsa_modulus_bytes(OTBN_RSA_KEYGEN_2048), 256, "2048 mod bytes");
	zassert_equal(otbn_rsa_modulus_bytes(OTBN_RSA_KEYGEN_3072), 384, "3072 mod bytes");
	zassert_equal(otbn_rsa_modulus_bytes(OTBN_RSA_KEYGEN_4096), 512, "4096 mod bytes");
	zassert_equal(otbn_rsa_prime_bytes(OTBN_RSA_KEYGEN_2048), 128, "2048 prime bytes");
	zassert_equal(otbn_rsa_prime_bytes(OTBN_RSA_KEYGEN_3072), 192, "3072 prime bytes");
	zassert_equal(otbn_rsa_prime_bytes(OTBN_RSA_KEYGEN_4096), 256, "4096 prime bytes");
	zassert_equal(otbn_rsa_modulus_bytes((otbn_rsa_keygen_size_t)99), 0,
		      "invalid size modulus_bytes != 0");
	zassert_equal(otbn_rsa_prime_bytes((otbn_rsa_keygen_size_t)99), 0,
		      "invalid size prime_bytes != 0");

	det_rng_reset(&rng, 0x1122334455667788ULL);
	ret = otbn_rsa_gen_candidate(OTBN_RSA_KEYGEN_2048, det_rng, &rng, g_p);
	zassert_equal(ret, 0, "gen_candidate ret=%d", ret);

	zassert_equal(g_p[0] & 0x03, 0x03,
		      "candidate 非奇数/非 3 mod 4: low=0x%02x", g_p[0]);
	zassert_equal(g_p[pb - 1] & 0xC0, 0xC0,
		      "candidate 最高两 bit 未置位: 0x%02x", g_p[pb - 1]);

	/* 同 seed 复位 ⇒ 逐字节相同的候选（确定性基础） */
	memcpy(g_n, g_p, pb);
	det_rng_reset(&rng, 0x1122334455667788ULL);
	ret = otbn_rsa_gen_candidate(OTBN_RSA_KEYGEN_2048, det_rng, &rng, g_q);
	zassert_equal(ret, 0, "gen_candidate#2 ret=%d", ret);
	zassert_mem_equal(g_q, g_n, pb, "gen_candidate 非确定性");
}

/* 直调 API：check_prime（真素数 → true / 大合数 → false）与 key_from_pq（复算一致）。
 * 用 1 次 keygen 取到真素数 p、q，再喂给两个 helper。 */
ZTEST(keygen, direct_apis_ok)
{
	det_rng_t rng;
	otbn_rsa_keygen_req_t req;
	static uint8_t comp[MAX_PRI] __aligned(4);
	bool pp = false;
	int ret;

	det_rng_reset(&rng, 0xDEADBEEFCAFEF00DULL);
	req_init(&req, OTBN_RSA_KEYGEN_2048, det_rng, &rng);
	ret = otbn_rsa_keygen(&req);
	zassert_equal(ret, 0, "keygen ret=%d", ret);
	if (ret != 0) {
		return;
	}

	/* 集成证据：IMEM 已切到 KEYGEN 固件（紧跟 keygen 读取；任何后续
	 * hash/ECC/modexp 操作都会改写该共享状态）⇒ 证明未走软件回落。 */
	zassert_equal((unsigned)ls_otbn_imem_firmware_get(),
		      (unsigned)OTBN_FIRMWARE_RSA_KEYGEN,
		      "IMEM firmware=%u != RSA_KEYGEN(%u)",
		      (unsigned)ls_otbn_imem_firmware_get(),
		      (unsigned)OTBN_FIRMWARE_RSA_KEYGEN);

	/* check_prime(生成的素数 p) → probably_prime == true */
	ret = otbn_rsa_check_prime(OTBN_RSA_KEYGEN_2048, g_p, &pp);
	zassert_equal(ret, 0, "check_prime(p) ret=%d", ret);
	zassert_true(pp, "生成的 p 被判合数");

	/* check_prime(全 1 大合数，≡3 mod 4: 2^1024-1 = (2^512-1)(2^512+1)) → false */
	memset(comp, 0xFF, sizeof(comp));
	pp = true;
	ret = otbn_rsa_check_prime(OTBN_RSA_KEYGEN_2048, comp, &pp);
	zassert_equal(ret, 0, "check_prime(2^1024-1) ret=%d", ret);
	zassert_false(pp, "2^1024-1 被判素数");

	/* key_from_pq 复算：与 keygen 输出逐字节一致（纯函数） */
	ret = otbn_rsa_key_from_pq(OTBN_RSA_KEYGEN_2048, g_p, g_q, g_n2, g_d2);
	zassert_equal(ret, 0, "key_from_pq ret=%d", ret);
	zassert_mem_equal(g_n2, g_n, 256, "key_from_pq n 与 keygen 不一致");
	zassert_mem_equal(g_d2, g_d, 256, "key_from_pq d 与 keygen 不一致");
}

/* mbedtls 路径：mbedtls_rsa_gen_key() 走 OTBN hook 成功 + check_privkey 通过。 */
ZTEST(keygen, mbedtls_gen_key_ok)
{
	mbedtls_rsa_context rsa;
	det_rng_t rng;
	int ret;

	det_rng_reset(&rng, 0x0FEDCBA987654321ULL);
	mbedtls_rsa_init(&rsa);
	ret = mbedtls_rsa_gen_key(&rsa, det_rng, &rng, 2048, 65537);
	ZT_INFO("mbedtls_gen_key_ok", "api=mbedtls_rsa_gen_key,keylen=2048,ret=%d", ret);
	zassert_equal(ret, 0, "mbedtls_rsa_gen_key ret=%d", ret);
	if (ret == 0) {
		ret = mbedtls_rsa_check_privkey(&rsa);
		zassert_equal(ret, 0, "mbedtls_rsa_check_privkey ret=%d", ret);
	}
	mbedtls_rsa_free(&rsa);
}

/* 2048：生成成功 + 全量正确性（n=p*q / 素性 / 3 mod 4 / e*d≡1 mod lcm）。 */
ZTEST(keygen, rsa_2048_correctness)
{
	det_rng_t rng;
	int ret = keygen_2048(&rng, 0xA5A5A5A5A5A5A5A5ULL);

	zassert_equal(ret, 0, "2048 keygen ret=%d", ret);
	if (ret != 0) {
		return;
	}
	check_key_consistency(OTBN_RSA_KEYGEN_2048);
}

/* ★ 确定性：同一固定 RNG 流跑两次，p/q/n/d 逐位相同。 */
ZTEST(keygen, rsa_2048_deterministic)
{
	det_rng_t rng;
	otbn_rsa_keygen_req_t req;
	static uint8_t p1[MAX_PRI], q1[MAX_PRI], n1[MAX_MOD], d1[MAX_MOD];
	int ret;

	/* 第 1 次 */
	det_rng_reset(&rng, 0x5A5A5A5A01234567ULL);
	req_init(&req, OTBN_RSA_KEYGEN_2048, det_rng, &rng);
	ret = otbn_rsa_keygen(&req);
	zassert_equal(ret, 0, "keygen#1 ret=%d", ret);
	if (ret != 0) {
		return;
	}
	memcpy(p1, g_p, 128);
	memcpy(q1, g_q, 128);
	memcpy(n1, g_n, 256);
	memcpy(d1, g_d, 256);

	/* 第 2 次：同 seed 复位 ⇒ 必须逐位相同 */
	det_rng_reset(&rng, 0x5A5A5A5A01234567ULL);
	req_init(&req, OTBN_RSA_KEYGEN_2048, det_rng, &rng);
	ret = otbn_rsa_keygen(&req);
	zassert_equal(ret, 0, "keygen#2 ret=%d", ret);
	if (ret != 0) {
		return;
	}
	zassert_mem_equal(g_p, p1, 128, "p 不确定（同 RNG 流两次不同）");
	zassert_mem_equal(g_q, q1, 128, "q 不确定");
	zassert_mem_equal(g_n, n1, 256, "n 不确定");
	zassert_mem_equal(g_d, d1, 256, "d 不确定");
}

/* 3072：生成成功 + n=p*q + 3 mod 4。 */
ZTEST(keygen, rsa_3072_ok)
{
	det_rng_t rng;
	otbn_rsa_keygen_req_t req;
	mbedtls_mpi P, Q, N, T;
	int ret;

	det_rng_reset(&rng, 0x13579BDF2468ACE0ULL);
	req_init(&req, OTBN_RSA_KEYGEN_3072, det_rng, &rng);
	ret = otbn_rsa_keygen(&req);
	zassert_equal(ret, 0, "3072 keygen ret=%d", ret);
	if (ret != 0) {
		return;
	}
	zassert_equal(g_p[0] & 0x03, 0x03, "3072 p %% 4 != 3");
	zassert_equal(g_q[0] & 0x03, 0x03, "3072 q %% 4 != 3");

	mbedtls_mpi_init(&P);
	mbedtls_mpi_init(&Q);
	mbedtls_mpi_init(&N);
	mbedtls_mpi_init(&T);
	mbedtls_mpi_read_binary_le(&P, g_p, 192);
	mbedtls_mpi_read_binary_le(&Q, g_q, 192);
	mbedtls_mpi_read_binary_le(&N, g_n, 384);
	mbedtls_mpi_mul_mpi(&T, &P, &Q);
	zassert_equal(mbedtls_mpi_cmp_mpi(&T, &N), 0, "3072 n != p*q");
	mbedtls_mpi_free(&P);
	mbedtls_mpi_free(&Q);
	mbedtls_mpi_free(&N);
	mbedtls_mpi_free(&T);
}

/* 4096：生成成功 + n=p*q（慢；采集窗口/卡死阈值已按此放宽）。 */
ZTEST(keygen, rsa_4096_ok)
{
	det_rng_t rng;
	otbn_rsa_keygen_req_t req;
	mbedtls_mpi P, Q, N, T;
	int ret;

	det_rng_reset(&rng, 0x2468ACE013579BDFULL);
	req_init(&req, OTBN_RSA_KEYGEN_4096, det_rng, &rng);
	ret = otbn_rsa_keygen(&req);
	zassert_equal(ret, 0, "4096 keygen ret=%d", ret);
	if (ret != 0) {
		return;
	}
	zassert_equal(g_p[0] & 0x03, 0x03, "4096 p %% 4 != 3");
	zassert_equal(g_q[0] & 0x03, 0x03, "4096 q %% 4 != 3");

	mbedtls_mpi_init(&P);
	mbedtls_mpi_init(&Q);
	mbedtls_mpi_init(&N);
	mbedtls_mpi_init(&T);
	mbedtls_mpi_read_binary_le(&P, g_p, 256);
	mbedtls_mpi_read_binary_le(&Q, g_q, 256);
	mbedtls_mpi_read_binary_le(&N, g_n, 512);
	mbedtls_mpi_mul_mpi(&T, &P, &Q);
	zassert_equal(mbedtls_mpi_cmp_mpi(&T, &N), 0, "4096 n != p*q");
	mbedtls_mpi_free(&P);
	mbedtls_mpi_free(&Q);
	mbedtls_mpi_free(&N);
	mbedtls_mpi_free(&T);
}

/* 错误路径：rng 回调返回的错误码必须原样上抛（不吞、不换成别的码）。 */
ZTEST(keygen, rng_error_propagates)
{
	otbn_rsa_keygen_req_t req;
	int ret;

	req_init(&req, OTBN_RSA_KEYGEN_2048, err_rng_eio, NULL);
	ret = otbn_rsa_keygen(&req);
	zassert_equal(ret, -EIO, "rng -EIO 上抛错误: got %d", ret);

	req_init(&req, OTBN_RSA_KEYGEN_2048, err_rng_eperm, NULL);
	ret = otbn_rsa_keygen(&req);
	zassert_equal(ret, -EPERM, "rng -EPERM 上抛错误: got %d", ret);
}

/* session 不泄漏：连续 10 次 2048 全部成功（泄漏则第 2 次即 -EBUSY）。 */
ZTEST(keygen, session_no_leak)
{
	det_rng_t rng;
	otbn_rsa_keygen_req_t req;
	int ret;
	int n_ok = 0;

	for (int i = 0; i < 10; i++) {
		det_rng_reset(&rng, 0x1111000000000000ULL + (uint64_t)i);
		req_init(&req, OTBN_RSA_KEYGEN_2048, det_rng, &rng);
		ret = otbn_rsa_keygen(&req);
		zassert_equal(ret, 0, "第 %d 次 keygen ret=%d（session 泄漏?）", i + 1, ret);
		if (ret != 0) {
			break;
		}
		n_ok++;
	}
	ZT_INFO("session_no_leak", "iterations=%d,ok=%d", 10, n_ok);
	zassert_equal(n_ok, 10, "连续 keygen 成功次数 %d != 10", n_ok);
}

/* 硬约束①：非 4 字节对齐的缓冲一律 -EINVAL。
 * 逐指针各测一次（p/n 由 keygen 校验；check_prime/key_from_pq 各测其一）。 */
ZTEST(keygen, unaligned_rejected)
{
	otbn_rsa_keygen_req_t req;
	det_rng_t rng;
	static uint8_t raw_p[MAX_PRI + 8] __aligned(4);
	static uint8_t raw_n[MAX_MOD + 8] __aligned(4);
	bool pp = false;
	int ret;

	det_rng_reset(&rng, 0x2222222222222222ULL);

	/* keygen: p_le 未对齐 */
	req_init(&req, OTBN_RSA_KEYGEN_2048, det_rng, &rng);
	req.p_le = raw_p + 1;
	ret = otbn_rsa_keygen(&req);
	zassert_equal(ret, -EINVAL, "未对齐 p_le 应 -EINVAL, got %d", ret);

	/* keygen: n_le 未对齐 */
	req_init(&req, OTBN_RSA_KEYGEN_2048, det_rng, &rng);
	req.n_le = raw_n + 1;
	ret = otbn_rsa_keygen(&req);
	zassert_equal(ret, -EINVAL, "未对齐 n_le 应 -EINVAL, got %d", ret);

	/* check_prime: 候选未对齐 */
	ret = otbn_rsa_check_prime(OTBN_RSA_KEYGEN_2048, raw_p + 1, &pp);
	zassert_equal(ret, -EINVAL, "未对齐 check_prime 应 -EINVAL, got %d", ret);

	/* key_from_pq: n_le 输出未对齐 */
	ret = otbn_rsa_key_from_pq(OTBN_RSA_KEYGEN_2048, g_p, g_q, raw_n + 1, g_d);
	zassert_equal(ret, -EINVAL, "未对齐 key_from_pq 应 -EINVAL, got %d", ret);
}

/* 把 256B 缓冲的首 16 字节与末 16 字节拼成一行十六进制（KAT 不匹配时的现场证据）。 */
static void hex_edges(const uint8_t *buf, size_t len, char *out, size_t out_sz)
{
	int n = 0;

	for (size_t i = 0; i < 16 && i < len; i++) {
		n += snprintf(out + n, out_sz - (size_t)n, "%02x", buf[i]);
	}
	n += snprintf(out + n, out_sz - (size_t)n, "..");
	for (size_t i = (len > 16 ? len - 16 : 0); i < len; i++) {
		n += snprintf(out + n, out_sz - (size_t)n, "%02x", buf[i]);
	}
}

/*
 * 客户 TPM（TCG 参考实现，deterministic 路径）产出的 RSA-2048 密钥对 KAT。
 *
 * 为什么这条值钱：它是**外部独立来源**的 N/d，不是由我们自己的代码算出——
 * 直接把 otbn_rsa_key_from_pq() 的输出钉死在客户密钥对上（逐字节）。
 *
 * 关键事实（主机侧已验证）：P ≡ 3 (mod 4)，但 Q ≡ 1 (mod 4)。
 * ⇒ key_from_pq 是纯算术（不判素性），结构上应能逐位产出参考 N、d；
 *    但**整条 keygen 全流程结构上不可能产出这对密钥** —— 候选值流不同是一层，
 *    更硬的一层是 CHECK_PRIME 对 ≡1 (mod 4) 恒判合数。下面的 ③④ 就是把这个
 *    接口约束钉成回归（③ P 判素；④ Q 判合数 —— 既定约束，不是 bug）。
 */
ZTEST(keygen, ref_vector_kat)
{
	static uint8_t kat_p[128] __aligned(4);
	static uint8_t kat_q[128] __aligned(4);
	static uint8_t kat_n[256] __aligned(4);
	static uint8_t kat_d[256] __aligned(4);
	char n_act[80], n_exp[80], d_act[80], d_exp[80];
	bool ok = false;
	int ret;

	/* 参考数组是 static const（对齐仅 1）；模块要求 4 字节对齐 ⇒ 拷进对齐缓冲，
	 * 向量本体保持逐字节不动的原件。 */
	memcpy(kat_p, ref_p_le, sizeof(kat_p));
	memcpy(kat_q, ref_q_le, sizeof(kat_q));

	/* ①② key_from_pq 必须逐位产出参考 N 与 d */
	ret = otbn_rsa_key_from_pq(OTBN_RSA_KEYGEN_2048, kat_p, kat_q, kat_n, kat_d);
	zassert_equal(ret, 0, "ref_vector: key_from_pq ret=%d", ret);
	if (ret == 0) {
		int n_eq = (memcmp(kat_n, ref_n_le, sizeof(kat_n)) == 0);
		int d_eq = (memcmp(kat_d, ref_d_le, sizeof(kat_d)) == 0);

		ZT_INFO("ref_vector_kat", "key_from_pq_ret=0,n_byte_equal=%d,d_byte_equal=%d",
			n_eq, d_eq);

		if (!n_eq) {
			hex_edges(kat_n, sizeof(kat_n), n_act, sizeof(n_act));
			hex_edges(ref_n_le, sizeof(ref_n_le), n_exp, sizeof(n_exp));
			ZT_INFO("ref_vector_kat", "n_act=%s", n_act);
			ZT_INFO("ref_vector_kat", "n_exp=%s", n_exp);
		}
		if (!d_eq) {
			hex_edges(kat_d, sizeof(kat_d), d_act, sizeof(d_act));
			hex_edges(ref_d_le, sizeof(ref_d_le), d_exp, sizeof(d_exp));
			ZT_INFO("ref_vector_kat", "d_act=%s", d_act);
			ZT_INFO("ref_vector_kat", "d_exp=%s", d_exp);
		}

		zassert_mem_equal(kat_n, ref_n_le, sizeof(kat_n),
				  "ref N 不匹配（首末 16B 见 INFO n_act/n_exp）");
		zassert_mem_equal(kat_d, ref_d_le, sizeof(kat_d),
				  "ref d 不匹配（首末 16B 见 INFO d_act/d_exp）");
	}

	/* ③ CHECK_PRIME(P) == true（P 是素数且 ≡ 3 mod 4） */
	ok = false;
	ret = otbn_rsa_check_prime(OTBN_RSA_KEYGEN_2048, kat_p, &ok);
	zassert_equal(ret, 0, "ref check_prime(P) ret=%d", ret);
	zassert_true(ok, "参考 P 应判为素数（P ≡ 3 mod 4）");

	/* ④ CHECK_PRIME(Q) == false。★ 这是 CHECK_PRIME 的既定接口约束（只接受
	 * ≡3 mod 4 的候选），**不是 bug**：Q 本身是素数（主机侧已验证），但
	 * Q ≡ 1 (mod 4) ⇒ 固件按约束恒判合数。本项把该约束钉成回归。 */
	ok = true;
	ret = otbn_rsa_check_prime(OTBN_RSA_KEYGEN_2048, kat_q, &ok);
	zassert_equal(ret, 0, "ref check_prime(Q) ret=%d", ret);
	zassert_false(ok,
		      "CHECK_PRIME 对 ≡1 mod 4 的候选应恒判合数（既定接口约束）");
}
```

## src/otbn_modexp_kat.c
```c
/*
 * SPDX-License-Identifier: Apache-2.0
 *
 * KAT bring-up for the extended OTBN modexp firmware.
 *
 * The rsa_imem image now implements two extra modulus widths (128 B / 192 B,
 * i.e. 1024 / 1536 bits) so that Miller-Rabin can run on prime candidates.
 * This suite drives the exported byte-level entry point directly and pins the
 * result to externally generated big-endian KATs:
 *
 *   mbedtls_ls_otbn_rsa_modexp(input, output, exp, n, num_bytes, is_public)
 *
 * Each vector asserts:
 *   1. the call did not return -ENOTSUP (the length whitelist accepted it),
 *   2. the result is byte-identical to the KAT,
 *   3. the OTBN firmware state is RSA_MODEXP afterwards (the local OTBN path
 *      really ran; there is no software fallback in this entry point).
 *
 * The vectors live in tests/expected/modexp_vectors.h, generated from
 * rsa_keygen/tpm_otbn_hook/modexp_test_vectors.txt.
 *
 * Test names carry the "zzz_" prefix on purpose: ztest executes in link order
 * (SORT_BY_NAME), so they run after the keygen suite and cannot perturb it.
 */

#include <errno.h>
#include <string.h>

#include <zephyr/kernel.h>
#include <zephyr/ztest.h>

#include "ztest_glue.h"

#include "ls_otbn_config.h"          /* ls_otbn_imem_firmware_get() */
#include "mbedtls_otbn_rsa_mbox.h"   /* mbedtls_ls_otbn_rsa_modexp() */

#include "modexp_vectors.h"

#define MODEXP_KAT_MAX_BYTES 512

/* File scope: the ztest thread stack must not carry 4 x 512 B buffers. */
static uint8_t g_in[MODEXP_KAT_MAX_BYTES] __aligned(4);
static uint8_t g_exp[MODEXP_KAT_MAX_BYTES] __aligned(4);
static uint8_t g_n[MODEXP_KAT_MAX_BYTES] __aligned(4);
static uint8_t g_out[MODEXP_KAT_MAX_BYTES] __aligned(4);

static void run_modexp_kat(const char *name, const modexp_vec_t *vec)
{
	int64_t t0, t1;
	size_t first_diff = (size_t)-1;
	int ret, eq = 0;
	unsigned fw;

	zassert_true(vec->num_bytes <= MODEXP_KAT_MAX_BYTES,
		     "%s: vector width %u exceeds buffer", name,
		     (unsigned)vec->num_bytes);

	memcpy(g_in, vec->base, vec->num_bytes);
	memcpy(g_exp, vec->exp, vec->num_bytes);
	memcpy(g_n, vec->n, vec->num_bytes);
	memset(g_out, 0xA5, sizeof(g_out));

	t0 = k_uptime_get();
	ret = mbedtls_ls_otbn_rsa_modexp(g_in, g_out, g_exp, g_n,
					 vec->num_bytes, true);
	t1 = k_uptime_get();
	fw = (unsigned)ls_otbn_imem_firmware_get();

	if (ret == 0) {
		for (size_t i = 0; i < vec->num_bytes; i++) {
			if (g_out[i] != vec->out[i]) {
				first_diff = i;
				break;
			}
		}
		eq = (first_diff == (size_t)-1);
	}

	/* Emit the measurement before asserting so the INFO line is always
	 * archived, including on failure. */
	ZT_INFO(name, "ret=%d,ms=%lld,byte_equal=%d,first_diff=%d,fw=%u",
		ret, (long long)(t1 - t0), eq,
		(first_diff == (size_t)-1) ? -1 : (int)first_diff, fw);

	zassert_true(ret != -ENOTSUP,
		     "%s: -ENOTSUP (length whitelist rejected %u bytes)",
		     name, (unsigned)vec->num_bytes);
	zassert_equal(ret, 0, "%s: modexp ret=%d", name, ret);
	zassert_true(eq, "%s: output differs from KAT (first_diff=%d)",
		     name, (first_diff == (size_t)-1) ? -1 : (int)first_diff);

	/* No software fallback exists in this entry point; the shared firmware
	 * state proves the local OTBN modexp image executed. */
	zassert_equal(fw, (unsigned)OTBN_FIRMWARE_RSA_MODEXP,
		      "%s: firmware state %u != RSA_MODEXP(%u)", name, fw,
		      (unsigned)OTBN_FIRMWARE_RSA_MODEXP);
}

ZTEST(keygen, zzz_modexp_kat_n128b_random)
{
	run_modexp_kat("zzz_modexp_kat_n128b_random", &modexp_vectors[0]);
}

ZTEST(keygen, zzz_modexp_kat_n192b_random)
{
	run_modexp_kat("zzz_modexp_kat_n192b_random", &modexp_vectors[1]);
}

ZTEST(keygen, zzz_modexp_kat_n256b_random)
{
	run_modexp_kat("zzz_modexp_kat_n256b_random", &modexp_vectors[2]);
}

ZTEST(keygen, zzz_modexp_kat_n4b_base1)
{
	run_modexp_kat("zzz_modexp_kat_n4b_base1", &modexp_vectors[3]);
}

ZTEST(keygen, zzz_modexp_kat_n4b_base0)
{
	run_modexp_kat("zzz_modexp_kat_n4b_base0", &modexp_vectors[4]);
}

ZTEST(keygen, zzz_modexp_kat_n4b_exp0)
{
	run_modexp_kat("zzz_modexp_kat_n4b_exp0", &modexp_vectors[5]);
}

ZTEST(keygen, zzz_modexp_kat_n4b_exp1)
{
	run_modexp_kat("zzz_modexp_kat_n4b_exp1", &modexp_vectors[6]);
}

ZTEST(keygen, zzz_modexp_kat_n4b_basenm1)
{
	run_modexp_kat("zzz_modexp_kat_n4b_basenm1", &modexp_vectors[7]);
}

/* Regression of the pre-existing 384/512 B entry points. Host-generated KATs
 * (Python pow); N512B_f4 uses e=65537, i.e. the F4 mode branch. */
ZTEST(keygen, zzz_modexp_kat_n384b_hostkat)
{
	run_modexp_kat("zzz_modexp_kat_n384b_hostkat", &modexp_vectors[8]);
}

ZTEST(keygen, zzz_modexp_kat_n512b_hostkat)
{
	run_modexp_kat("zzz_modexp_kat_n512b_hostkat", &modexp_vectors[9]);
}

ZTEST(keygen, zzz_modexp_kat_n512b_f4_hostkat)
{
	run_modexp_kat("zzz_modexp_kat_n512b_f4_hostkat", &modexp_vectors[10]);
}
```
