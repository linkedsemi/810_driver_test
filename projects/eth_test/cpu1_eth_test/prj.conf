## CMakeLists.txt
```
# SPDX-License-Identifier: Apache-2.0
# Ethernet test (eth1@40064000 + 板载 RTL8211F PHY) - CMakeLists.txt
#
# 单核（cpu1）工程，四个 case 变体共享同一源目录，由 test.sh 用 -D 选择源集：
#   -DETH_ARP_ICMP_TEST=y -> src/eth_arp_icmp_test.c （B 组：数据面 ARP/ICMP）
#   -DETH_UDP_ECHO_TEST=y -> src/eth_udp_echo_test.c  （B 组：数据面 UDP echo）
#   -DETH_LINK_TEST=y     -> src/eth_link_test.c      （B 组：MDIO 之上，链路状态）
#   默认                  -> src/eth_mdio_test.c      （A 组：零对端，不依赖网线状态）
# 变体机制与 sec_iwdg_cpu1_test 一致（SPEC_REFERENCE §6.1.8）。

cmake_minimum_required(VERSION 3.20.0)
find_package(Zephyr REQUIRED HINTS $ENV{ZEPHYR_BASE})
project(cpu1_eth_test)

if(ETH_ARP_ICMP_TEST)
    target_sources(app PRIVATE
        src/main.c
        src/eth_arp_icmp_test.c)
    target_compile_definitions(app PRIVATE ETH_ARP_ICMP_TEST=1)
elseif(ETH_UDP_ECHO_TEST)
    target_sources(app PRIVATE
        src/main.c
        src/eth_udp_echo_test.c)
    target_compile_definitions(app PRIVATE ETH_UDP_ECHO_TEST=1)
elseif(ETH_LINK_TEST)
    target_sources(app PRIVATE
        src/main.c
        src/eth_link_test.c)
    target_compile_definitions(app PRIVATE ETH_LINK_TEST=1)
else()
    target_sources(app PRIVATE
        src/main.c
        src/eth_mdio_test.c)
    target_compile_definitions(app PRIVATE ETH_MDIO_TEST=1)
endif()

# 统一 CMake 入口（common_sources.cmake）：注入公共源
# common/test_results.c + common/ztest_glue.c + common/gpio_toggle.c
# 及 include 目录。禁止在此单独 target_sources 这三个文件（SPEC_REFERENCE §6.1.9）。
include(${CMAKE_CURRENT_SOURCE_DIR}/../../../common/common_sources.cmake)
```

## prj.conf
```kconfig
# Ethernet test (eth1 + 板载 RTL8211F PHY) —— cpu1 侧固件配置
#
# 配置基准：linkedsemi_zephyr_project/samples/zperf/（本板已实测跑通的以太网
# 网络栈配置）+ zperf/boards/lsqsh_evb_cpu1.conf（CONFIG_MDIO=y）。

# ---- 810 公共固件规范（SPEC_REFERENCE §6.1）----
CONFIG_LOG=y
CONFIG_LOG_MODE_DEFERRED=y
CONFIG_LOG_BUFFER_SIZE=16384
CONFIG_LOG_PROCESS_THREAD_SLEEP_MS=10
CONFIG_LOG_BACKEND_UART=y
CONFIG_LOG_PRINTK=n
CONFIG_SERIAL=y
# 810 各工程一律 CONFIG_SHELL=n，但 eth_dwmac.c:800-832 在文件末尾**无条件**
# 注册 shell 命令（SHELL_CMD_ARG_REGISTER 在 CONFIG_SHELL=n 下不是空宏，
# 而是把 entry 放进 shell_root_cmds 段），其 handler 调用 shell_error() ->
# shell_fprintf_error()，该符号只在 CONFIG_SHELL=y 时编入 ⇒ SHELL=n 必然
# 链接失败（undefined reference to `shell_fprintf_error`）。
# 折中：开 SHELL 拿到符号，但**关掉串口 backend、只留 dummy backend**，
# shell 线程无传输通道，不产生提示符/不占用 uart1 RX，ztest 串口流不受污染。
CONFIG_SHELL=y
CONFIG_SHELL_BACKEND_SERIAL=n
CONFIG_SHELL_BACKEND_DUMMY=y
CONFIG_ZTEST=y
CONFIG_ZTEST_ASSERT_VERBOSE=1
CONFIG_ZTEST_VERBOSE_OUTPUT=y
CONFIG_ZTEST_SUMMARY=n
# libc 三件套（KNOWN_ISSUES #58）
CONFIG_PICOLIBC=y
CONFIG_NEWLIB_LIBC=n
CONFIG_MINIMAL_LIBC=n
CONFIG_GPIO=y

# ---- 以太网 / MDIO ----
# MDIO 驱动（snps,dwmac-mdio -> mdio_dwmac.c）的 init 挂在
# CONFIG_NETWORKING_AUTO_INIT 下（mdio_dwmac.c:387），故网络栈必须打开，
# 否则 mdio1 设备不会做时钟/pinctrl/复位初始化，MDIO 事务必然超时。
# eth1（linkedsemi,ethernet -> eth_dwmac_linkedsemi.c + eth_dwmac.c）经
# CONFIG_ETH_DWMAC 编入，其依赖 NET_BUF_FIXED_DATA_SIZE 也由网络栈提供。
CONFIG_NETWORKING=y
CONFIG_NET_L2_ETHERNET=y
CONFIG_ETH_DRIVER=y
CONFIG_MDIO=y
CONFIG_MDIO_SHELL=n
CONFIG_NET_IPV6=n
CONFIG_NET_IPV4=y
CONFIG_NET_UDP=y
CONFIG_NET_DHCPV4=n
# eth_dwmac.c 的 RX refill 线程优先级取 CONFIG_NET_TCP_WORKER_PRIO-1
# （eth_dwmac.c:73），故 NET_TCP 必须编入，否则该符号未定义、驱动编不过。
CONFIG_NET_TCP=y
# MAC 地址由 dwmac_platform_init() 的 gen_random_mac() 生成
CONFIG_TEST_RANDOM_GENERATOR=y

# 缓冲/描述符：DATA_SIZE 取 1600（= zperf 实测值），使 1500B 帧单片容纳，
# 描述符数与 net_buf 数对齐（RX/TX 各 16）。
CONFIG_NET_BUF_DATA_SIZE=1600
CONFIG_NET_PKT_RX_COUNT=16
CONFIG_NET_PKT_TX_COUNT=16
CONFIG_NET_BUF_RX_COUNT=16
CONFIG_NET_BUF_TX_COUNT=16
CONFIG_DWMAC_NB_RX_DESCS=16
CONFIG_DWMAC_NB_TX_DESCS=16

# ---- B 组数据面（ARP / ICMP / UDP echo）追加项（2026-09-17，纯追加）----
# 地址为**约定值**，P6 按实际网络调整时只改下面两行（必须同网段）。
CONFIG_NET_SOCKETS=y
CONFIG_NET_CONFIG_SETTINGS=y
CONFIG_NET_CONFIG_MY_IPV4_ADDR="192.168.1.100"
CONFIG_NET_CONFIG_MY_IPV4_NETMASK="255.255.255.0"
CONFIG_NET_CONFIG_PEER_IPV4_ADDR="192.168.1.1"
# 0 = 启动阶段不等待链路就绪（默认 30 s：网线未插/对端未激活时会让开机阻塞，
# 进而吃掉 case 超时窗口）。静态地址仍在 net_config 的 SYS_INIT 里立即写入。
CONFIG_NET_CONFIG_INIT_TIMEOUT=0
```

## app.overlay
```dts
/*
 * SPDX-License-Identifier: Apache-2.0
 *
 * Ethernet 单核测试 overlay（cpu1，lsqsh_evb@1os/lsqsh/cpu1）。
 *
 * 硬件：eth1@40064000（compatible "linkedsemi,ethernet"）+
 *       mdio1@40064000（compatible "snps,dwmac-mdio"）+
 *       板载 RTL8211F PHY（mdio1 下 ethernet-phy@0；其 reset-gpios 在 GPIOG 的
 *       pin1、int-gpios 在 GPIOG 的 pin5，均由板级 dts 给出）。
 *
 * 板级 dts 已把 &mdio1 / &eth1 / 其 PHY 子节点置 status="okay"
 * （zephyr/boards/linkedsemi/lsqsh_evb/lsqsh_evb_cpu1.dts:263-276），
 * 故本 overlay 不重复声明节点状态，只补 console 与公共 GPIO 片段。
 */

/ {
	chosen {
		zephyr,console = &uart1;
		zephyr,shell-uart = &uart1;
	};
};

/* GPIO toggle 使能块统一走公共层（SPEC_REFERENCE §6.1.9 复用收敛）。
 * CPU1 侧固件编入 gpio_toggle.c，cpu2 侧不编入。 */
#include "../../../common/gpio_toggle.dtsi"
```

## src/main.c
```c
/*
 * SPDX-License-Identifier: Apache-2.0
 *
 * Ethernet test - entry point (single-core, cpu1)
 */

#include <zephyr/kernel.h>
#include <zephyr/logging/log.h>
#include "ztest_glue.h"

LOG_MODULE_REGISTER(eth_test, LOG_LEVEL_INF);

void test_main(void)
{
	LOG_INF("[CPU1 ETH] Ethernet test started");
	zt_init("TGT");
	zt_run_all();
}
```

## src/eth_arp_icmp_test.c
```c
/*
 * SPDX-License-Identifier: Apache-2.0
 *
 * Ethernet 测试 —— B 组数据面①：ARP 解析 + ICMP echo 收发校验
 *
 * 覆盖对象：
 *   zephyr/subsys/net/lib/config/init.c     静态 IPv4 地址写入（net_config 库）
 *   zephyr/subsys/net/l2/ethernet/arp.c     IPv4 发送路径内的 ARP 解析/缓存
 *   zephyr/subsys/net/ip/icmp.c, icmpv4.c   ICMPv4 Echo-Request / Echo-Reply
 *   zephyr/drivers/ethernet/eth_dwmac.c     真实收发路径 dwmac_send / dwmac_receive
 *                                           （eth_dev_ready 只碰设备契约，不碰数据面）
 *
 * 外部路径（SPEC_REFERENCE §6.6）：板载 RJ45 <-> PC 网口（网线）。
 *   对端要求：PC 网口上电且自协商成功 + PC 侧同网段静态 IPv4 + 放行 ICMPv4 回显请求
 *   （详见 tests/COVERAGE.md「PC 侧前置条件」）。
 *
 * 判据设计（防 flaky）：ARP 首包解析失败、ICMP 首包丢失是常态，
 *   故用「N 次重试 + 每次独立超时」；命中 1 次即 PASS —— 一次成功的
 *   请求/应答同时证明「ARP 解析到 PC」与「ICMP 往返通」两件事。
 *   统计值（发送/接收/丢包/RTT 极值）用 ZT_INFO 上报，不做精确值断言。
 *
 * 注意：ARP 表在本版本 Zephyr 无公开查询 API（无 net/arp.h），故「ARP 是否解析成功」
 *   以**回包的源 IPv4 地址等于对端地址**为证据（ARP 不成功则收不到该对端的回包）。
 */

#include <zephyr/kernel.h>
#include <zephyr/device.h>
#include <zephyr/devicetree.h>
#include <zephyr/net/net_if.h>
#include <zephyr/net/net_ip.h>
#include <zephyr/net/icmp.h>
#include <zephyr/net/socket.h>
#include <zephyr/ztest.h>
#include <string.h>

#include "ztest_glue.h"   /* ZT_INFO 约定行（SPEC_REFERENCE §6.5.4） */

/* 约定值（P6 按实际网络调整时只改 prj.conf 的 CONFIG_NET_CONFIG_* 两行） */
#define LOCAL_IPV4       CONFIG_NET_CONFIG_MY_IPV4_ADDR
#define PEER_IPV4        CONFIG_NET_CONFIG_PEER_IPV4_ADDR

/* 重试窗口：5 次 × 2 s 上限 = 10 s，远小于 case_timeout */
#define PING_ATTEMPTS    5U
#define PING_TIMEOUT_MS  2000
#define PING_PAYLOAD_LEN 32U

static K_SEM_DEFINE(reply_sem, 0, 1);

/* handler 在 net rx 线程执行：只记账 + give 信号量，禁 log/禁阻塞（§6.1.2 同款纪律） */
static volatile int64_t last_send_uptime_ms;
static volatile uint32_t reply_total;
static volatile uint32_t reply_from_peer;
static volatile int64_t rtt_last_us;
static volatile int64_t rtt_min_us;
static volatile int64_t rtt_max_us;

static int echo_reply_handler(struct net_icmp_ctx *ctx, struct net_pkt *pkt,
			      struct net_icmp_ip_hdr *hdr,
			      struct net_icmp_hdr *icmp_hdr, void *user_data)
{
	int64_t now;
	int64_t sent;
	struct in_addr peer;

	ARG_UNUSED(ctx);
	ARG_UNUSED(pkt);
	ARG_UNUSED(icmp_hdr);
	ARG_UNUSED(user_data);

	if (hdr == NULL || hdr->family != AF_INET) {
		return 0;
	}

	reply_total++;

	/* 回包源地址 == 对端地址 ⇒ ARP 解析到的就是 PC 本机 */
	if (net_addr_pton(AF_INET, PEER_IPV4, &peer) == 0 &&
	    memcmp(&hdr->ipv4->src, &peer, sizeof(peer)) == 0) {
		reply_from_peer++;
	}

	now = k_uptime_get();
	sent = last_send_uptime_ms;
	if (sent != 0) {
		int64_t rtt = (now - sent) * 1000;   /* ms -> us */

		rtt_last_us = rtt;
		if (rtt_min_us == 0 || rtt < rtt_min_us) {
			rtt_min_us = rtt;
		}
		if (rtt > rtt_max_us) {
			rtt_max_us = rtt;
		}
	}

	k_sem_give(&reply_sem);

	return 0;
}

/* ==================================================================
 * eth_arp_icmp：静态 IP -> ARP 解析 PC -> ICMP echo 收发校验
 * ================================================================== */
ZTEST(eth_arp_icmp, eth_arp_icmp)
{
	const struct device *eth = DEVICE_DT_GET(DT_NODELABEL(eth1));
	struct net_if *iface;
	struct sockaddr_in dst = { 0 };
	struct in_addr local;
	struct net_icmp_ping_params params = { 0 };
	struct net_icmp_ctx ctx;
	static uint8_t payload[PING_PAYLOAD_LEN];
	uint32_t sent = 0;
	uint32_t got = 0;
	bool src_ok = false;
	int ret;

	iface = net_if_lookup_by_dev(eth);
	zassert_not_null(iface, "eth1 未绑定 net_if");

	/* 1) 静态 IPv4 配置生效（CONFIG_NET_CONFIG_MY_IPV4_ADDR 由 net_config 写入） */
	ret = net_addr_pton(AF_INET, LOCAL_IPV4, &local);
	zassert_equal(ret, 0, "本机地址 \"%s\" 解析失败", LOCAL_IPV4);

	if (net_if_ipv4_addr_lookup(&local, NULL) == NULL) {
		/* 地址未由 net_config 写入时自补一次，避免判定被启动时序左右 */
		struct net_if_addr *added =
			net_if_ipv4_addr_add(iface, &local, NET_ADDR_MANUAL, 0);

		zassert_not_null(added, "静态 IPv4 \"%s\" 既未配置也无法添加", LOCAL_IPV4);
	}

	/* 2) 对端地址（约定值） */
	dst.sin_family = AF_INET;
	ret = net_addr_pton(AF_INET, PEER_IPV4, &dst.sin_addr);
	zassert_equal(ret, 0, "对端地址 \"%s\" 解析失败", PEER_IPV4);

	/* 3) 注册 ICMP Echo-Reply 处理（handler 在 net rx 线程，禁阻塞） */
	memset(&ctx, 0, sizeof(ctx));
	ret = net_icmp_init_ctx(&ctx, NET_ICMPV4_ECHO_REPLY, 0, echo_reply_handler);
	zassert_equal(ret, 0, "net_icmp_init_ctx ret=%d", ret);

	for (uint32_t i = 0; i < PING_PAYLOAD_LEN; i++) {
		payload[i] = (uint8_t)(0xE0U + i);
	}

	params.identifier = 0x4554U;      /* 'ET' */
	params.data = payload;
	params.data_size = sizeof(payload);

	/* 4) N 次重试：每次独立超时；命中 1 次即通过 */
	for (uint32_t i = 0; i < PING_ATTEMPTS; i++) {
		/* 清掉上一轮迟到/超时后到达的回包，避免串轮 */
		while (k_sem_take(&reply_sem, K_NO_WAIT) == 0) {
			/* drain */
		}

		params.sequence = (uint16_t)i;
		last_send_uptime_ms = k_uptime_get();
		rtt_last_us = 0;

		ret = net_icmp_send_echo_request(&ctx, iface, (struct sockaddr *)&dst,
						 &params, NULL);
		zassert_equal(ret, 0, "第 %u 次 net_icmp_send_echo_request ret=%d", i, ret);
		sent++;

		if (k_sem_take(&reply_sem, K_MSEC(PING_TIMEOUT_MS)) == 0) {
			got++;
			src_ok = (reply_from_peer > 0);
			break;                /* 一次成功即证明通路 */
		}
	}

	ret = net_icmp_cleanup_ctx(&ctx);
	zassert_equal(ret, 0, "net_icmp_cleanup_ctx ret=%d", ret);

	ZT_INFO("eth_arp_icmp",
		"peer=%s,local=%s,sent=%u,recv=%u,loss_pct=%u,reply_total=%u,"
		"rtt_us=%ld,rtt_min_us=%ld,rtt_max_us=%ld",
		PEER_IPV4, LOCAL_IPV4, sent, got,
		sent ? (unsigned)((sent - got) * 100U / sent) : 0U,
		(unsigned)reply_total,
		(long)rtt_last_us, (long)rtt_min_us, (long)rtt_max_us);

	/* 5) 判据：至少 1 次「源地址 = 对端」的回包（同时证明 ARP 与 ICMP 往返） */
	zassert_true(got > 0,
		     "对端 %s 在 %u 次尝试（每次 %d ms）内无 ICMP 回包："
		     "需确认 PC 网口已激活、同网段静态 IP 已配、ICMPv4 回显请求未被防火墙拦截",
		     PEER_IPV4, PING_ATTEMPTS, PING_TIMEOUT_MS);
	zassert_true(src_ok,
		     "收到 %u 个回包但源地址不是对端 %s（ARP 解析到的不是 PC？）",
		     (unsigned)reply_total, PEER_IPV4);
}

ZTEST_SUITE(eth_arp_icmp, NULL, NULL, NULL, NULL, NULL);
```

## src/eth_link_test.c
```c
/*
 * SPDX-License-Identifier: Apache-2.0
 *
 * Ethernet 测试 —— B 组：网口链路建立（需网线对端）
 *
 * 覆盖对象：
 *   zephyr/drivers/ethernet/phy/phy_realtek_rtl8211f.c
 *     （compatible "realtek,rtl8211f"，实例 = mdio1 下 ethernet-phy@0；
 *        链路状态取 PHY 专有状态寄存器 PHYSR(0x1A)，不是标准 BMSR）
 *   zephyr/drivers/ethernet/eth_dwmac_linkedsemi.c（net_if / L2 绑定）
 *
 * 外部路径（SPEC_REFERENCE §6.6）：**网线 + PC 对端**
 *   板载 RJ45 <--> PC 网口，对端网口须上电并开启自协商。
 *
 * 说明：同族弱判据项 `eth_phy_link_state`（只读 PHY 状态、不断言 up、无需对端）
 *   已按父会话裁定挪入 A 组 `case_mdio`（套件 `eth_mdio`），本 case 只留强判据。
 */

#include <zephyr/kernel.h>
#include <zephyr/device.h>
#include <zephyr/devicetree.h>
#include <zephyr/net/phy.h>
#include <zephyr/ztest.h>

#include "ztest_glue.h"       /* ZT_INFO 约定行（SPEC_REFERENCE §6.5.4） */
#include "eth_phy_common.h"   /* eth_phy_dev / link_speed_mbps / link_duplex_str */

/* 链路协商是毫秒~秒级过程：轮询 + 超时窗口，不做单次采样判定。
 * 窗口取 10 s —— 对端网卡处于省电模式或被固定速率时，自协商可能超过 5 s。 */
#define LINK_UP_TIMEOUT_MS    10000U
#define LINK_POLL_INTERVAL_MS 100U

static bool poll_link_up(struct phy_link_state *state, uint32_t timeout_ms)
{
	int64_t deadline = k_uptime_get() + (int64_t)timeout_ms;

	do {
		if (phy_get_link_state(eth_phy_dev(), state) == 0 && state->is_up) {
			return true;
		}
		k_msleep(LINK_POLL_INTERVAL_MS);
	} while (k_uptime_get() < deadline);

	return false;
}

/* ==================================================================
 * eth_link_up：网口链路建立（功能通路）—— 需对端
 *   外部: 板载 RJ45 <-> PC 网口（网线），对端网口须上电并在自协商。
 *   10000 ms 轮询窗口内 PHY 报 link up 即 PASS；超时仍 down 判 FAIL，
 *   提示先查对端网口状态（不是单次采样的时序抖动）。
 * ================================================================== */
ZTEST(eth_link, eth_link_up)
{
	struct phy_link_state st = { 0 };
	bool up = poll_link_up(&st, LINK_UP_TIMEOUT_MS);

	ZT_INFO("eth_link_up", "link=%s,speed_mbps=%u,duplex=%s,window_ms=%u",
		up ? "up" : "down", link_speed_mbps(st.speed),
		link_duplex_str(st.speed), LINK_UP_TIMEOUT_MS);

	zassert_true(up,
		     "网线对端 %u ms 内未建立链路（PHY 报 link down）："
		     "需确认 PC 网口已上电/激活且自协商开启",
		     LINK_UP_TIMEOUT_MS);
}

ZTEST_SUITE(eth_link, NULL, NULL, NULL, NULL, NULL);
```

## src/eth_mdio_test.c
```c
/*
 * SPDX-License-Identifier: Apache-2.0
 *
 * Ethernet / MDIO 测试 —— A 组（零对端，不依赖网线状态）
 *
 * 覆盖对象：
 *   zephyr/drivers/mdio/mdio_dwmac.c
 *     （compatible "snps,dwmac-mdio"，实例 mdio1@0x40064000；
 *       对外 API：mdio_read / mdio_write，经 mdio_dwmac_transfer()）
 *   zephyr/drivers/ethernet/eth_dwmac_linkedsemi.c + eth_dwmac.c
 *     （compatible "linkedsemi,ethernet"，实例 eth1@0x40064000）
 *   zephyr/drivers/ethernet/phy/phy_realtek_rtl8211f.c
 *     （仅**弱判据** eth_phy_link_state：读 PHYSR(0x1A) 解码链路状态，
 *       不断言 link 必须 up ⇒ 无对端也能确定判定，故归 A 组）
 *
 * 硬件：板载 RTL8211F PHY，挂 mdio1 下，phy addr = 0
 *       （zephyr/boards/linkedsemi/lsqsh_evb/lsqsh_evb_cpu1.dts:268-276）。
 *
 * 外部路径：无 —— 只与板载 PHY 通话，网线插拔不影响本组判定。
 */

#include <zephyr/kernel.h>
#include <zephyr/device.h>
#include <zephyr/devicetree.h>
#include <zephyr/drivers/mdio.h>
#include <zephyr/net/mii.h>
#include <zephyr/net/net_if.h>
#include <zephyr/net/ethernet.h>
#include <zephyr/ztest.h>
#include <string.h>

#include "ztest_glue.h"       /* ZT_INFO 约定行（SPEC_REFERENCE §6.5.4） */
#include "eth_phy_common.h"   /* eth_phy_dev / link_speed_mbps / link_duplex_str */

/* 板载 RTL8211F：mdio1 下的 ethernet-phy@0 */
#define ETH_PHY_ADDR      0U
/* Realtek OUI = 0x001CC9（PHYID1R[15:0] + PHYID2R[15:8]）。
 * PHYID2R 低字节是 model/revision，随 RTL8211F 具体型号而异，故只断言 OUI。 */
#define RTL8211F_PHYID1   0x001CU
#define RTL8211F_OUI_HI   0xC900U

/* mdio_dwmac.c 的地址寄存器把 PHY addr / reg 直接裁进 5 位字段
 * （mdio_address_t.PA[4:0] / .RDA[4:0]），驱动无范围校验 ⇒ 越界索引
 * 静默按 5 位回绕。本组把该行为钉住。 */
#define MDIO_ADDR_WRAP    32U

static const struct device *eth_mdio_dev(void)
{
	return DEVICE_DT_GET(DT_NODELABEL(mdio1));
}

/* ==================================================================
 * TC-1: MDIO 读 PHY 标识（功能通路）
 *   读 mdio_dwmac_read() -> mdio_dwmac_transfer() 的 C22 读路径。
 * ================================================================== */
ZTEST(eth_mdio, mdio_phy_id)
{
	const struct device *mdio = eth_mdio_dev();
	uint16_t id1 = 0;
	uint16_t id2 = 0;
	int ret;

	zassert_true(device_is_ready(mdio), "mdio1 device is not ready");

	ret = mdio_read(mdio, ETH_PHY_ADDR, MII_PHYID1R, &id1);
	zassert_equal(ret, 0, "mdio_read(PHYID1R) ret=%d", ret);

	ret = mdio_read(mdio, ETH_PHY_ADDR, MII_PHYID2R, &id2);
	zassert_equal(ret, 0, "mdio_read(PHYID2R) ret=%d", ret);

	ZT_INFO("mdio_phy_id", "addr=%u,id1=0x%04x,id2=0x%04x,oui=0x%06x",
		ETH_PHY_ADDR, id1, id2,
		((uint32_t)id1 << 8) | (uint32_t)(id2 >> 8));

	/* 非退化：全 0/全 1 说明 MDIO 通路没真正取到数据 */
	zassert_false(id1 == 0x0000 && id2 == 0x0000,
		      "PHY ID 读回全 0x0000（MDIO 通路未取到数据）");
	zassert_false(id1 == 0xFFFF && id2 == 0xFFFF,
		      "PHY ID 读回全 0xFFFF（MDIO 通路未取到数据）");

	/* 归因顺序（★ 排障提示）：读到 0x0000 / 0xFFFF / 非 Realtek OUI 时，
	 * **先查 PHY 复位是否成功**，不要先怀疑下面的期望值（0x001C / 0xC9 已核实正确）：
	 *   mdio_dwmac.c:275 调用 mdio_dwmac_ethphy_reset() 的返回值**已修**为
	 *   被上报（:276-279 `if (ret) { DEV_ERR("PHY reset failed"); goto done; }`）
	 *   ⇒ 复位失败现在会使 mdio_dwmac_init() 返回非 0，
	 *     `device_is_ready(mdio1)` 随之先失败，不会再静默走到本项。
	 * （历史：修前该返回值被丢弃，复位失败不报错、PHY 可能仍处复位态，
	 *   MDIO 读回垃圾值 —— 这条排障提示即源于那次缺陷。） */
	zassert_equal(id1, RTL8211F_PHYID1,
		      "PHYID1R=0x%04x 不是 Realtek OUI 高 16 位 0x%04x",
		      id1, RTL8211F_PHYID1);
	zassert_equal(id2 & 0xFF00U, RTL8211F_OUI_HI,
		      "PHYID2R=0x%04x 的 OUI 低 8 位 != 0x%02x（非 Realtek PHY）",
		      id2, RTL8211F_OUI_HI >> 8);
}

/* ==================================================================
 * TC-2: MDIO 寄存器读写回环（功能通路）
 *   走 mdio_dwmac_write() 的写分支（is_write -> 先写 MDIO_DATA 再写
 *   MDIO_ADDRESS）与随后的读回。
 *
 *   选 ANAR(0x04) 作为读写靶：802.3 clause 22 规定其 16 位全 RW，且
 *   **修改 ANAR 不重启自协商**（只有写 BMCR 才会），故对在跑的链路无副作用；
 *   写完立即恢复原值。
 * ================================================================== */
ZTEST(eth_mdio, mdio_reg_rw)
{
	const struct device *mdio = eth_mdio_dev();
	uint16_t anar_orig = 0;
	uint16_t anar_probe = 0;
	uint16_t anar_back = 0;
	uint16_t bmcr_a = 0;
	uint16_t bmcr_b = 0;
	uint16_t modified;
	int ret;

	/* 读通路可重复性：同寄存器连续两次读必须一致 */
	ret = mdio_read(mdio, ETH_PHY_ADDR, MII_BMCR, &bmcr_a);
	zassert_equal(ret, 0, "mdio_read(BMCR) ret=%d", ret);
	ret = mdio_read(mdio, ETH_PHY_ADDR, MII_BMCR, &bmcr_b);
	zassert_equal(ret, 0, "mdio_read(BMCR) ret=%d", ret);
	zassert_equal(bmcr_a, bmcr_b,
		      "BMCR 连续两次读不一致: 0x%04x / 0x%04x", bmcr_a, bmcr_b);
	/* 复位位自清：读到 1 说明复位未完成 */
	zassert_equal(bmcr_a & MII_BMCR_RESET, 0,
		      "BMCR.RESET 仍为 1（PHY 复位未完成）: 0x%04x", bmcr_a);

	/* 写通路：改一位（ANAR bit5 = 100BASE-TX half duplex）后读回 */
	ret = mdio_read(mdio, ETH_PHY_ADDR, MII_ANAR, &anar_orig);
	zassert_equal(ret, 0, "mdio_read(ANAR) ret=%d", ret);
	ZT_INFO("mdio_reg_rw", "anar_orig=0x%04x", anar_orig);

	modified = (uint16_t)(anar_orig ^ 0x0020U);

	ret = mdio_write(mdio, ETH_PHY_ADDR, MII_ANAR, modified);
	zassert_equal(ret, 0, "mdio_write(ANAR, 0x%04x) ret=%d", modified, ret);

	ret = mdio_read(mdio, ETH_PHY_ADDR, MII_ANAR, &anar_probe);
	zassert_equal(ret, 0, "mdio_read(ANAR) ret=%d", ret);

	/* 恢复原值 */
	ret = mdio_write(mdio, ETH_PHY_ADDR, MII_ANAR, anar_orig);
	zassert_equal(ret, 0, "mdio_write(ANAR, 0x%04x) ret=%d", anar_orig, ret);

	ret = mdio_read(mdio, ETH_PHY_ADDR, MII_ANAR, &anar_back);
	zassert_equal(ret, 0, "mdio_read(ANAR) ret=%d", ret);

	ZT_INFO("mdio_reg_rw", "anar_w=0x%04x,anar_rb=0x%04x,anar_restored=0x%04x",
		modified, anar_probe, anar_back);

	zassert_equal(anar_probe, modified,
		      "ANAR 写回读不相等: 写 0x%04x 读回 0x%04x", modified, anar_probe);
	zassert_equal(anar_back, anar_orig,
		      "ANAR 恢复失败: 原值 0x%04x 恢复后读回 0x%04x",
		      anar_orig, anar_back);
}

/* ==================================================================
 * TC-3: MDIO 越界参数（异常参数 / 边界长度）
 *   驱动对 phy addr / reg 无范围校验，两者都被裁进 5 位字段：
 *   越界索引静默回绕到 addr 0 / reg 0。
 *
 *   注意：**不测“无 PHY 的地址必须报错”** —— DW MAC 的 MDIO 事务不区分
 *   “从设备无响应”，GB 位照样清零并返回上一次的数据，因此“读到错误码”
 *   这一判据在本平台上不存在（见 COVERAGE.md 跳过项）。
 * ================================================================== */
ZTEST(eth_mdio, mdio_invalid_args)
{
	const struct device *mdio = eth_mdio_dev();
	uint16_t reg0 = 0;
	uint16_t wrap_addr = 0;
	uint16_t wrap_reg = 0;
	uint16_t absent = 0;
	int ret;

	ret = mdio_read(mdio, ETH_PHY_ADDR, 0, &reg0);
	zassert_equal(ret, 0, "mdio_read(addr=0, reg=0) ret=%d", ret);

	/* phy addr 越界：32 -> PA[4:0] = 0 */
	ret = mdio_read(mdio, ETH_PHY_ADDR + MDIO_ADDR_WRAP, 0, &wrap_addr);
	zassert_equal(ret, 0, "mdio_read(addr=%u) ret=%d",
		      ETH_PHY_ADDR + MDIO_ADDR_WRAP, ret);
	zassert_equal(wrap_addr, reg0,
		      "phy addr %u 未按 5 位回绕到 0: 0x%04x vs 0x%04x",
		      ETH_PHY_ADDR + MDIO_ADDR_WRAP, wrap_addr, reg0);

	/* reg 越界：32 -> RDA[4:0] = 0 */
	ret = mdio_read(mdio, ETH_PHY_ADDR, MDIO_ADDR_WRAP, &wrap_reg);
	zassert_equal(ret, 0, "mdio_read(reg=%u) ret=%d", MDIO_ADDR_WRAP, ret);
	zassert_equal(wrap_reg, reg0,
		      "reg %u 未按 5 位回绕到 0: 0x%04x vs 0x%04x",
		      MDIO_ADDR_WRAP, wrap_reg, reg0);

	/* 只观测、不断言：addr 31 无 PHY，但 DW MAC 不区分无响应 */
	ret = mdio_read(mdio, 31, 0, &absent);
	ZT_INFO("mdio_invalid_args",
		"wrap_addr_val=0x%04x,wrap_reg_val=0x%04x,absent_phy31:ret=%d,val=0x%04x",
		wrap_addr, wrap_reg, ret, absent);
}

/* ==================================================================
 * TC-4: 以太网设备 / net_if 契约（功能通路）
 *   覆盖 eth_dwmac_linkedsemi.c 的 ETH_NET_DEVICE_DT_INST_DEFINE 产物：
 *   设备就绪、net_if 绑定、L2 类型、MTU、链路层地址。
 * ================================================================== */
ZTEST(eth_mdio, eth_dev_ready)
{
	const struct device *eth = DEVICE_DT_GET(DT_NODELABEL(eth1));
	struct net_if *iface;
	struct net_linkaddr *link_addr;
	uint8_t or_all = 0;
	uint8_t and_all = 0xFF;
	int i;

	zassert_true(device_is_ready(eth), "eth1 device is not ready");

	iface = net_if_lookup_by_dev(eth);
	zassert_not_null(iface, "eth1 未绑定 net_if");
	zassert_equal(net_if_get_device(iface), eth,
		      "net_if 绑定的设备不是 eth1");
	zassert_equal(net_if_get_mtu(iface), NET_ETH_MTU,
		      "net_if MTU=%u != %u", net_if_get_mtu(iface), NET_ETH_MTU);

	link_addr = net_if_get_link_addr(iface);
	zassert_not_null(link_addr, "net_if link addr 为 NULL");
	zassert_not_null(link_addr->addr, "net_if link addr 缓冲区为 NULL");
	zassert_equal(link_addr->len, NET_ETH_ADDR_LEN,
		      "MAC 长度 %u != %u", link_addr->len, NET_ETH_ADDR_LEN);

	for (i = 0; i < NET_ETH_ADDR_LEN; i++) {
		or_all |= link_addr->addr[i];
		and_all &= link_addr->addr[i];
	}

	ZT_INFO("eth_dev_ready", "mac=%02x:%02x:%02x:%02x:%02x:%02x,mtu=%u,admin_up=%d",
		link_addr->addr[0], link_addr->addr[1], link_addr->addr[2],
		link_addr->addr[3], link_addr->addr[4], link_addr->addr[5],
		net_if_get_mtu(iface), (int)net_if_is_admin_up(iface));

	zassert_not_equal(or_all, 0x00, "MAC 地址全 0（未初始化）");
	zassert_not_equal(and_all, 0xFF, "MAC 地址全 0xFF（未初始化）");
	zassert_equal(link_addr->addr[0] & 0x01U, 0,
		      "MAC 首字节 0x%02x 的组播位置起（应为单播地址）",
		      link_addr->addr[0]);
}

/* ==================================================================
 * TC-5: PHY 链路状态可观测（功能通路，**弱判据** —— A 组，无需对端）
 *   走 phy_rt_rtl8211f_get_link()：加锁 -> 读 PHYSR(0x1A) -> 解码
 *   link/speed/duplex。**不断言 link 必须 up**（取决于对端是否激活），
 *   只断言读路径成功 + 若 up 则解码出的速率码合法 ⇒ 无对端也能确定判定。
 *   （原在 case_link 的 `eth_link` 套件内，按父会话裁定挪入 A 组。）
 * ================================================================== */
ZTEST(eth_mdio, eth_phy_link_state)
{
	const struct device *phy = eth_phy_dev();
	struct phy_link_state st = { 0 };
	int ret;

	zassert_true(device_is_ready(phy), "eth1_phy device is not ready");

	ret = phy_get_link_state(phy, &st);
	zassert_equal(ret, 0, "phy_get_link_state ret=%d", ret);

	/* mdio_reset_*：mdio1 的复位脉冲配置（DT 属性），用于**区分本变体**——
	 * case_mdio 为 0/0（脉冲子块不发脉冲），case_phy_reset 为 10/30（真发脉冲）。
	 * 见 mdio_dwmac.c:231/:252 的门 `reset_hold_ms && circuits_set_ms`。 */
	ZT_INFO("eth_phy_link_state",
		"link=%s,speed_mbps=%u,duplex=%s,speed_code=0x%02x,"
		"mdio_reset_hold_ms=%u,mdio_circuits_set_ms=%u",
		st.is_up ? "up" : "down", link_speed_mbps(st.speed),
		link_duplex_str(st.speed), (unsigned int)st.speed,
		(unsigned int)DT_PROP_OR(DT_NODELABEL(mdio1), reset_hold_ms, 0),
		(unsigned int)DT_PROP_OR(DT_NODELABEL(mdio1), circuits_set_ms, 0));

	if (st.is_up) {
		/* 链路已建立时，速率/双工必须能解码到 802.3 合法组合
		 * （10/100/1000 Mbps × half/full）。 */
		zassert_true(link_speed_is_valid(st.speed),
			     "link up 但解码出的速率码非法: 0x%02x", (unsigned int)st.speed);
	}
}

ZTEST_SUITE(eth_mdio, NULL, NULL, NULL, NULL, NULL);
```

## src/eth_phy_common.h
```c
/*
 * SPDX-License-Identifier: Apache-2.0
 *
 * PHY 链路状态公共辅助（工程内复用；case_mdio 与 case_link 两个源集共享）。
 *
 * 均为 static inline，随各 case 的源文件编入本 case 的镜像；
 * 不产生跨编译单元符号，也不引入链接依赖。
 */

#ifndef ETH_PHY_COMMON_H
#define ETH_PHY_COMMON_H

#include <zephyr/kernel.h>
#include <zephyr/device.h>
#include <zephyr/devicetree.h>
#include <zephyr/net/phy.h>

/* 板载 RTL8211F PHY（mdio1 下的 ethernet-phy@0） */
static inline const struct device *eth_phy_dev(void)
{
	return DEVICE_DT_GET(DT_NODELABEL(eth1_phy));
}

/* RTL8211F 的链路速率码 -> Mbps（PHYSR 的 LINKDUPLEX/LINKSPEED 位域解码） */
static inline unsigned int link_speed_mbps(enum phy_link_speed speed)
{
	if (PHY_LINK_IS_SPEED_1000M(speed)) {
		return 1000U;
	}
	if (PHY_LINK_IS_SPEED_100M(speed)) {
		return 100U;
	}
	return 10U;
}

static inline const char *link_duplex_str(enum phy_link_speed speed)
{
	return PHY_LINK_IS_FULL_DUPLEX(speed) ? "full" : "half";
}

/* 速率码是否为 802.3 合法组合（10/100/1000 Mbps × half/full） */
static inline bool link_speed_is_valid(enum phy_link_speed speed)
{
	return speed == LINK_HALF_10BASE_T || speed == LINK_FULL_10BASE_T ||
	       speed == LINK_HALF_100BASE_T || speed == LINK_FULL_100BASE_T ||
	       speed == LINK_HALF_1000BASE_T || speed == LINK_FULL_1000BASE_T;
}

#endif /* ETH_PHY_COMMON_H */
```

## src/eth_udp_echo_test.c
```c
/*
 * SPDX-License-Identifier: Apache-2.0
 *
 * Ethernet 测试 —— B 组数据面②：UDP 报文收发 + 载荷校验
 *
 * 覆盖对象：
 *   zephyr/drivers/ethernet/eth_dwmac.c  真实收发路径（dwmac_send / dwmac_receive
 *                                        + RX refill 线程 + 描述符环形队列）
 *   zephyr/subsys/net/ip/                  UDP 封装/IPv4 输出（含 ARP 解析）
 *   zephyr/subsys/net/lib/sockets/         zsock UDP socket 数据面
 *
 * 外部路径（SPEC_REFERENCE §6.6）：板载 RJ45 <-> PC 网口（网线）。
 *   对端要求：PC 网口激活 + 同网段静态 IPv4 + **PC 侧运行 UDP 回声程序**，
 *   把收到的报文原样送回板卡（详见 tests/COVERAGE.md「PC 侧前置条件」）。
 *
 * 判据设计（防 flaky）：
 *   - UDP 无连接，**首包 sendto 因 ARP 未解析而返回 EHOSTUNREACH 属正常**，
 *     故 sendto 失败只计数不硬判；用「N 次重试 + 每次独立超时」兜住。
 *   - 每次载荷带**序号**，回包必须与本次发出的字节**逐字节相等**才计入成功
 *     ⇒ 上一轮的迟到回包会被 memcmp 拒绝，不会造成假成功。
 *   - 命中 1 次即 PASS；统计值（发送/发送失败/接收/校验失败/丢包率/RTT）用
 *     ZT_INFO 上报，不做精确值断言。
 */

#include <zephyr/kernel.h>
#include <zephyr/device.h>
#include <zephyr/devicetree.h>
#include <zephyr/net/net_if.h>
#include <zephyr/net/net_ip.h>
#include <zephyr/net/socket.h>
#include <zephyr/ztest.h>
#include <string.h>

#include "ztest_glue.h"   /* ZT_INFO 约定行（SPEC_REFERENCE §6.5.4） */

/* 约定值（P6 按实际网络调整时只改 prj.conf 的 CONFIG_NET_CONFIG_* 两行） */
#define LOCAL_IPV4   CONFIG_NET_CONFIG_MY_IPV4_ADDR
#define PEER_IPV4    CONFIG_NET_CONFIG_PEER_IPV4_ADDR

/* UDP 回声端口：必须与 PC 侧回声程序监听/回送的端口一致 */
#define UDP_ECHO_PORT   5001U

/* 重试窗口：5 次 × 2 s 上限 = 10 s，远小于 case_timeout */
#define UDP_ATTEMPTS     5U
#define UDP_TIMEOUT_MS   2000
#define UDP_PAYLOAD_LEN  32U

/* 载荷构造：magic + 序号 + 滚动字节。发送与校验共用，保证可逐字节比对。 */
static void build_payload(uint8_t *buf, uint16_t seq)
{
	buf[0] = 0x45U;                       /* 'E' */
	buf[1] = 0x54U;                       /* 'T' */
	buf[2] = (uint8_t)(seq & 0xFFU);
	buf[3] = (uint8_t)(seq >> 8);
	for (uint32_t i = 4; i < UDP_PAYLOAD_LEN; i++) {
		buf[i] = (uint8_t)(0xA5U + i);
	}
}

ZTEST(eth_udp_echo, eth_udp_echo)
{
	const struct device *eth = DEVICE_DT_GET(DT_NODELABEL(eth1));
	struct net_if *iface;
	struct sockaddr_in peer = { 0 };
	struct in_addr local;
	uint8_t tx[UDP_PAYLOAD_LEN];
	uint8_t rx[UDP_PAYLOAD_LEN * 2];      /* 稍大，便于识别异常长度 */
	uint32_t sent = 0;
	uint32_t send_fail = 0;
	uint32_t rx_total = 0;
	uint32_t rx_bad = 0;
	uint32_t verified = 0;
	int64_t rtt_last_us = 0;
	int64_t rtt_min_us = 0;
	int64_t rtt_max_us = 0;
	int ret;
	int sock;

	iface = net_if_lookup_by_dev(eth);
	zassert_not_null(iface, "eth1 未绑定 net_if");

	/* 1) 静态 IPv4 配置生效（CONFIG_NET_CONFIG_MY_IPV4_ADDR 由 net_config 写入） */
	ret = net_addr_pton(AF_INET, LOCAL_IPV4, &local);
	zassert_equal(ret, 0, "本机地址 \"%s\" 解析失败", LOCAL_IPV4);

	if (net_if_ipv4_addr_lookup(&local, NULL) == NULL) {
		struct net_if_addr *added =
			net_if_ipv4_addr_add(iface, &local, NET_ADDR_MANUAL, 0);

		zassert_not_null(added, "静态 IPv4 \"%s\" 既未配置也无法添加", LOCAL_IPV4);
	}

	/* 2) 对端地址（约定值） */
	peer.sin_family = AF_INET;
	peer.sin_port = htons(UDP_ECHO_PORT);
	ret = net_addr_pton(AF_INET, PEER_IPV4, &peer.sin_addr);
	zassert_equal(ret, 0, "对端地址 \"%s\" 解析失败", PEER_IPV4);

	/* 3) UDP socket */
	sock = zsock_socket(AF_INET, SOCK_DGRAM, IPPROTO_UDP);
	zassert_true(sock >= 0, "zsock_socket ret=%d", sock);

	/* 4) N 次重试：每次独立超时；命中 1 次逐字节相符的回包即通过 */
	for (uint32_t i = 0; i < UDP_ATTEMPTS; i++) {
		int64_t deadline;
		int64_t t0;
		bool ok = false;

		build_payload(tx, (uint16_t)i);
		t0 = k_uptime_get();

		ret = zsock_sendto(sock, tx, sizeof(tx), 0,
				   (struct sockaddr *)&peer, sizeof(peer));
		if (ret < 0) {
			/* ARP 尚未解析 / 无路由等：只计数，继续下一轮 */
			send_fail++;
			continue;
		}
		sent++;

		deadline = t0 + UDP_TIMEOUT_MS;
		while (k_uptime_get() < deadline) {
			struct zsock_pollfd pfd = { .fd = sock, .events = ZSOCK_POLLIN };
			int64_t left = deadline - k_uptime_get();
			struct sockaddr_in from = { 0 };
			socklen_t from_len = sizeof(from);
			int pr;
			int n;

			if (left <= 0) {
				break;
			}

			pr = zsock_poll(&pfd, 1, (int)left);
			if (pr <= 0) {
				break;
			}

			n = zsock_recvfrom(sock, rx, sizeof(rx), 0,
					   (struct sockaddr *)&from, &from_len);
			if (n < 0) {
				break;
			}

			rx_total++;

			if ((uint32_t)n == sizeof(tx) &&
			    memcmp(rx, tx, sizeof(tx)) == 0) {
				int64_t rtt = (k_uptime_get() - t0) * 1000;   /* ms -> us */

				verified++;
				ok = true;
				rtt_last_us = rtt;
				if (rtt_min_us == 0 || rtt < rtt_min_us) {
					rtt_min_us = rtt;
				}
				if (rtt > rtt_max_us) {
					rtt_max_us = rtt;
				}
				break;
			}

			/* 长度或内容不符（可能是上一轮迟到回包）：继续等本轮 */
			rx_bad++;
		}

		if (ok) {
			break;                /* 一次成功即证明收发通路 */
		}
	}

	(void)zsock_close(sock);

	ZT_INFO("eth_udp_echo",
		"peer=%s:%u,local=%s,sent=%u,send_fail=%u,rx_total=%u,rx_bad=%u,"
		"verified=%u,rtt_us=%ld,rtt_min_us=%ld,rtt_max_us=%ld",
		PEER_IPV4, UDP_ECHO_PORT, LOCAL_IPV4,
		sent, send_fail, rx_total, rx_bad, verified,
		(long)rtt_last_us, (long)rtt_min_us, (long)rtt_max_us);

	/* 5) 判据：至少 1 次「逐字节相符」的回包 */
	zassert_true(verified > 0,
		     "对端 %s:%u 在 %u 次尝试（每次 %d ms）内无相符回包 "
		     "(sent=%u,send_fail=%u,rx_total=%u,rx_bad=%u)："
		     "需确认 PC 侧 UDP 回声程序已运行且端口一致、PC 与板卡同网段",
		     PEER_IPV4, UDP_ECHO_PORT, UDP_ATTEMPTS, UDP_TIMEOUT_MS,
		     sent, send_fail, rx_total, rx_bad);
}

ZTEST_SUITE(eth_udp_echo, NULL, NULL, NULL, NULL, NULL);
```
