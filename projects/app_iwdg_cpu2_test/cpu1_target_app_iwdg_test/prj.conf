## CMakeLists.txt
```
# SPDX-License-Identifier: Apache-2.0
# app_iwdg_cpu2_test - cpu1 (target) side CMakeLists.txt
#
# 双核工程（SPEC_REFERENCE §6.1.10）：本目录存在即构成"有 cpu1 之外的固件
# 目录"中的 cpu1 侧；另一侧为 cpu2_controller_app_iwdg_test。

cmake_minimum_required(VERSION 3.20.0)
find_package(Zephyr REQUIRED HINTS $ENV{ZEPHYR_BASE})
project(cpu1_target_app_iwdg_test)

# ztest 单出口覆盖点（SPEC_REFERENCE §6.9.3/§6.11.5）：本核为从核，把 ztest 的
# `PRINT_DATA` 指向 RLOG。覆盖头必须对**所有** TU 可见（ztest 库自己也用
# PRINT_DATA）⇒ 用 zephyr_include_directories 挂到 zephyr_interface。
zephyr_include_directories(${CMAKE_CURRENT_SOURCE_DIR}/src)

target_sources(app PRIVATE
    src/main.c
    src/app_iwdg_domain_test.c)

target_include_directories(app PRIVATE
    ${CMAKE_CURRENT_SOURCE_DIR}/../tests/include)

include(${CMAKE_CURRENT_SOURCE_DIR}/../../../common/common_sources.cmake)

# RLOG 单出口（SPEC_REFERENCE §6.9.3）：只在本工程编入 —— 其余工程没有
# `rlog_channel` 设备树节点，编进去会因 DT_NODELABEL 取不到而构建失败。
target_sources(app PRIVATE
    ${CMAKE_CURRENT_SOURCE_DIR}/../../../common/rlog.c)

# ztest 单出口的长行预算（common/rlog.h::RLOG_TEXT_MAX 说明）：逐项 D1 行
# 可长到 ~56B（测试名 + " in X.XXX seconds"），默认 54B 会把结尾的
# 'seconds' 截掉 ⇒ 逐项证据被静默吞掉。两核取同一值（帧是双方 ABI），
# 且 overlay 的通道 width 必须 ≥ RLOG_TEXT_MAX+9（此处 118+9=127 ≤ 128）。
target_compile_definitions(app PRIVATE RLOG_TEXT_MAX=118)
```

## prj.conf
```kconfig
CONFIG_LOG=y
CONFIG_LOG_MODE_DEFERRED=y
CONFIG_LOG_BUFFER_SIZE=16384
CONFIG_LOG_PROCESS_THREAD_SLEEP_MS=10
CONFIG_SERIAL=y
CONFIG_SHELL=n
CONFIG_ZTEST=y
CONFIG_ZTEST_ASSERT_VERBOSE=1
CONFIG_ZTEST_VERBOSE_OUTPUT=y
CONFIG_ZTEST_SUMMARY=n
CONFIG_PICOLIBC=y
CONFIG_NEWLIB_LIBC=n
CONFIG_MINIMAL_LIBC=n
CONFIG_GPIO=y

# RLOG 单出口（SPEC_REFERENCE §6.9.3）：从核经 mbox 把 token 交给主核统一打印
CONFIG_MBOX=y
# ztest 输出换后端（§6.11.5）：tc_util.h 在定义 PRINT_DATA 前 include
# `tc_util_user_override.h`（见本核 src/），把逐项输出指向 RLOG。
CONFIG_ZTEST_TC_UTIL_USER_OVERRIDE=y
```

## app.overlay
```dts
/*
 * app_iwdg_cpu2_test - cpu1 (target) side overlay
 *
 * cpu1 是 2os 的引导核（负责释放 cpu2），本身不是被测对象：
 * app_iwdg@0x40099000 属 cpu2 应用域，cpu1 板级 dts 不使能该节点
 * （本文件**不得**使能 app_iwdg——cpu1 侧用例显式断言该节点非 okay）。
 *
 * 控制台用板级默认 uart1（PN04/PN03）。GPIO toggle 片段按复用收敛原则
 * 引用公共层（SPEC_REFERENCE §6.1.9）。
 */

#include "../../../common/gpio_toggle.dtsi"

/ {
	chosen {
		zephyr,console = &uart1;
		zephyr,shell-uart = &uart1;
	};
};

/* RLOG 单出口通道（SPEC_REFERENCE §6.9.3）：两核 token 汇成一路串口流。
 * `channel` 单元格必须等于本节点在 `&mbox` 子节点中的**序号**（驱动按
 * DT_INST_FOREACH_CHILD_STATUS_OKAY 的遍历序索引 FIFO），**以 zephyr.dts
 * 里 `&mbox` 的子节点顺序为准**，不要按固定数字或板级占用数推断：板级现有
 * 5 个 consumer（qspi/otbn/espi/vuart/pcc1 = 0..4），本项目追加 ⇒ 序号 5。
 * 两核必须一致；宽 128 与本工程 RLOG 帧长（127B）匹配。 */
&mbox {
	rlog_channel: rlog_channel {
		compatible = "vnd,mbox-consumer";
		mboxes = <&mbox 5 128 8 128 8>;
		mbox-names = "mbox";
	};
};
```

## src/main.c
```c
/*
 * SPDX-License-Identifier: Apache-2.0
 *
 * app_iwdg_cpu2_test - cpu1 侧入口（2os TARGET 核，常驻监督）
 *
 * 职责边界：cpu1 是 2os 的引导核，负责释放 cpu2 并在 cpu2 被 app_iwdg
 * 触发 HART 复位期间保持在线。它不是本案被测对象（app_iwdg 的复位原因
 * 由 cpu2 侧 reset_reason_init() 的 SYSC_APP_PER 分支产生，cpu1 读不到）。
 */

#include <zephyr/kernel.h>
#include <zephyr/logging/log.h>

#include "app_iwdg_test_protocol.h"
#include "ztest_glue.h"
#include "rlog.h"
#include "test_results.h"

LOG_MODULE_REGISTER(app_iwdg_cpu1_main, LOG_LEVEL_INF);

void test_main(void)
{
	/* 单出口（SPEC_REFERENCE §6.9.3/§6.11.5）：本核是**从核**（ztest 型）⇒
	 * 不往自己的串口打 token。ztest 的逐项输出经 `tc_util_user_override.h`
	 * 把 PRINT_DATA 指向 RLOG 自动换出口；BOOT/INFO 走公共宏的 printk 路径
	 * （不经 PRINT_DATA）⇒ 此处显式换出口。本核 LOG / panic / assert 现场
	 * 仍走本核串口。 */
	rlog_secondary_init();

	LOG_INF("[CPU1 APP_IWDG] resident supervisor entry");
	RLOG_ZT_BOOT("TGT");
	zt_run_all();

	/* 本核结论（与主核同源：zt_run_all 按 ztest stats 记入 test_results[]）。
	 * DONE 帧是**本核发出的最后一条**：主核等到它才打自己的 PROJECT
	 * EXECUTION（§6.9.3 硬约束：完成标记必须是整条流最后一个）。 */
	bool any_fail = false;

	for (int i = 0; i < TR_MAX_COUNT; i++) {
		if (test_results[i] == TR_FAIL) {
			any_fail = true;
			break;
		}
	}
	rlog_emit_done(!any_fail, any_fail ? "PROJECT EXECUTION FAILED"
					   : "PROJECT EXECUTION SUCCESSFUL");

	/* 2os 引导核常驻：不得返回（SPEC_REFERENCE §6.1.1） */
	k_sleep(K_FOREVER);
}
```

## src/app_iwdg_domain_test.c
```c
/*
 * SPDX-License-Identifier: Apache-2.0
 *
 * app_iwdg_cpu2_test - cpu1 侧结构守卫用例
 *
 * cpu1 无被测对象（app_iwdg 是 cpu2 外设），本套件锁定的是"为什么本案必须
 * 拆成独立 cpu2 工程"这一结构事实，防止后续有人把 app_iwdg 用例塞回单核
 * 工程（roadmap §4「通用规则」）：
 *   - app_iwdg 节点在 cpu1 板级 dts 上未使能；
 *   - cpu1 侧 reset_reason_init() 走 SEC_PMU/SEC_PER 分支，不产生
 *     APP_IWDT_HART_RESET（`soc_reset_reason.c` 的
 *     `DT_NODE_HAS_STATUS(DT_NODELABEL(cpu1), okay)` 分支）。
 *
 * 本套件全部为**结构守卫**（编译期事实的运行期断言），非行为验证；
 * 真正的行为验证在 cpu2 侧 app_iwdg 套件。
 */

#include <zephyr/kernel.h>
#include <zephyr/device.h>
#include <zephyr/devicetree.h>
#include <zephyr/ztest.h>

#include "ztest_glue.h"
#include "rlog.h"
#include "soc_reset.h"

ZTEST(app_iwdg_domain, test_cpu1_does_not_own_app_iwdg)
{
	zassert_false(DT_NODE_HAS_STATUS(DT_NODELABEL(app_iwdg), okay),
		      "cpu1 板级不应使能 app_iwdg（它是 cpu2 应用域外设）");
}

ZTEST(app_iwdg_domain, test_cpu1_reset_reason_not_app_iwdt)
{
	uint32_t reason = reset_reason_get();

	/* 单出口：INFO 是四类标记之一（§6.9.1）⇒ 不能留在本核串口 */
	RLOG_ZT_INFO("test_cpu1_reset_reason_not_app_iwdt", "reason=%u", reason);
	zassert_not_equal(reason, APP_IWDT_HART_RESET,
			  "cpu1 不应报告 APP_IWDT_HART_RESET（该枚举仅 cpu2 侧分支产生），实际 %u",
			  reason);
}

ZTEST_SUITE(app_iwdg_domain, NULL, NULL, NULL, NULL, NULL);
```
