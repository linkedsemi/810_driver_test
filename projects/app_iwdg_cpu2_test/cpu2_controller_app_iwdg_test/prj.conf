## CMakeLists.txt
```
# SPDX-License-Identifier: Apache-2.0
# app_iwdg_cpu2_test - cpu2 (controller) side CMakeLists.txt
#
# 注意：EXTRA_DTC_OVERLAY_FILE 必须在 find_package 之前。

cmake_minimum_required(VERSION 3.20.0)

# cpu2 侧必须注入（find_package 之前）：
#   cpu2_console_uart5.overlay  - 控制台 uart5（PN14/PN13, 115200）
#   cpu2_mem_layout.overlay     - 内存布局（sram_ro/sram 地址与大小）
set(EXTRA_DTC_OVERLAY_FILE
    ${CMAKE_CURRENT_SOURCE_DIR}/../../../common/cpu2_console_uart5.overlay;
    ${CMAKE_CURRENT_SOURCE_DIR}/../../../common/cpu2_mem_layout.overlay)

find_package(Zephyr REQUIRED HINTS $ENV{ZEPHYR_BASE})
project(cpu2_controller_app_iwdg_test)

target_sources(app PRIVATE
    src/main.c)

# case 变体（见本目录 Kconfig）：只编入被选中的那份用例实现，
# 使各 case 的构建输入互不重叠。
if(CONFIG_APP_IWDG_TEST_CASE_ID EQUAL 1)
    target_sources(app PRIVATE src/app_iwdg_quick_test.c)
elseif(CONFIG_APP_IWDG_TEST_CASE_ID EQUAL 2)
    target_sources(app PRIVATE src/app_iwdg_quick_invalid_test.c)
elseif(CONFIG_APP_IWDG_TEST_CASE_ID EQUAL 3)
    target_sources(app PRIVATE src/app_iwdg_reset_test.c)
else()
    target_sources(app PRIVATE src/app_iwdg_test.c)
endif()

target_include_directories(app PRIVATE
    ${CMAKE_CURRENT_SOURCE_DIR}/../tests/include)

include(${CMAKE_CURRENT_SOURCE_DIR}/../../../common/common_sources.cmake)

# RLOG 单出口（SPEC_REFERENCE §6.9.3）：主核收从核 token 行并加核信封转发。
target_sources(app PRIVATE
    ${CMAKE_CURRENT_SOURCE_DIR}/../../../common/rlog.c)

# ztest 单出口的长行预算（common/rlog.h::RLOG_TEXT_MAX 说明）：逐项 D1 行
# 可长到 ~56B（测试名 + " in X.XXX seconds"），默认 54B 会把结尾的
# 'seconds' 截掉 ⇒ 逐项证据被静默吞掉。两核取同一值（帧是双方 ABI），
# 且 overlay 的通道 width 必须 ≥ RLOG_TEXT_MAX+9（此处 118+9=127 ≤ 128）。
target_compile_definitions(app PRIVATE RLOG_TEXT_MAX=118)
```

## Kconfig
```
# SPDX-License-Identifier: Apache-2.0
#
# app_iwdg_cpu2_test cpu2 (controller) 应用 Kconfig 根。
# 必须先引入 Zephyr 主配置树，否则整个符号树缺失（prj.conf 全部报
# "undefined symbol" 并中止构建）。
source "$(ZEPHYR_BASE)/Kconfig.zephyr"

# case 选择：一个 firmware 目录 + 四种构建输入，case 差异只体现在
# tests/case_*/controller.conf + controller.overlay（SPEC_REFERENCE §6.1.8）。
#
#   0 = case_non_destructive     ztest：app_iwdg API 通路 / 异常参数 / 边界
#   1 = case_quick_enable        ztest：iwdt_init quick-enable 正常分支
#   2 = case_quick_invalid       ztest：iwdt_init quick-timeout-ms=0 -> -EINVAL
#   3 = case_reset               自定义 main：app_iwdg HART 复位 + 复位原因回读
#
# ⚠ ZTEST_SUITE 槽位纪律（qsh-test-gen §1.4 第 8 条）由各用例实现文件自行遵守。

config APP_IWDG_TEST_CASE_ID
	int "app_iwdg_cpu2_test case id (0 = non-destructive ztest)"
	default 0
	help
	  0..2 = ztest 用例，3 = 破坏性 HART 复位状态机。
	  取值与 tests/include/app_iwdg_test_protocol.h 的 APP_IWDG_TEST_CASE_* 一一对应。
```

## prj.conf
```kconfig
CONFIG_LOG=y
CONFIG_LOG_MODE_DEFERRED=y
CONFIG_LOG_BUFFER_SIZE=16384
CONFIG_LOG_PROCESS_THREAD_SLEEP_MS=10
CONFIG_SERIAL=y
CONFIG_SHELL=n
CONFIG_ZTEST=y
CONFIG_ZTEST_ASSERT_VERBOSE=1
CONFIG_ZTEST_VERBOSE_OUTPUT=y
CONFIG_ZTEST_SUMMARY=n
CONFIG_WATCHDOG=y
# 驱动 iwdt_init 的 WDT_DISABLE_AT_BOOT 分支保持关闭：cpu2 侧用例依赖
# quick-enable 的启动态可观测（case_quick_enable）。
CONFIG_WDT_DISABLE_AT_BOOT=n
CONFIG_PICOLIBC=y
CONFIG_NEWLIB_LIBC=n
CONFIG_MINIMAL_LIBC=n
CONFIG_GPIO=y

# RLOG 单出口（SPEC_REFERENCE §6.9.3）：主核收从核 token 行并加核信封转发
CONFIG_MBOX=y
```

## app.overlay
```dts
/*
 * app_iwdg_cpu2_test - cpu2 (controller) side overlay
 *
 * 控制台走公共层 cpu2_console_uart5.overlay（uart5, PN14/PN13, 115200）。
 * 本文件只声明被测实例：app_iwdg@0x40099000（HART 复位域，cpu2）。
 * 注意 cpu2 侧**不得** include gpio_toggle.dtsi（GPIOA 双核共享，
 * common_sources.cmake 已按 BOARD_QUALIFIERS 把 gpio_toggle.c 排除在 cpu2 外）。
 */

&app_iwdg {
	status = "okay";
};

/* RLOG 单出口通道（SPEC_REFERENCE §6.9.3）：两核 token 汇成一路串口流。
 * `channel` 单元格必须等于本节点在 `&mbox` 子节点中的**序号**（驱动按
 * DT_INST_FOREACH_CHILD_STATUS_OKAY 的遍历序索引 FIFO），**以 zephyr.dts
 * 里 `&mbox` 的子节点顺序为准**，不要按固定数字或板级占用数推断：板级现有
 * 5 个 consumer（qspi/otbn/espi/vuart/pcc1 = 0..4），本项目追加 ⇒ 序号 5。
 * 两核必须一致；宽 128 与本工程 RLOG 帧长（127B）匹配。 */
&mbox {
	rlog_channel: rlog_channel {
		compatible = "vnd,mbox-consumer";
		mboxes = <&mbox 5 128 8 128 8>;
		mbox-names = "mbox";
	};
};
```

## src/main.c
```c
/*
 * SPDX-License-Identifier: Apache-2.0
 *
 * app_iwdg_cpu2_test - cpu2 (controller) side entry point
 *
 * case 由本目录 Kconfig 的 APP_IWDG_TEST_CASE_ID 选择（见 CMakeLists.txt）：
 *   0..2 = ztest 用例（非破坏性）
 *   3    = app_iwdg HART 复位状态机（破坏性，永不返回）
 */

#include <zephyr/kernel.h>
#include <zephyr/logging/log.h>

#include "app_iwdg_test_protocol.h"
#include "ztest_glue.h"
#include "rlog.h"
#include "test_results.h"

LOG_MODULE_REGISTER(app_iwdg_cpu2_main, LOG_LEVEL_INF);

#if defined(CONFIG_APP_IWDG_TEST_CASE_ID) && (CONFIG_APP_IWDG_TEST_CASE_ID == 3)
extern void app_iwdg_reset_main(void);
#endif

void test_main(void)
{
#if defined(CONFIG_APP_IWDG_TEST_CASE_ID) && (CONFIG_APP_IWDG_TEST_CASE_ID == 3)
	/* 破坏性复位状态机：内部 k_sleep(K_FOREVER)，不返回 */
	app_iwdg_reset_main();
#else
	LOG_INF("[CPU2 APP_IWDG] app_iwdg case %d entry",
		(int)CONFIG_APP_IWDG_TEST_CASE_ID);
	LOG_INF("[CPU2 APP_IWDG] non-destructive suite: install/query only, "
		"the watchdog is never allowed to fire -> no reset here. "
		"Real reset: CASE_ID 3 (standalone) or `itest hwreset app_iwdg`");
	zt_init("CTRL");

	/* 单出口（SPEC_REFERENCE §6.9.3）：本核是主核（唯一串口出口），收下从核
	 * 经 RLOG 送来的 token 行，加**核信封**原样转发。信封是分拣凭据
	 * （§6.9.4）：采集侧按 `<前缀>:TGT:` 把它们搬回 serial_TGT.log。 */
	rlog_primary_init();
	rlog_set_relay_envelope(APP_IWDG_TEST_PREFIX, "TGT");

	zt_run_all();

	/* 等从核 DONE（期间反复 drain，给从核 FIFO/环腾空间）。fail-closed
	 * （§6.9.3）：没等到 DONE、或接收侧跳号/坏帧/缓冲满 ⇒ 判失败 —— 绝不把
	 * "没收到从核结果"当成"通过"。 */
	bool sec_ok = rlog_wait_secondary_done(RLOG_TX_TIMEOUT_MS);
	bool any_fail = !sec_ok || (rlog_lost() != 0U);

	if (!sec_ok) {
		printk("[CTRL] secondary check FAILED: %s lost=%u\n",
		       rlog_secondary_silent() ? "SECONDARY_SILENT"
					       : "SECONDARY_INCOMPLETE",
		       (unsigned)rlog_lost());
	}
	for (int i = 0; i < TR_MAX_COUNT; i++) {
		if (test_results[i] == TR_FAIL) {
			any_fail = true;
			break;
		}
	}
	printk("PROJECT EXECUTION %s\n", any_fail ? "FAILED" : "SUCCESSFUL");

	/* cpu2 是被测量核：套件结束后保持在线（不返回，§6.1.1）。
	 * 不返回也保证 ztest 强 main() 的 TC_END_REPORT 不会在本核**再补**一条
	 * 晚于从核 DONE 的收尾标记（§6.9.3 硬约束）。 */
	k_sleep(K_FOREVER);
#endif
}
```

## src/app_iwdg_quick_invalid_test.c
```c
/*
 * SPDX-License-Identifier: Apache-2.0
 *
 * app_iwdg quick-enable 非法参数用例（cpu2，case_quick_invalid = CASE_ID 2）
 *
 * 覆盖驱动 iwdt_init 的 quick_timeout_ms == 0 拒绝分支
 * （wdt_iwdg_ls.c:175-179）：init 打 LOG_ERR 并 return -EINVAL，
 * 其结果在 Zephyr 设备模型中的可观测形态 = 该设备 init 失败、未就绪
 * （state->init_res == EINVAL，见 kernel/init.c:311-326 与
 * device.h:380-394 的"正值 errno"语义）。
 *
 * controller.overlay 设 quick-enable; quick-timeout-ms = <0>。
 * 本 case 只有一个测试项：设备不可用意味着本套件不应再调用任何 wdt_* API。
 *
 * 2026-09-18（F5 波）：原唯一断言是 device_is_ready()==false 的裸否定，
 * 不能区分"驱动按 quick-timeout-ms=0 拒绝"与"别的原因根本没起来"；
 * 现加三级正控（DT 前置条件 / init 已执行 / init_res==EINVAL）。
 */

#include <zephyr/kernel.h>
#include <zephyr/device.h>
#include <zephyr/devicetree.h>
#include <zephyr/drivers/watchdog.h>
#include <zephyr/ztest.h>
#include <errno.h>

#include "ztest_glue.h"

ZTEST(app_iwdg_quick_invalid, test_quick_timeout_zero_leaves_device_unready)
{
	const struct device *dev = DEVICE_DT_GET(DT_NODELABEL(app_iwdg));
	bool ready = device_is_ready(dev);

	ZT_INFO("test_quick_timeout_zero_leaves_device_unready",
		"ready=%d,initialized=%d,init_res=%u", (int)ready,
		(dev != NULL && dev->state != NULL) ? (int)dev->state->initialized : -1,
		(dev != NULL && dev->state != NULL) ?
			(unsigned)dev->state->init_res : 0u);

	/* 结论断言：设备模型可观测形态 = 未就绪 */
	zassert_false(ready,
		      "quick-enable + quick-timeout-ms=0 应使 iwdt_init 返回 -EINVAL"
		      "（设备未就绪），实际 ready=%d", (int)ready);

	/* ================= 正控（本轮新增，堵"裸否定断言"空壳）=================
	 * 原实现唯一断言是上面的 zassert_false(device_is_ready(dev))：设备未
	 * 就绪的**任何**原因（节点 disabled / 驱动未编入 / 无关 init 失败 /
	 * overlay 没生效 / 根本没跑到这里）都会让它 PASS，无法区分"驱动按
	 * quick-timeout-ms=0 拒绝"与"别的原因根本没起来"。
	 * 下面按 前置条件 → init 已执行 → 失败原因精确匹配 三级收窄：
	 */

	/* 1. 前置条件（DT 层）：节点 okay、驱动已编入、overlay 的拒绝参数确实
	 *    生效。这三条把"节点 disabled / 配置写错 / overlay 缺失"排掉 ——
	 *    若 overlay 没生效，下面的 quick 参数断言先炸。（DT_PROP_OR 的默认
	 *    值 -1 使属性缺失时判为"不是 0"，不依赖编译期报错。） */
	zassert_true(DT_NODE_HAS_STATUS(DT_NODELABEL(app_iwdg), okay),
		     "app_iwdg node is not okay in the merged DTS");
	zassert_true(IS_ENABLED(CONFIG_WATCHDOG),
		     "CONFIG_WATCHDOG is off: wdt_iwdg_ls driver not built");
	zassert_true(DT_NODE_HAS_PROP(DT_NODELABEL(app_iwdg), quick_enable),
		     "overlay did not set quick-enable on app_iwdg");
	zassert_equal(DT_PROP_OR(DT_NODELABEL(app_iwdg), quick_timeout_ms, -1), 0,
		      "overlay quick-timeout-ms is not 0 (case conf/overlay wrong)");

	/* 2. init 函数确已执行：Zephyr 设备模型在 do_device_init() 里**无条件**
	 *    置 state->initialized=true（zephyr/kernel/init.c:311-326），失败时
	 *    把**正值** errno 写入 state->init_res。initialized==false 意味着
	 *    init 根本没被调用（设备未链接进镜像）—— 那样"未就绪"不构成证据。 */
	zassert_true(dev != NULL && dev->state != NULL,
		     "device handle/state is NULL (driver not linked?)");
	zassert_true(dev->state->initialized,
		     "iwdt_init was never invoked (device not in the image)");

	/* 3. 失败原因精确匹配：iwdt_init 只有三条返回路径 —— -ENODEV（时钟
	 *    设备未就绪，:155-158）/ 时钟使能失败（:161-165）/ -EINVAL
	 *    （quick_timeout_ms==0，:175-179，见 wdt_iwdg_ls.c）。
	 *    init_res 存正值 errno ⇒ 等于 EINVAL(22) **唯一**指向
	 *    quick-timeout-ms 拒绝分支，排除其余全部原因。 */
	zassert_equal(dev->state->init_res, (uint8_t)EINVAL,
		      "iwdt_init failed with init_res=%u, not EINVAL(22): "
		      "device is unready for a different reason than the "
		      "quick_timeout_ms==0 rejection",
		      (unsigned)dev->state->init_res);
}

ZTEST_SUITE(app_iwdg_quick_invalid, NULL, NULL, NULL, NULL, NULL);
```

## src/app_iwdg_quick_test.c
```c
/*
 * SPDX-License-Identifier: Apache-2.0
 *
 * app_iwdg quick-enable 用例（cpu2，case_quick_enable = CASE_ID 1）
 *
 * 覆盖驱动 iwdt_init 的 quick_enable 正常分支（wdt_iwdg_ls.c:172-184）：
 *   quick_enable == true && quick_timeout_ms > 0
 *     -> IWDT_LOAD = quick_timeout_ms 换算 ticks
 *     -> IWDT_CTRL  = IWDT_RST_EN | IWDT_EN（POST_KERNEL 阶段即启动）
 *
 * 本 case 通过 controller.overlay 给 app_iwdg 加 `quick-enable` 与
 * `quick-timeout-ms`——这是本案新开独立工程后**新增**的覆盖能力
 * （sec_iwdg_cpu1_test 受"只增不改"约束无法引入该 DT 配置）。
 *
 * 顺序无关性说明：启动态只能在内核 init 之后、任何 install_timeout 之前
 * 观测（install_timeout 会写 CTRL=0）。为避免依赖 ztest 链接序
 * （SORT_BY_NAME，SPEC_REFERENCE §10.27），本 case 用**单个**测试项
 * 内部固定顺序 观测 -> feed -> disable。
 */

#include <zephyr/kernel.h>
#include <zephyr/device.h>
#include <zephyr/devicetree.h>
#include <zephyr/drivers/watchdog.h>
#include <zephyr/ztest.h>
#include <errno.h>

#include "ztest_glue.h"

#define IWDG_LOAD_WORD 0u
#define IWDG_CTRL_WORD 1u

#define APP_IWDG_REGS ((volatile uint32_t *)DT_REG_ADDR(DT_NODELABEL(app_iwdg)))

#define IWDG_CTRL_ENABLED 0x3u

/*
 * controller.overlay 设 quick-timeout-ms = <60000>；
 * ticks = 60000 * 32768 / 1000 = 1966080（不回绕）。
 */
#define QUICK_TIMEOUT_MS 60000u
#define QUICK_TICKS 1966080u

ZTEST(app_iwdg_quick, test_quick_enable_boot_state_feed_disable)
{
	const struct device *dev = DEVICE_DT_GET(DT_NODELABEL(app_iwdg));

	zassert_true(device_is_ready(dev), "app_iwdg not ready");

	/* 1. 启动态：quick_enable 应在 POST_KERNEL 阶段就把看门狗跑起来 */
	uint32_t load = APP_IWDG_REGS[IWDG_LOAD_WORD];
	uint32_t ctrl = APP_IWDG_REGS[IWDG_CTRL_WORD];

	ZT_INFO("test_quick_enable_boot_state_feed_disable",
		"ms=%u,load=%u,ctrl=0x%x", QUICK_TIMEOUT_MS, load, ctrl);
	zassert_equal(load, QUICK_TICKS,
		      "IWDT_LOAD=%u after quick-enable(%ums), expected %u",
		      load, QUICK_TIMEOUT_MS, QUICK_TICKS);
	zassert_equal(ctrl, IWDG_CTRL_ENABLED,
		      "IWDT_CTRL=0x%x after quick-enable, expected 0x%x (RST_EN|EN)",
		      ctrl, IWDG_CTRL_ENABLED);

	/* 2. 喂狗通路在 quick-enable 态下同样可用 */
	int feed = wdt_feed(dev, 0);

	zassert_equal(feed, 0, "feed after quick-enable returned %d, expected 0", feed);

	/* 3. 关闭，避免 60s 超时影响后续 */
	int dis = wdt_disable(dev);

	zassert_equal(dis, 0, "disable returned %d, expected 0", dis);

	/* ★ 2026-09-21：先把 disable 后的 `IWDT_CTRL` 实际值**采出来**再断言。
	 *
	 * 原断言直接判"整寄存器 == 0"，且失败消息不带实测值 ⇒ 2026-09-21 那轮
	 * 回归只知道"非 0"、**不知道非 0 的是哪一位**，该 FAIL 至今无法判定：
	 * 是硬件留存位（`KNOWN_ISSUES #92` 已记 feed 后 `IWDT_CNT_CLR`(bit3)
	 * 会留存），还是 disable 压根没生效。二者的处置完全不同。
	 *
	 * **本条不放宽任何判据**（仍断言整寄存器为 0），只补采数 —— 下次回归
	 * 即可从 INFO 行直接读出位值，把"无法判定"变成"可判定"。
	 * 两条 INFO 同名不冲突：解析器是 `infos.setdefault(name, {}).update(...)`
	 * （`common/ztest_report.py:184`），按 key 合并而非整条覆盖。 */
	uint32_t ctrl_after = APP_IWDG_REGS[IWDG_CTRL_WORD];

	ZT_INFO("test_quick_enable_boot_state_feed_disable",
		"ctrl_after_disable=0x%x", ctrl_after);

	/* 判据取"看门狗确已关闭"的**语义位** `EN|RST_EN`，而不是整寄存器为 0。
	 *
	 * ★ 2026-09-22 上板实测（`OPEN_ITEMS` O-32）：disable 后 `IWDT_CTRL = 0x8`
	 *   —— **只有 bit3 `IWDT_CNT_CLR` 残留**，bit0 `EN` 与 bit1 `RST_EN`
	 *   **均已清零** ⇒ `iwdt_ls_disable()` 确已生效。
	 *   该残留位是**硬件清计数类位的留存行为**（`KNOWN_ISSUES #92` 已记同一
	 *   寄存器在 `feed` 后留存 bit3），disable 本就清不掉它 ⇒ 原判据
	 *   "整寄存器 == 0" 对本硬件**不可满足**，属判据过强。
	 *
	 * ★ 改判语义位后**不是放宽**：`EN` 或 `RST_EN` 只要有一个仍为 1
	 *   （= disable 未生效）**依然会被抓住**；且完整寄存器值仍经上面的
	 *   `ZT_INFO` 上报，任何异常位都不会被掩盖。
	 *   （本项在 disable 前先执行过 `wdt_feed`，见 `:64`。）
	 *   位定义：`modules/hal/linkedsemi/hal_driver/inc/reg_iwdgv2_type.h:31-37`。 */
	zassert_equal(ctrl_after & IWDG_CTRL_ENABLED, 0u,
		      "IWDT_CTRL=0x%x after disable: EN|RST_EN 未清零 ⇒ disable 未生效"
		      " (位: bit3=CNT_CLR bit2=INTR_CLR bit1=RST_EN bit0=EN)",
		      ctrl_after);
}

ZTEST_SUITE(app_iwdg_quick, NULL, NULL, NULL, NULL, NULL);
```

## src/app_iwdg_reset_test.c
```c
/*
 * SPDX-License-Identifier: Apache-2.0
 *
 * app_iwdg 复位用例（cpu2，case_reset = CASE_ID 3）——破坏性
 *
 * 独立 main，不走 ztest（流程不是独立测试项而是状态机）。
 * 状态用 __noinit 跨复位保留；复位把控制权交回本固件入口后按 test_phase 推进。
 *
 * 流程：
 *   Phase 0（首次启动）：install(2000ms, RESET_CPU_CORE) + setup，不喂狗，
 *                        等待 app_iwdg 超时触发 **cpu2 HART 复位**
 *   Phase 1（复位后启动）：验证 reset_reason_get() == APP_IWDT_HART_RESET
 *                        （由 soc_reset_reason.c 的 SYSC_APP_PER 分支产生——
 *                          该分支只在 cpu1 节点非 okay 的 cpu2 构建里编译）
 *   Phase 2（上一轮遗留）：本次启动未装狗、未复位、未校验 ⇒ 不打任何判定标记；
 *                        清 noinit 状态后按 Phase 0 重跑一轮完整流程
 *
 * noinit 跨复位保留既是本状态机的基础，也意味着重复 load/run 会读到上一轮
 * 的终态（GDB load 不写 NOLOAD 段）。故 PASS 标记只能由本轮真跑出来的
 * Phase 1 打出。
 *
 * 注意：本 case 会真实复位 cpu2。cpu1 不在 APP_IWDT 的复位域内，应由 cpu1
 * 侧常驻固件保持在线；本 case **不可进批量回归**（见 tests/COVERAGE.md）。
 */

#include <zephyr/kernel.h>
#include <zephyr/device.h>
#include <zephyr/devicetree.h>
#include <zephyr/drivers/watchdog.h>
#include <errno.h>

#include "soc_reset.h"
#include "app_iwdg_test_protocol.h"
#if defined(ITEST_PEER_SECONDARY)
#include "rlog.h"
#endif

/* noinit 段跨 HART 复位保留（RAM 不被 hart 复位清空） */
__noinit static uint32_t test_phase;     /* 0=未跑, 1=已跑(等复位), 2=复位后验证 */
__noinit static uint32_t phase0_passed;  /* 第一阶段是否执行完 */

#define WDT_NODE DT_NODELABEL(app_iwdg)
#define WDT_TIMEOUT_MS 2000

void app_iwdg_reset_main(void)
{
	printk("\n*** app_iwdg (cpu2) HART reset test ***\n");
	printk("Reset reason: %u\n", reset_reason_get());
	printk("test_phase: %u, phase0_passed: %u\n", test_phase, phase0_passed);

	/* Phase 2：noinit 里是上一轮留下的终态（或上电随机值）。本次启动尚未
	 * 装狗、未复位、未校验 ⇒ 此处不打任何判定标记；清状态后落到下面的
	 * Phase 0 重新走完整流程，判定标记由那一轮的 Phase 1 打出。 */
	if (test_phase != 0 && test_phase != 1) {
		printk("PHASE 2: stale noinit state (test_phase=%u), no test ran this "
		       "boot; clearing and restarting from PHASE 0\n", test_phase);
		test_phase = 0;
		phase0_passed = 0;
	}

phase0_restart:
	if (test_phase == 0) {
		printk("PHASE 0: install %d ms timeout, will NOT feed, expecting HART reset\n",
		       WDT_TIMEOUT_MS);
#if defined(ITEST_PEER_SECONDARY)
		/* The integrated image keeps cpu2's console off the operator's view;
		 * relay the arming line so "the reset really happened" is visible on
		 * cpu1 too, not just as a verdict after the fact. */
		rlog_emitf("[itest-cpu2] app_iwdg: arming %d ms, expecting HART reset",
			   WDT_TIMEOUT_MS);
#endif

		const struct device *wdt_dev = DEVICE_DT_GET(WDT_NODE);

		if (!device_is_ready(wdt_dev)) {
			printk("ERROR: app_iwdg not ready\n");
			printk("PROJECT EXECUTION FAILED\n");
			k_sleep(K_FOREVER);
		}

		struct wdt_timeout_cfg cfg = {
			.flags = WDT_FLAG_RESET_CPU_CORE,
			.window.min = 0,
			.window.max = WDT_TIMEOUT_MS,
		};
		int channel = wdt_install_timeout(wdt_dev, &cfg);

		if (channel < 0) {
			printk("ERROR: install_timeout failed: %d\n", channel);
			printk("PROJECT EXECUTION FAILED\n");
			k_sleep(K_FOREVER);
		}

		int ret = wdt_setup(wdt_dev, WDT_OPT_PAUSE_HALTED_BY_DBG);

		if (ret != 0) {
			printk("ERROR: wdt_setup failed: %d\n", ret);
			printk("PROJECT EXECUTION FAILED\n");
			k_sleep(K_FOREVER);
		}

		test_phase = 1;
		phase0_passed = 1;
		printk("PHASE 0 complete, waiting for app_iwdg reset...\n");

		/* 不喂狗，等 app_iwdg 超时复位本 hart */
		k_sleep(K_FOREVER);

		/* 正常情况下不会执行到这里 */
		printk("ERROR: app_iwdg did not reset after timeout!\n");
		printk("PROJECT EXECUTION FAILED\n");
		k_sleep(K_FOREVER);
	} else {
		/* test_phase == 1：上一轮 Phase 0 已装狗等复位。
		 *
		 * noinit 段跨"重烧 + 复位"存活（cpu2 是 RAM 运行，重烧后 RAM 可能
		 * 保留上一轮的值），所以 phase==1 也可能是上一次会话留下的。
		 * 只有"复位来源是看门狗"才证明本轮真的走完了 Phase 0；否则清状态
		 * 重来，绝不打裁决（否则重烧后会拿烧录复位原因比对，打出假 FAIL
		 * 并 k_sleep 挂死调用线程）。 */
		uint32_t reason = reset_reason_get();

		if (reason != APP_IWDT_HART_RESET &&
		    reason != APP_WWDT_HART_RESET &&
		    reason != SEC_IWDT_HART_RESET &&
		    reason != SYS_IWDT_FULL_RESET) {
			printk("STALE: phase==1 but reset_reason=%u is not a "
			       "watchdog reset; no test ran this boot, restarting "
			       "from PHASE 0\n", reason);
			test_phase = 0;
			phase0_passed = 0;
			goto phase0_restart;
		}

		bool ok = (reason == APP_IWDT_HART_RESET);

		printk("PHASE 1: after reset, reason=%u, expected APP_IWDT_HART_RESET(%d)\n",
		       reason, APP_IWDT_HART_RESET);
		test_phase = 2;

		if (ok) {
			printk(APP_IWDG_RESET_PASS_MARK
			       ": reset_reason == APP_IWDT_HART_RESET\n");
			printk("PROJECT EXECUTION SUCCESSFUL\n");
		} else {
			printk(APP_IWDG_RESET_FAIL_MARK
			       ": reset_reason=%u, expected %d\n",
			       reason, APP_IWDT_HART_RESET);
			printk("PROJECT EXECUTION FAILED\n");
		}
		k_sleep(K_FOREVER);
	}
}
```

## src/app_iwdg_test.c
```c
/*
 * SPDX-License-Identifier: Apache-2.0
 *
 * app_iwdg 非破坏性用例（cpu2，case_non_destructive = CASE_ID 0）
 *
 * 对照 zephyr/drivers/watchdog/wdt_iwdg_ls.c 逐分支覆盖（SPEC_REFERENCE
 * §6.5.1 七维扫描）：
 *   install_timeout: window.min != 0 拒 / window.max == 0 拒 /
 *                    HAL_IWDG_IS_MATCH 按实例匹配 flags / callback 注册与清除
 *   setup:           IWDT_LOAD == 0 -> -ENOTSUP / IWDT_CTRL != 0 -> -EBUSY /
 *                    WDT_OPT_PAUSE_IN_SLEEP -> -ENOTSUP / 正常使能路径
 *   feed / disable:  正常返回 0，喂狗窗口内不复位
 *   换算:            timeout_ms -> IWDT_LOAD ticks
 *
 * 全部用例不使看门狗跑到超时：setup 成功的用例在断言后立即 disable；
 * test_feed_within_window_no_reset 有意跨越一个完整超时窗口，用"后续断言
 * 仍能执行"证明喂狗确实生效（若喂狗失效，本 hart 会被 app_iwdg 复位，
 * 整个 case 表现为重启）。
 */

#include <zephyr/kernel.h>
#include <zephyr/device.h>
#include <zephyr/devicetree.h>
#include <zephyr/drivers/watchdog.h>
#include <zephyr/ztest.h>
#include <errno.h>

#include "ztest_glue.h"

/*
 * IWDT_LOAD / IWDT_CTRL 在实例寄存器块的字偏移 0 / 1（字节 0x0 / 0x4，
 * 见 reg_iwdgv2_type.h）。驱动无 API 把 IWDT_LOAD 复位为 0，故
 * 「未安装超时」前置态由测试直接写寄存器复现（白盒前置态设置，
 * 不改变被测驱动行为）。
 */
#define IWDG_LOAD_WORD 0u
#define IWDG_CTRL_WORD 1u

#define APP_IWDG_REGS ((volatile uint32_t *)DT_REG_ADDR(DT_NODELABEL(app_iwdg)))

/* 驱动 iwdt_ls_setup 正常路径写入 CTRL = IWDT_RST_EN | IWDT_EN = 0x2 | 0x1 */
#define IWDG_CTRL_ENABLED 0x3u

/*
 * app_iwdg 的 clock-frequency = 32768（lsqsh.dtsi）。
 * 驱动换算 iwdt_calculate_load：ticks = timeout_ms * 32768 / 1000，
 * 其中 `timeout_ms * frequency` 是 **uint32 乘法**（两个操作数都是
 * uint32_t，C 整型提升后仍为 32 位）——故下界取值均选在
 * timeout_ms <= 131071（131072 * 32768 == 2^32）的**不回绕区间**内，
 * 预期值即按该式手算。回绕区间无确定性预期，见 COVERAGE.md 未覆盖项。
 */
#define TICKS_1MS 32u             /* 1 * 32768 / 1000                    */
#define TICKS_1000MS 32768u       /* 1000 * 32768 / 1000                 */
#define TICKS_65535MS 2147450u    /* 65535 * 32768 / 1000（商截断）      */
#define TICKS_MAX_NO_WRAP 4294934u /* 131071 * 32768 / 1000（不回绕上界） */

static const struct device *app_dev;

static void app_iwdg_dummy_cb(const struct device *dev, int channel)
{
	ARG_UNUSED(dev);
	ARG_UNUSED(channel);
}

static void *app_iwdg_setup(void)
{
	app_dev = DEVICE_DT_GET(DT_NODELABEL(app_iwdg));
	zassert_true(device_is_ready(app_dev), "app_iwdg not ready");
	/* 清掉可能的遗留使能态，使首项与执行顺序解耦 */
	(void)wdt_disable(app_dev);
	return NULL;
}

static void app_iwdg_teardown(void *data)
{
	ARG_UNUSED(data);
	/* setup 无共享句柄，teardown 只做幂等的关闭，保证不复位 */
	(void)wdt_disable(app_dev);
}

static int install_with(uint32_t window_min, uint32_t window_max, uint8_t flags,
			wdt_callback_t cb)
{
	struct wdt_timeout_cfg cfg = {
		.flags = flags,
		.window.min = window_min,
		.window.max = window_max,
		.callback = cb,
	};

	return wdt_install_timeout(app_dev, &cfg);
}

/* ---- install_timeout: flags × 实例匹配（HAL_IWDG_IS_MATCH，ls_msp_iwdg.c:72） ---- */

/* app_iwdg 属 HART 复位域，只接受 WDT_FLAG_RESET_CPU_CORE */
ZTEST(app_iwdg, test_install_accepts_reset_cpu_core_flag)
{
	int ret = install_with(0, 60000, WDT_FLAG_RESET_CPU_CORE, NULL);

	zassert_true(ret >= 0,
		     "app_iwdg install(RESET_CPU_CORE) returned %d, expected >= 0", ret);
}

/* app_iwdg 不是 SOC 复位域实例（HAL 只对 SEC_PMU_IWDG 返回匹配）-> -EINVAL */
ZTEST(app_iwdg, test_install_rejects_reset_soc_flag)
{
	int ret = install_with(0, 1000, WDT_FLAG_RESET_SOC, NULL);

	zassert_equal(ret, -EINVAL,
		      "app_iwdg install(RESET_SOC) returned %d, expected -EINVAL", ret);
}

/* flags = 0（NONE）与未知位 0xFF 均不匹配任何实例 -> -EINVAL */
ZTEST(app_iwdg, test_install_rejects_unmatched_flags)
{
	int ret_none = install_with(0, 1000, WDT_FLAG_RESET_NONE, NULL);

	zassert_equal(ret_none, -EINVAL,
		      "install(flags=NONE) returned %d, expected -EINVAL", ret_none);

	int ret_ff = install_with(0, 1000, 0xFF, NULL);

	zassert_equal(ret_ff, -EINVAL,
		      "install(flags=0xFF) returned %d, expected -EINVAL", ret_ff);
}

/* ---- install_timeout: 窗口参数边界 ---- */

/* window.max == 0：上界为 0 无意义 -> -EINVAL */
ZTEST(app_iwdg, test_install_invalid_window_max_zero)
{
	int ret = install_with(0, 0, WDT_FLAG_RESET_CPU_CORE, NULL);

	zassert_equal(ret, -EINVAL,
		      "install(window.max=0) returned %d, expected -EINVAL", ret);
}

/* window.min != 0：驱动不支持窗口模式，一律 -EINVAL */
ZTEST(app_iwdg, test_install_invalid_window_min_nonzero)
{
	int ret = install_with(1, 1000, WDT_FLAG_RESET_CPU_CORE, NULL);

	zassert_equal(ret, -EINVAL,
		      "install(window.min=1) returned %d, expected -EINVAL", ret);
}

/* ---- install_timeout: callback 注册 / 清除分支 ---- */

/* callback != NULL：驱动走 irq_config_func + data->callback 赋值分支 */
ZTEST(app_iwdg, test_install_with_callback_accepted)
{
	int ret = install_with(0, 60000, WDT_FLAG_RESET_CPU_CORE, app_iwdg_dummy_cb);

	zassert_equal(ret, 0, "install(callback!=NULL) returned %d, expected 0", ret);

	/* 清除已注册回调，避免遗留 irq_enable + 非空 data->callback 影响后续用例 */
	int ret_clear = install_with(0, 60000, WDT_FLAG_RESET_CPU_CORE, NULL);

	zassert_equal(ret_clear, 0, "install(callback=NULL) returned %d, expected 0",
		      ret_clear);
}

/* callback == NULL：驱动走 data->callback 置空分支 */
ZTEST(app_iwdg, test_install_without_callback_accepted)
{
	int ret = install_with(0, 60000, WDT_FLAG_RESET_CPU_CORE, NULL);

	zassert_equal(ret, 0, "install(callback==NULL) returned %d, expected 0", ret);
}

/* ---- setup: 正常使能路径（含 CTRL 位域白盒断言） ---- */

ZTEST(app_iwdg, test_setup_enables_ctrl_rst_en)
{
	int ch = install_with(0, 60000, WDT_FLAG_RESET_CPU_CORE, NULL);

	zassert_true(ch >= 0, "install_timeout returned %d", ch);

	int ret = wdt_setup(app_dev, WDT_OPT_PAUSE_HALTED_BY_DBG);

	zassert_equal(ret, 0, "setup returned %d, expected 0", ret);

	uint32_t ctrl = APP_IWDG_REGS[IWDG_CTRL_WORD];

	ZT_INFO("test_setup_enables_ctrl_rst_en", "ctrl=0x%x", ctrl);
	zassert_equal(ctrl, IWDG_CTRL_ENABLED,
		      "IWDT_CTRL=0x%x after setup, expected 0x%x (RST_EN|EN)",
		      ctrl, IWDG_CTRL_ENABLED);

	int dis = wdt_disable(app_dev);

	zassert_equal(dis, 0, "disable returned %d", dis);
	zassert_equal(APP_IWDG_REGS[IWDG_CTRL_WORD], 0u,
		      "IWDT_CTRL should be 0 after disable");
}

/* ---- setup: 错误分支 ---- */

/* IWDT_LOAD == 0（未安装超时）-> -ENOTSUP */
ZTEST(app_iwdg, test_setup_without_timeout_enotsup)
{
	/* 复现「未安装超时」前置态：CTRL=0 且 LOAD=0（与套件内执行顺序解耦） */
	(void)wdt_disable(app_dev);
	APP_IWDG_REGS[IWDG_LOAD_WORD] = 0;
	APP_IWDG_REGS[IWDG_CTRL_WORD] = 0;

	int ret = wdt_setup(app_dev, 0);

	zassert_equal(ret, -ENOTSUP,
		      "setup without install returned %d, expected -ENOTSUP", ret);
}

/* WDT_OPT_PAUSE_IN_SLEEP 不支持 -> -ENOTSUP（且不使能看门狗） */
ZTEST(app_iwdg, test_setup_pause_in_sleep_enotsup)
{
	int ch = install_with(0, 60000, WDT_FLAG_RESET_CPU_CORE, NULL);

	zassert_true(ch >= 0, "install_timeout returned %d", ch);

	int ret = wdt_setup(app_dev, WDT_OPT_PAUSE_IN_SLEEP);

	zassert_equal(ret, -ENOTSUP,
		      "setup(PAUSE_IN_SLEEP) returned %d, expected -ENOTSUP", ret);
	zassert_equal(APP_IWDG_REGS[IWDG_CTRL_WORD], 0u,
		      "IWDT_CTRL should stay 0 after -ENOTSUP");

	(void)wdt_disable(app_dev);
}

/* IWDT_CTRL != 0（已 setup）-> -EBUSY */
ZTEST(app_iwdg, test_setup_twice_ebusy)
{
	int ch = install_with(0, 60000, WDT_FLAG_RESET_CPU_CORE, NULL);

	zassert_true(ch >= 0, "install_timeout returned %d", ch);

	int ret = wdt_setup(app_dev, 0);

	zassert_equal(ret, 0, "first setup returned %d, expected 0", ret);

	int ret2 = wdt_setup(app_dev, 0);

	zassert_equal(ret2, -EBUSY,
		      "second setup returned %d, expected -EBUSY", ret2);

	(void)wdt_disable(app_dev);
}

/* ---- feed：窗口内喂狗，系统不复位 ---- */

ZTEST(app_iwdg, test_feed_within_window_no_reset)
{
	const uint32_t timeout_ms = 1000;
	int ch = install_with(0, timeout_ms, WDT_FLAG_RESET_CPU_CORE, NULL);

	zassert_true(ch >= 0, "install_timeout returned %d", ch);

	int ret = wdt_setup(app_dev, WDT_OPT_PAUSE_HALTED_BY_DBG);

	zassert_equal(ret, 0, "setup returned %d, expected 0", ret);

	/* 总时长 6 * 200ms = 1200ms > 1000ms 超时窗口：喂狗若失效，
	 * 本 hart 会在窗口处被 app_iwdg 复位，本项及后续项都不可能执行完。 */
	for (int i = 0; i < 6; i++) {
		k_sleep(K_MSEC(200));
		int feed = wdt_feed(app_dev, ch);

		zassert_equal(feed, 0, "feed #%d returned %d, expected 0", i, feed);
	}

	uint32_t ctrl = APP_IWDG_REGS[IWDG_CTRL_WORD];

	ZT_INFO("test_feed_within_window_no_reset", "timeout_ms=%u,elapsed_ms=%u",
		timeout_ms, 6u * 200u);
	zassert_equal(ctrl, IWDG_CTRL_ENABLED,
		      "IWDT_CTRL=0x%x after 1200ms of feeding, expected still enabled",
		      ctrl);

	int dis = wdt_disable(app_dev);

	zassert_equal(dis, 0, "disable returned %d", dis);
}

/* ---- timeout_ms -> IWDT_LOAD 换算（不回绕区间内） ---- */

ZTEST(app_iwdg, test_load_ticks_min_timeout)
{
	int ch = install_with(0, 1, WDT_FLAG_RESET_CPU_CORE, NULL);

	zassert_true(ch >= 0, "install_timeout returned %d", ch);

	uint32_t load = APP_IWDG_REGS[IWDG_LOAD_WORD];

	ZT_INFO("test_load_ticks_min_timeout", "ms=1,ticks=%u", load);
	zassert_equal(load, TICKS_1MS,
		      "IWDT_LOAD=%u for max=1ms, expected %u", load, TICKS_1MS);
}

ZTEST(app_iwdg, test_load_ticks_1000ms)
{
	int ch = install_with(0, 1000, WDT_FLAG_RESET_CPU_CORE, NULL);

	zassert_true(ch >= 0, "install_timeout returned %d", ch);

	uint32_t load = APP_IWDG_REGS[IWDG_LOAD_WORD];

	ZT_INFO("test_load_ticks_1000ms", "ms=1000,ticks=%u", load);
	zassert_equal(load, TICKS_1000MS,
		      "IWDT_LOAD=%u for max=1000ms, expected %u", load, TICKS_1000MS);
}

/* 商截断：65535 * 32768 / 1000 = 2147450.88 -> 2147450 */
ZTEST(app_iwdg, test_load_ticks_65535ms)
{
	int ch = install_with(0, 65535, WDT_FLAG_RESET_CPU_CORE, NULL);

	zassert_true(ch >= 0, "install_timeout returned %d", ch);

	uint32_t load = APP_IWDG_REGS[IWDG_LOAD_WORD];

	ZT_INFO("test_load_ticks_65535ms", "ms=65535,ticks=%u", load);
	zassert_equal(load, TICKS_65535MS,
		      "IWDT_LOAD=%u for max=65535ms, expected %u", load, TICKS_65535MS);
}

/* 不回绕上界：131072 * 32768 == 2^32（回绕起点），131071 为最大安全值 */
ZTEST(app_iwdg, test_load_ticks_max_no_wrap)
{
	int ch = install_with(0, 131071u, WDT_FLAG_RESET_CPU_CORE, NULL);

	zassert_true(ch >= 0, "install_timeout returned %d", ch);

	uint32_t load = APP_IWDG_REGS[IWDG_LOAD_WORD];

	ZT_INFO("test_load_ticks_max_no_wrap", "ms=131071,ticks=%u", load);
	zassert_equal(load, TICKS_MAX_NO_WRAP,
		      "IWDT_LOAD=%u for max=131071ms, expected %u", load,
		      TICKS_MAX_NO_WRAP);
}

ZTEST_SUITE(app_iwdg, NULL, app_iwdg_setup, NULL, NULL, app_iwdg_teardown);
```
