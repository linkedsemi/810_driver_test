## CMakeLists.txt
```
# SPDX-License-Identifier: Apache-2.0
# cpu2 (controller) firmware CMakeLists.txt -- the delegation CLIENT.
# 注意：EXTRA_DTC_OVERLAY_FILE 必须在 find_package 之前

cmake_minimum_required(VERSION 3.20.0)

# cpu2 侧必须注入（find_package 之前）：
#   cpu2_console_uart5.overlay  - 控制台 uart5（PN14/PN13, 115200）
#   cpu2_mem_layout.overlay     - 内存布局（sram_ro/sram 地址与大小）
set(EXTRA_DTC_OVERLAY_FILE
    ${CMAKE_CURRENT_SOURCE_DIR}/../../../common/cpu2_console_uart5.overlay;
    ${CMAKE_CURRENT_SOURCE_DIR}/../../../common/cpu2_mem_layout.overlay)

find_package(Zephyr REQUIRED HINTS $ENV{ZEPHYR_BASE})
project(cpu2_controller_otbn_delegation_test)

# 项目特定源文件
target_sources(app PRIVATE
    src/main.c)

# 测试体：cpu1/cpu2 共用同一份源码（tests/src/），差异全在 Kconfig（CLIENT/SERVER）。
# case_throughput（-DOTBN_DELEG_BENCH=1）换成基准源码：只跑 bench 一项，不与功能/负例并存。
if(OTBN_DELEG_BENCH)
    target_sources(app PRIVATE
        ${CMAKE_CURRENT_SOURCE_DIR}/../tests/src/otbn_delegation_bench.c)
elseif(OTBN_DELEG_SOAK)
    target_sources(app PRIVATE
        ${CMAKE_CURRENT_SOURCE_DIR}/../tests/src/otbn_delegation_soak.c)
elseif(OTBN_DELEG_RSA)
    # case_rsa_delegation (-DOTBN_DELEG_RSA=1): the RSA item set gets its OWN
    # translation unit, like bench/soak. It must not share the ECDSA body: the
    # ECDSA items are all linked, so its channel-masking item would otherwise run
    # before t01 (link order is by name, and 'r' < 't') and wedge the matrix.
    target_sources(app PRIVATE
        ${CMAKE_CURRENT_SOURCE_DIR}/../tests/src/otbn_delegation_rsa.c)
elseif(OTBN_DELEG_SLOT)
    # case_slot (-DOTBN_DELEG_SLOT=1): the private-key slot item set has its own
    # TU so its s* link order is independent of the default t* matrix.
    target_sources(app PRIVATE
        ${CMAKE_CURRENT_SOURCE_DIR}/../tests/src/otbn_delegation_slot.c)
else()
    target_sources(app PRIVATE
        ${CMAKE_CURRENT_SOURCE_DIR}/../tests/src/otbn_delegation_test.c)
endif()

# 项目特定 include 目录（协议头）
target_include_directories(app PRIVATE
    ${CMAKE_CURRENT_SOURCE_DIR}/../tests/include)

# 包含公共源文件和配置（test_results.c, ztest_glue.c, gpio_toggle.c）
include(${CMAKE_CURRENT_SOURCE_DIR}/../../../common/common_sources.cmake)

# 用例可选测试面：case 的 test.sh 可传 -DOTBN_DELEG_NO_SERVER=1 建模"对端缺席"
# （见 tests/case_no_server/test.sh）。默认不设，构建输入与 case_default 一致。
if(OTBN_DELEG_NO_SERVER)
    target_compile_definitions(app PRIVATE OTBN_DELEG_NO_SERVER=1)
endif()
if(OTBN_DELEG_DEAD_CHANNEL)
    target_compile_definitions(app PRIVATE OTBN_DELEG_DEAD_CHANNEL=1)
endif()
if(OTBN_DELEG_BENCH)
    target_compile_definitions(app PRIVATE OTBN_DELEG_BENCH=1)
endif()
# case_throughput_iso_{proxy,local} (-DOTBN_DELEG_BENCH_HOLD=1): the "hold" side
# of an isolated throughput measurement. This core compiles the same bench TU but
# does not bench, so the peer measures the shared OTBN uncontended. The item name
# is kept identical to the active core's, as the dual-core matrix requires.
if(OTBN_DELEG_BENCH_HOLD)
    target_compile_definitions(app PRIVATE OTBN_DELEG_BENCH_HOLD=1)
endif()
# case_throughput_iso_local_hwrng (-DOTBN_DELEG_BENCH_HWRNG=1): the bench feeds
# genkey/sign from the hardware entropy device instead of the in-process LCG, so
# the local baseline matches what the delegation SERVER uses when serving a
# proxied genkey/sign (see tests/src/otbn_delegation_bench.c).
if(OTBN_DELEG_BENCH_HWRNG)
    target_compile_definitions(app PRIVATE OTBN_DELEG_BENCH_HWRNG=1)
endif()
# case_entropy_iso (-DOTBN_DELEG_BENCH_ENTROPY=1): the bench measures the two
# entropy-device fetch APIs (blocking vs ENTROPY_BUSYWAIT) instead of OTBN ops.
# Passed to BOTH cores; the HOLD side registers the same b02_entropy placeholder.
if(OTBN_DELEG_BENCH_ENTROPY)
    target_compile_definitions(app PRIVATE OTBN_DELEG_BENCH_ENTROPY=1)
endif()
# OTBN_DELEG_BENCH_TRNG1=1 (ad-hoc, trng1 timing): see the cpu1 CMakeLists. On this
# HOLD core the entropy bench expands to the hold placeholder, so the define is
# inert here; it is accepted only so the same EXTRA_CMAKE_ARGS can drive both
# cores without a per-core branch.
if(OTBN_DELEG_BENCH_TRNG1)
    target_compile_definitions(app PRIVATE OTBN_DELEG_BENCH_TRNG1=1)
endif()
if(OTBN_DELEG_SOAK)
    target_compile_definitions(app PRIVATE OTBN_DELEG_SOAK=1)
endif()
# case_explicit_api (-DOTBN_DELEG_EXPLICIT_API=1): the client calls the explicit
# mbedtls_ls_otbn_ecdsa_* entry points by name (see the redirection block in
# tests/src/otbn_delegation_test.c). Passed to BOTH cores: the server registers
# the equivalence item for name symmetry and SKIPs (its image has no explicit
# entry point), while its matrix keeps the mbedtls_* names.
if(OTBN_DELEG_EXPLICIT_API)
    target_compile_definitions(app PRIVATE OTBN_DELEG_EXPLICIT_API=1)
endif()
# case_alt_via_proxy (-DOTBN_DELEG_VIA_PROXY=1): the client is built with
# CONFIG_MBEDTLS_ECDSA_LINKEDSEMI_OTBN_ALT_VIA_DELEGATION=y, so its PLAIN
# mbedtls_ecdsa_* names ARE the proxy; the shared body calls them (see the
# redirection block in tests/src/otbn_delegation_test.c) and registers the t90
# "plain API is really mailbox-bound" item. Passed to BOTH cores: the server
# registers t90 for name symmetry and SKIPs.
if(OTBN_DELEG_VIA_PROXY)
    target_compile_definitions(app PRIVATE OTBN_DELEG_VIA_PROXY=1)
endif()
# case_rsa_delegation (-DOTBN_DELEG_RSA=1): the RSA item set lives in its own
# source file (tests/src/otbn_delegation_rsa.c, selected above). Passed to BOTH
# cores: the client drives the RSA proxy, the server drives its local OTBN RSA
# backend (enabled by case_rsa_delegation/target.conf).
if(OTBN_DELEG_RSA)
    target_compile_definitions(app PRIVATE OTBN_DELEG_RSA=1)
endif()
# case_slot (-DOTBN_DELEG_SLOT=1): selects the slot-signing TU and lets cpu1's
# test_main register slot 0 before ztest starts. Passed to BOTH cores.
if(OTBN_DELEG_SLOT)
    target_compile_definitions(app PRIVATE OTBN_DELEG_SLOT=1)
endif()
```

## prj.conf
```kconfig
# SPDX-License-Identifier: Apache-2.0
# cpu2 (controller = delegation CLIENT) project config.
#
# The mbedtls/OTBN block mirrors samples/crypto/otbn/delegation/mbedtls_client
# boards/lsqsh_evb_cpu2.conf (proven to build); the block below it is the 810
# ztest/log/serial convention (810_driver_test/CLAUDE.md §4).

# ---- mbedtls + OTBN ECDSA (from the reference delegation client) ----
CONFIG_MBEDTLS=y
CONFIG_MBEDTLS_BUILTIN=y
CONFIG_MBEDTLS_ENABLE_HEAP=y
CONFIG_MBEDTLS_HEAP_SIZE=8192

CONFIG_CRYPTO_MBEDTLS_SHIM=y

# ecc
CONFIG_MBEDTLS_ECP_C=y
CONFIG_MBEDTLS_ECDSA_C=y
CONFIG_MBEDTLS_ECP_ALL_ENABLED=y

CONFIG_MBEDTLS_THREADING_LINKEDSEMI_ALT=y


# delegation (this core is the CLIENT: the ECC ops are proxied to cpu1)
CONFIG_MBEDTLS_LINKEDSEMI_OTBN_DELEGATION_CLIENT=y

# ---- 810 ztest / log / serial conventions ----
CONFIG_LOG=y
CONFIG_LOG_MODE_DEFERRED=y
CONFIG_LOG_BUFFER_SIZE=16384
CONFIG_LOG_PROCESS_THREAD_SLEEP_MS=10
CONFIG_LOG_BACKEND_UART=y
CONFIG_LOG_PRINTK=n
CONFIG_SERIAL=y
CONFIG_SHELL=n

CONFIG_ZTEST=y
CONFIG_ZTEST_ASSERT_VERBOSE=1
# 逐项 START/PASS/FAIL 行是 parse_ztest 的数据源，必须打开（KNOWN_ISSUES #26）
CONFIG_ZTEST_VERBOSE_OUTPUT=y
CONFIG_ZTEST_SUMMARY=n
# ECDSA 调用链较深（bignum/ecp + mbedtls 局部变量），测试线程栈给足
CONFIG_ZTEST_STACK_SIZE=16384
CONFIG_MAIN_STACK_SIZE=8192

CONFIG_GPIO=y
CONFIG_MBOX=y

# libc 三件套（KNOWN_ISSUES #35 / #58）
CONFIG_PICOLIBC=y
CONFIG_NEWLIB_LIBC=n
CONFIG_MINIMAL_LIBC=n
```

## app.overlay
```dts
/*
 * cpu2 (controller = delegation CLIENT) devicetree overlay.
 *
 * Console (uart5) and memory layout come from the common overlays injected by
 * CMakeLists.txt (cpu2_console_uart5.overlay / cpu2_mem_layout.overlay).
 *
 * No external wiring: OTBN ECDSA delegation runs entirely on-chip over the
 * pre-existing `mbox_consumer_otbn_crypto` node (board dts) -- nothing to
 * mux or connect here.
 */
```

## src/main.c
```c
/*
 * Copyright (c) 2026 LinkedSemi
 *
 * SPDX-License-Identifier: Apache-2.0
 *
 * OTBN ECDSA delegation -- cpu2 (controller, the delegation CLIENT).
 *
 * test_main only sets up the delegation channel and then hands over to ztest;
 * the test bodies live in tests/src/otbn_delegation_test.c (shared with cpu1).
 * The client's mbedtls_ecdsa_{genkey,sign,verify} are the delegation stubs, so
 * every test item below drives a real mbox round-trip to cpu1.
 */

#include <zephyr/kernel.h>

#include "ztest_glue.h"
#include "ls_otbn_delegation.h"

void test_main(void)
{
	/* Role banner (harness identifies the CTRL port by it). */
	printk("[CPU2 OTBN_DELEGATION CTRL] delegation client started\n");

	/* Bring up the otbn_crypto mbox channel BEFORE any test sends a request.
	 * cpu1 (server) is released first (CONFIG_BOOT_CPU2 on the cpu1 image) so
	 * its callback is already registered when the first request goes out.
	 * Guarded so a non-client build still links. */
#if defined(CONFIG_MBEDTLS_LINKEDSEMI_OTBN_DELEGATION_CLIENT)
	ls_otbn_delegation_client_init();
#endif

	zt_init("CTRL");
	zt_run_all();
}
```
