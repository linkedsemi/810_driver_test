#include "../../cpu2_controller_otbn_delegation_test/app.overlay"

/* case_seq_soak: no DT difference; the soak surface is selected by
 * -DOTBN_DELEG_SOAK=1 in test.sh (client runs the seq'd proxy path). */
