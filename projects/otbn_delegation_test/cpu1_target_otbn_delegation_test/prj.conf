## CMakeLists.txt
```
# SPDX-License-Identifier: Apache-2.0
# cpu1 (target) firmware CMakeLists.txt -- the delegation SERVER.

cmake_minimum_required(VERSION 3.20.0)
find_package(Zephyr REQUIRED HINTS $ENV{ZEPHYR_BASE})
project(cpu1_target_otbn_delegation_test)

# 项目特定源文件
target_sources(app PRIVATE
    src/main.c)

# 测试体：cpu1/cpu2 共用同一份源码（tests/src/），差异全在 Kconfig（CLIENT/SERVER）。
# case_throughput（-DOTBN_DELEG_BENCH=1）换成基准源码：只跑 bench 一项，不与功能/负例并存。
if(OTBN_DELEG_BENCH)
    target_sources(app PRIVATE
        ${CMAKE_CURRENT_SOURCE_DIR}/../tests/src/otbn_delegation_bench.c)
elseif(OTBN_DELEG_SOAK)
    target_sources(app PRIVATE
        ${CMAKE_CURRENT_SOURCE_DIR}/../tests/src/otbn_delegation_soak.c)
elseif(OTBN_DELEG_RSA)
    # case_rsa_delegation (-DOTBN_DELEG_RSA=1): the RSA item set gets its own
    # translation unit (see the cpu2 CMakeLists for why it must not share the
    # ECDSA body).
    target_sources(app PRIVATE
        ${CMAKE_CURRENT_SOURCE_DIR}/../tests/src/otbn_delegation_rsa.c)
elseif(OTBN_DELEG_SLOT)
    # case_slot (-DOTBN_DELEG_SLOT=1): private-key slot item set (own TU).
    target_sources(app PRIVATE
        ${CMAKE_CURRENT_SOURCE_DIR}/../tests/src/otbn_delegation_slot.c)
else()
    target_sources(app PRIVATE
        ${CMAKE_CURRENT_SOURCE_DIR}/../tests/src/otbn_delegation_test.c)
endif()

# 项目特定 include 目录（协议头）
target_include_directories(app PRIVATE
    ${CMAKE_CURRENT_SOURCE_DIR}/../tests/include)

# 包含公共源文件和配置（test_results.c, ztest_glue.c, gpio_toggle.c）
include(${CMAKE_CURRENT_SOURCE_DIR}/../../../common/common_sources.cmake)

# 用例可选测试面：case 的 test.sh 可传 -DOTBN_DELEG_NO_SERVER=1 建模"对端缺席"
# （见 tests/case_no_server/test.sh）。默认不设，构建输入与 case_default 一致。
if(OTBN_DELEG_NO_SERVER)
    target_compile_definitions(app PRIVATE OTBN_DELEG_NO_SERVER=1)
endif()
if(OTBN_DELEG_DEAD_CHANNEL)
    target_compile_definitions(app PRIVATE OTBN_DELEG_DEAD_CHANNEL=1)
endif()
if(OTBN_DELEG_BENCH)
    target_compile_definitions(app PRIVATE OTBN_DELEG_BENCH=1)
endif()
# case_throughput_iso_{proxy,local} (-DOTBN_DELEG_BENCH_HOLD=1): the "hold" side
# of an isolated throughput measurement. This core compiles the same bench TU but
# does not bench, so the peer measures the shared OTBN uncontended. The item name
# is kept identical to the active core's, as the dual-core matrix requires.
if(OTBN_DELEG_BENCH_HOLD)
    target_compile_definitions(app PRIVATE OTBN_DELEG_BENCH_HOLD=1)
endif()
# case_throughput_iso_local_hwrng (-DOTBN_DELEG_BENCH_HWRNG=1): the bench feeds
# genkey/sign from the hardware entropy device instead of the in-process LCG, so
# the local baseline matches what the delegation SERVER uses when serving a
# proxied genkey/sign (see tests/src/otbn_delegation_bench.c).
if(OTBN_DELEG_BENCH_HWRNG)
    target_compile_definitions(app PRIVATE OTBN_DELEG_BENCH_HWRNG=1)
endif()
# case_entropy_iso (-DOTBN_DELEG_BENCH_ENTROPY=1): the bench measures the two
# entropy-device fetch APIs (blocking vs ENTROPY_BUSYWAIT) instead of OTBN ops.
# Passed to BOTH cores; the HOLD side registers the same b02_entropy placeholder.
if(OTBN_DELEG_BENCH_ENTROPY)
    target_compile_definitions(app PRIVATE OTBN_DELEG_BENCH_ENTROPY=1)
endif()
# OTBN_DELEG_BENCH_TRNG1=1 (ad-hoc, trng1 timing): the entropy bench additionally
# times trng1 (ls-dwtrng, DT_NODELABEL(trng1)) through the same three fetch APIs,
# in the same run as trng0. Requires the trng1 node to be enabled by an overlay
# (injected via EXTRA_DTC_OVERLAY_FILE); without it DT_NODELABEL(trng1) has no
# ready device and the bench's device_is_ready assert fires. Additive only.
if(OTBN_DELEG_BENCH_TRNG1)
    target_compile_definitions(app PRIVATE OTBN_DELEG_BENCH_TRNG1=1)
endif()
if(OTBN_DELEG_SOAK)
    target_compile_definitions(app PRIVATE OTBN_DELEG_SOAK=1)
endif()
# case_explicit_api (-DOTBN_DELEG_EXPLICIT_API=1): the client calls the explicit
# mbedtls_ls_otbn_ecdsa_* entry points by name (see the redirection block in
# tests/src/otbn_delegation_test.c). Passed to BOTH cores: the server registers
# the equivalence item for name symmetry and SKIPs (its image has no explicit
# entry point), while its matrix keeps the mbedtls_* names.
if(OTBN_DELEG_EXPLICIT_API)
    target_compile_definitions(app PRIVATE OTBN_DELEG_EXPLICIT_API=1)
endif()
# case_alt_via_proxy (-DOTBN_DELEG_VIA_PROXY=1): see the cpu2 CMakeLists. Passed to
# BOTH cores; on the server it only registers the t90 item for name symmetry
# (t90 SKIPs there -- no delegation forwarder on this image).
if(OTBN_DELEG_VIA_PROXY)
    target_compile_definitions(app PRIVATE OTBN_DELEG_VIA_PROXY=1)
endif()
# case_rsa_delegation (-DOTBN_DELEG_RSA=1): see the cpu2 CMakeLists. Passed to
# BOTH cores; the server runs r01/r02/r03 against its local OTBN RSA backend
# (case_rsa_delegation/target.conf) and SKIPs r90 (no delegation client here).
if(OTBN_DELEG_RSA)
    target_compile_definitions(app PRIVATE OTBN_DELEG_RSA=1)
endif()
# case_slot (-DOTBN_DELEG_SLOT=1): selects the slot TU and enables the slot 0
# registration in test_main. Passed to BOTH cores.
if(OTBN_DELEG_SLOT)
    target_compile_definitions(app PRIVATE OTBN_DELEG_SLOT=1)
endif()
```

## prj.conf
```kconfig
# SPDX-License-Identifier: Apache-2.0
# cpu1 (target = delegation SERVER) project config.
#
# The mbedtls/OTBN block mirrors samples/crypto/otbn/delegation/mbedtls_server
# boards/lsqsh_evb_cpu1.conf (proven to build); the block below it is the 810
# ztest/log/serial convention (810_driver_test/CLAUDE.md §4).

# ---- mbedtls + OTBN ECDSA (from the reference delegation server) ----
CONFIG_MBEDTLS=y
CONFIG_MBEDTLS_BUILTIN=y
CONFIG_MBEDTLS_ENABLE_HEAP=y
CONFIG_MBEDTLS_HEAP_SIZE=8192

CONFIG_CRYPTO_MBEDTLS_SHIM=y

# ecc
CONFIG_MBEDTLS_ECP_C=y
CONFIG_MBEDTLS_ECDSA_C=y
CONFIG_MBEDTLS_ECP_ALL_ENABLED=y
# the server performs the real crypto locally (OTBN ECDSA ALT)
CONFIG_MBEDTLS_ECDSA_SECP256R1_SECP384R1_SM2_LINKEDSEMI_OTBN_ALT=y

CONFIG_MBEDTLS_THREADING_LINKEDSEMI_ALT=y


# delegation (this core is the SERVER: it answers cpu2's proxied ECC ops)
CONFIG_MBEDTLS_LINKEDSEMI_OTBN_DELEGATION_SERVER=y

# ---- 810 ztest / log / serial conventions ----
CONFIG_LOG=y
CONFIG_LOG_MODE_DEFERRED=y
CONFIG_LOG_BUFFER_SIZE=16384
CONFIG_LOG_PROCESS_THREAD_SLEEP_MS=10
CONFIG_LOG_BACKEND_UART=y
CONFIG_LOG_PRINTK=n
CONFIG_SERIAL=y
CONFIG_SHELL=n

CONFIG_ZTEST=y
CONFIG_ZTEST_ASSERT_VERBOSE=1
# 逐项 START/PASS/FAIL 行是 parse_ztest 的数据源，必须打开（KNOWN_ISSUES #26）
CONFIG_ZTEST_VERBOSE_OUTPUT=y
CONFIG_ZTEST_SUMMARY=n
# ECDSA 调用链较深（bignum/ecp + mbedtls 局部变量），测试线程栈给足
CONFIG_ZTEST_STACK_SIZE=16384
CONFIG_MAIN_STACK_SIZE=8192

CONFIG_GPIO=y
CONFIG_MBOX=y

# libc 三件套（KNOWN_ISSUES #35 / #58）
CONFIG_PICOLIBC=y
CONFIG_NEWLIB_LIBC=n
CONFIG_MINIMAL_LIBC=n
```

## app.overlay
```dts
/*
 * cpu1 (target = delegation SERVER) devicetree overlay.
 *
 * Console (uart1) comes from the board dts; no cpu2-style overlay is needed.
 * GPIO toggle (PA05/PA07) is compiled into the cpu1 side only, so enable GPIOA
 * through the shared fragment (SPEC_REFERENCE §6.1.9 reuse convergence).
 */
#include "../../../common/gpio_toggle.dtsi"

/*
 * No external wiring: the delegation runs over the pre-existing
 * `mbox_consumer_otbn_crypto` node (board dts).
 */
```

## src/main.c
```c
/*
 * Copyright (c) 2026 LinkedSemi
 *
 * SPDX-License-Identifier: Apache-2.0
 *
 * OTBN ECDSA delegation -- cpu1 (target, the delegation SERVER).
 *
 * test_main brings up the delegation server (mbox callback + dedicated thread
 * that performs the real OTBN ECDSA on behalf of cpu2) and then runs the SAME ztest
 * matrix against the LOCAL OTBN backend. The double-core PASS therefore means
 * "cpu2's proxied ops round-tripped correctly" AND "cpu1's local crypto is
 * correct" -- cpu1 doubles as the oracle for cpu2.
 */

#include <zephyr/kernel.h>

#include "ztest_glue.h"
#include "ls_otbn_delegation.h"

#if defined(OTBN_DELEG_SLOT)
#include "mbedtls/ecp.h"
#include "mbedtls_otbn_ecdsa_slot_mbox.h"
#include "otbn_delegation_slot_vectors.h"
#endif

void test_main(void)
{
	/* Role banner (harness identifies the TGT port by it). */
	printk("[CPU1 OTBN_DELEGATION TGT] delegation server started\n");

	/* Register the otbn_crypto mbox callback + start the delegation thread
	 * before cpu2 issues any request. Guarded: case_no_server builds this core
	 * with CONFIG_MBEDTLS_LINKEDSEMI_OTBN_DELEGATION_SERVER=n (peer absent). */
#if defined(CONFIG_MBEDTLS_LINKEDSEMI_OTBN_DELEGATION_SERVER)
	ls_otbn_delegation_server_init();
#endif

	/* case_slot: publish slot 0 before ztest starts, so the client's first
	 * request (which may race this boot) finds it. The key buffer is static in
	 * the vectors header and therefore outlives the test run. */
#if defined(OTBN_DELEG_SLOT) && defined(CONFIG_MBEDTLS_LINKEDSEMI_OTBN_DELEGATION_SERVER)
	{
		int rc0 = ls_otbn_ecdsa_key_slot_register(0, MBEDTLS_ECP_DP_SECP256R1,
							  otbn_slot_key_le);
		int rc1 = ls_otbn_ecdsa_key_slot_register(1, MBEDTLS_ECP_DP_SECP384R1,
							  p384_key_le);
		int rc2 = ls_otbn_ecdsa_key_slot_register(2, MBEDTLS_ECP_DP_SM2,
							  sm2_key_le);
		int rc3 = ls_otbn_ecdsa_key_slot_register(3, MBEDTLS_ECP_DP_SECP256R1,
							  p256b_key_le);

		printk("[CPU1 OTBN_SLOT TGT] slots 0..3 register rc=%d,%d,%d,%d\n",
		       rc0, rc1, rc2, rc3);
	}
#endif

	zt_init("TGT");
	zt_run_all();
}
```
