## CMakeLists.txt
```
# SPDX-License-Identifier: Apache-2.0
# DMA M2M test - CMakeLists.txt

cmake_minimum_required(VERSION 3.20.0)
find_package(Zephyr REQUIRED HINTS $ENV{ZEPHYR_BASE})
project(cpu1_dma_test)

if(DMA_DESTRUCTIVE)
    target_sources(app PRIVATE
        src/main.c
        src/dma_destructive_test.c)
else()
    target_sources(app PRIVATE
        src/main.c
        src/dma_test.c)
endif()

target_include_directories(app PRIVATE
    ${CMAKE_CURRENT_SOURCE_DIR}/../tests/include)

include(${CMAKE_CURRENT_SOURCE_DIR}/../../../common/common_sources.cmake)
```

## prj.conf
```kconfig
CONFIG_LOG=y
CONFIG_LOG_MODE_DEFERRED=y
CONFIG_LOG_BUFFER_SIZE=16384
CONFIG_LOG_PROCESS_THREAD_SLEEP_MS=10
CONFIG_SERIAL=y
CONFIG_SHELL=n
CONFIG_ZTEST=y
CONFIG_ZTEST_ASSERT_VERBOSE=1
CONFIG_ZTEST_VERBOSE_OUTPUT=y
CONFIG_ZTEST_SUMMARY=n
CONFIG_DMA=y
CONFIG_DMA_LOG_LEVEL_INF=y
CONFIG_PICOLIBC=y
CONFIG_NEWLIB_LIBC=n
CONFIG_MINIMAL_LIBC=n
CONFIG_GPIO=y
```

## app.overlay
```dts
/*
 * SPDX-License-Identifier: Apache-2.0
 *
 * DMA M2M test overlay (cpu1, lsqsh_evb)
 *
 * 使能 dmac1（8 通道，不与 SPI3/4 的 dmac2 冲突）。
 * M2M 传输直接用 dmac1 节点，不需额外 consumer（上游 loop_transfer 也是直接传设备）。
 */

/ {
	chosen {
		zephyr,console = &uart1;
		zephyr,shell-uart = &uart1;
	};
};

&dmac1 {
	status = "okay";
};

/* P1a 新增配置项（2026-09-17）：第二个 DW DMAC 实例 dmac2@40042000，
 * 供 test_dma_dmac2_transfer 用（既有用例只跑 dmac1）。
 * 该节点与 dmac1 同 compatible（linkedsemi,dma + snps,designware-dma-2.20a）、
 * 同 dma-channels=8；soc dtsi 默认 disabled，此处显式使能。
 * 注：dmac2 的 ch0/ch1 在 dts 里被 spi3/spi4 的 `dmas` 引用，但 spi3/spi4
 * 本工程未使能（board dts 里为注释状态），故无抢占。 */
&dmac2 {
	status = "okay";
};
```

## src/main.c
```c
/*
 * SPDX-License-Identifier: Apache-2.0
 *
 * DMA M2M test - entry point (single-core, cpu1)
 */

#include <zephyr/kernel.h>
#include <zephyr/logging/log.h>
#include "ztest_glue.h"

LOG_MODULE_REGISTER(dma_test, LOG_LEVEL_INF);

void test_main(void)
{
	LOG_INF("[CPU1 DMA] DMA M2M test started");
	zt_init("TGT");
	zt_run_all();
}
```

## src/dma_destructive_test.c
```c
/*
 * SPDX-License-Identifier: Apache-2.0
 *
 * DMA destructive/robustness tests (LinkedSemi DMA driver, dmac1)
 *
 * 测试 DMA 驱动在异常参数/边界条件下的鲁棒性：
 *   - 无效参数拒绝（data_size、block_size、同址传输）
 *   - 通道忙碌时重配置
 *   - 极小/极大传输
 *
 * 驱动约束（dma_dw_common.c）：
 *   - source_data_size 必须在 {1,2,4,8,16}
 *   - block_size 不能 > DW_CTLH_BLOCK_TS_MASK（该 IP 的 BLOCK_TS 仅 CTL_HI[10:0] 有效，即 2047）
 *   - source_address 与 dest_address 不能相同（同址属退化配置，显式返回 -EINVAL）
 *   - 忙碌通道重配置返回 -EBUSY
 *
 * 负例的 src/dst 一律用两个不同缓冲区，使每项只压测自己那一维约束，
 * 不被同址校验提前拦下。
 */

#include <zephyr/kernel.h>
#include <zephyr/device.h>
#include <zephyr/devicetree.h>
#include <zephyr/drivers/dma.h>
#include <zephyr/ztest.h>
#include <errno.h>
#include <string.h>
#include "ztest_glue.h"

#define DMA_NODE DT_NODELABEL(dmac1)
#define DMA_CHANNEL 0

static const struct device *dma_dev;
static volatile bool dma_done;
static volatile int dma_status;

static void dma_callback(const struct device *dev, void *arg,
			 uint32_t id, int status)
{
	dma_status = status;
	dma_done = true;
}

static void *dma_test_setup(void)
{
	dma_dev = DEVICE_DT_GET(DMA_NODE);
	zassert_true(device_is_ready(dma_dev), "dmac1 not ready");
	return NULL;
}

static void dma_test_before(void *fixture)
{
	ARG_UNUSED(fixture);
	/* Ensure channel is released before each test (previous test may have
	 * left it active due to timeout or missing cleanup). */
	dma_stop(dma_dev, DMA_CHANNEL);
	dma_done = false;
	dma_status = -1;
}

static void dma_wait_complete(int timeout_ms)
{
	for (int t = 0; t < timeout_ms && !dma_done; t++) {
		k_msleep(1);
	}
	if (!dma_done) {
		/* Transfer timed out - stop channel to release it for next test */
		dma_stop(dma_dev, DMA_CHANNEL);
	}
}

/* TC-1: invalid data_size (3) should be rejected */
ZTEST(dma_destructive, test_dma_invalid_data_size)
{
	__nocache __aligned(32) static uint8_t src[64];
	__nocache __aligned(32) static uint8_t dst[64];
	memset(src, 0, sizeof(src));
	memset(dst, 0, sizeof(dst));

	struct dma_config cfg = {
		.dma_slot = 0,
		.channel_direction = MEMORY_TO_MEMORY,
		.dma_callback = dma_callback,
		.complete_callback_en = 1,
		.error_callback_dis = 0,
		.source_data_size = 3,   /* invalid: not in {1,2,4,8,16} */
		.dest_data_size = 3,
		.source_burst_length = 1,
		.dest_burst_length = 1,
		.block_count = 1,
	};
	struct dma_block_config block = {
		.source_address = (uint32_t)src,
		.dest_address = (uint32_t)dst,
		.block_size = 64,
	};
	cfg.head_block = &block;

	int ret = dma_config(dma_dev, DMA_CHANNEL, &cfg);
	zassert_not_equal(ret, 0, "dma_config with data_size=3 should fail");
}

/* TC-2: data_size=0 should be rejected */
ZTEST(dma_destructive, test_dma_data_size_zero)
{
	__nocache __aligned(32) static uint8_t src[64];
	__nocache __aligned(32) static uint8_t dst[64];
	memset(src, 0, sizeof(src));
	memset(dst, 0, sizeof(dst));

	struct dma_config cfg = {
		.dma_slot = 0,
		.channel_direction = MEMORY_TO_MEMORY,
		.dma_callback = dma_callback,
		.complete_callback_en = 1,
		.error_callback_dis = 0,
		.source_data_size = 0,   /* invalid */
		.dest_data_size = 0,
		.source_burst_length = 1,
		.dest_burst_length = 1,
		.block_count = 1,
	};
	struct dma_block_config block = {
		.source_address = (uint32_t)src,
		.dest_address = (uint32_t)dst,
		.block_size = 64,
	};
	cfg.head_block = &block;

	int ret = dma_config(dma_dev, DMA_CHANNEL, &cfg);
	zassert_not_equal(ret, 0, "dma_config with data_size=0 should fail");
}

/* TC-3: block_size > DW_CTLH_BLOCK_TS_MASK (0x7FF = 2047) should be rejected */
ZTEST(dma_destructive, test_dma_block_too_large)
{
	__nocache __aligned(32) static uint8_t src[256];
	__nocache __aligned(32) static uint8_t dst[256];
	memset(src, 0, sizeof(src));
	memset(dst, 0, sizeof(dst));

	struct dma_config cfg = {
		.dma_slot = 0,
		.channel_direction = MEMORY_TO_MEMORY,
		.dma_callback = dma_callback,
		.complete_callback_en = 1,
		.error_callback_dis = 0,
		.source_data_size = 1,
		.dest_data_size = 1,
		.source_burst_length = 1,
		.dest_burst_length = 1,
		.block_count = 1,
	};
	struct dma_block_config block = {
		.source_address = (uint32_t)src,
		.dest_address = (uint32_t)dst,
		.block_size = 70000,   /* > 2047 */
	};
	cfg.head_block = &block;

	int ret = dma_config(dma_dev, DMA_CHANNEL, &cfg);
	zassert_not_equal(ret, 0, "dma_config with block_size=70000 should fail");
}

/* TC-4: 同址传输（src == dst）属退化配置，驱动须显式拒绝 */
ZTEST(dma_destructive, test_dma_self_copy_rejected)
{
	__nocache __aligned(32) static uint8_t buf[64];
	for (int i = 0; i < 64; i++) {
		buf[i] = (uint8_t)i;
	}

	struct dma_config cfg = {
		.dma_slot = 0,
		.channel_direction = MEMORY_TO_MEMORY,
		.dma_callback = dma_callback,
		.complete_callback_en = 1,
		.error_callback_dis = 0,
		.source_data_size = 1,
		.dest_data_size = 1,
		.source_burst_length = 1,
		.dest_burst_length = 1,
		.block_count = 1,
	};
	struct dma_block_config block = {
		.source_address = (uint32_t)buf,
		.dest_address = (uint32_t)buf,  /* src == dst */
		.block_size = 64,
	};
	cfg.head_block = &block;

	int ret = dma_config(dma_dev, DMA_CHANNEL, &cfg);
	zassert_equal(ret, -EINVAL, "dma_config src==dst should be rejected: %d", ret);

	/* 拒绝发生在参数校验阶段，通道未被占用、缓冲区不应被改动 */
	for (int i = 0; i < 64; i++) {
		zassert_equal(buf[i], (uint8_t)i, "rejected config corrupted byte[%d]", i);
	}
}

/* TC-5: minimal transfer (1 byte) */
ZTEST(dma_destructive, test_dma_one_byte)
{
	__nocache __aligned(32) static uint8_t src[32] = {0};
	__nocache __aligned(32) static uint8_t dst[32] = {0};
	src[0] = 0xAB;
	dma_done = false;
	dma_status = -1;

	struct dma_config cfg = {
		.dma_slot = 0,
		.channel_direction = MEMORY_TO_MEMORY,
		.dma_callback = dma_callback,
		.complete_callback_en = 1,
		.error_callback_dis = 0,
		.source_data_size = 1,
		.dest_data_size = 1,
		.source_burst_length = 1,
		.dest_burst_length = 1,
		.block_count = 1,
	};
	struct dma_block_config block = {
		.source_address = (uint32_t)src,
		.dest_address = (uint32_t)dst,
		.block_size = 1,   /* minimal */
	};
	cfg.head_block = &block;

	int ret = dma_config(dma_dev, DMA_CHANNEL, &cfg);
	zassert_equal(ret, 0, "dma_config failed: %d", ret);
	ret = dma_start(dma_dev, DMA_CHANNEL);
	zassert_equal(ret, 0, "dma_start failed: %d", ret);

	dma_wait_complete(200);
	zassert_true(dma_done, "1-byte transfer timed out");
	zassert_equal(dst[0], 0xAB, "1-byte transfer data mismatch");
}

/* TC-6: 最大合法单块传输（BLOCK_TS 实际有效位宽 11 位，单块上限 2047 字节） */
ZTEST(dma_destructive, test_dma_large_block)
{
	/* block_size 上限 2047：BLOCK_TS 的 bit11 无效，超限值被硬件截断
	 * （2048 → 0 → 通道挂住；其余只搬运 block_size & 0x7FF 次）。 */
	__nocache __aligned(32) static uint8_t large_src[4096];
	__nocache __aligned(32) static uint8_t large_dst[4096];
	memset(large_src, 0x55, sizeof(large_src));
	memset(large_dst, 0xAA, sizeof(large_dst));
	dma_done = false;
	dma_status = -1;

	struct dma_config cfg = {
		.dma_slot = 0,
		.channel_direction = MEMORY_TO_MEMORY,
		.dma_callback = dma_callback,
		.complete_callback_en = 1,
		.error_callback_dis = 0,
		.source_data_size = 1,
		.dest_data_size = 1,
		.source_burst_length = 1,
		.dest_burst_length = 1,
		.block_count = 1,
	};
	struct dma_block_config block = {
		.source_address = (uint32_t)large_src,
		.dest_address = (uint32_t)large_dst,
		.block_size = 2047,  /* BLOCK_TS[10:0] 最大值 */
	};
	cfg.head_block = &block;

	int ret = dma_config(dma_dev, DMA_CHANNEL, &cfg);
	zassert_equal(ret, 0, "dma_config failed for 2047-byte block: %d", ret);
	ret = dma_start(dma_dev, DMA_CHANNEL);
	zassert_equal(ret, 0, "dma_start failed: %d", ret);

	dma_wait_complete(2000);
	zassert_true(dma_done, "2047-byte transfer timed out");
	/* verify first and last bytes */
	zassert_equal(large_dst[0], 0x55, "first byte mismatch");
	zassert_equal(large_dst[2046], 0x55, "last byte mismatch");
}

/* ==================================================================
 * P1a 新增用例（2026-09-17）
 * ================================================================== */

/* TC-7: LLI pool 耗尽边界 —— block_count > CONFIG_DMA_DW_LLI_POOL_SIZE(=2)。
 *   覆盖 dw_dma_config 的 pool 容量检查分支（dma_dw_common.c:226-232）；
 *   拒绝发生在任何状态/描述符改写之前，故通道与缓冲区必须保持原样。 */
ZTEST(dma_destructive, test_dma_lli_pool_exhaust)
{
	__nocache __aligned(32) static uint8_t src[256];
	__nocache __aligned(32) static uint8_t dst[256];

	memset(src, 0x11, sizeof(src));
	memset(dst, 0x00, sizeof(dst));

	struct dma_block_config b2 = {
		.source_address = (uint32_t)(src + 128),
		.dest_address = (uint32_t)(dst + 128),
		.block_size = 64,
		.next_block = NULL,
	};
	struct dma_block_config b1 = {
		.source_address = (uint32_t)(src + 64),
		.dest_address = (uint32_t)(dst + 64),
		.block_size = 64,
		.next_block = &b2,
	};
	struct dma_block_config b0 = {
		.source_address = (uint32_t)src,
		.dest_address = (uint32_t)dst,
		.block_size = 64,
		.next_block = &b1,
	};
	struct dma_config cfg = {
		.dma_slot = 0,
		.channel_direction = MEMORY_TO_MEMORY,
		.dma_callback = dma_callback,
		.complete_callback_en = 1,
		.error_callback_dis = 0,
		.source_data_size = 1,
		.dest_data_size = 1,
		.source_burst_length = 1,
		.dest_burst_length = 1,
		.block_count = 3,   /* pool = CONFIG_DMA_DW_LLI_POOL_SIZE = 2 */
		.head_block = &b0,
	};

	int ret = dma_config(dma_dev, DMA_CHANNEL, &cfg);

	ZT_INFO("test_dma_lli_pool_exhaust", "block_count=3,pool=2,ret=%d", ret);
	zassert_equal(ret, -EINVAL,
		      "block_count=3 > pool 2 should be -EINVAL, got %d", ret);

	/* 参数校验阶段即拒绝：通道未被占用，缓冲区不应被改动 */
	for (int i = 0; i < 256; i++) {
		zassert_equal(dst[i], 0x00, "rejected config modified dst[%d]", i);
	}

	/* 拒绝后通道仍可用（状态未被污染） */
	__nocache __aligned(32) static uint8_t src2[64];
	__nocache __aligned(32) static uint8_t dst2[64];
	struct dma_block_config ok = {
		.source_address = (uint32_t)src2,
		.dest_address = (uint32_t)dst2,
		.block_size = 64,
	};

	cfg.block_count = 1;
	cfg.head_block = &ok;
	dma_done = false;
	zassert_ok(dma_config(dma_dev, DMA_CHANNEL, &cfg),
		   "channel unusable after pool-exhaust rejection");
	zassert_ok(dma_start(dma_dev, DMA_CHANNEL));
	dma_wait_complete(200);
	zassert_true(dma_done, "post-rejection transfer timed out");
}

/* TC-8: 传输中途 stop/abort（中断/时序）。断言不依赖"stop 时传输是否已结束"：
 *   已完成 → dw_dma_stop 走 !dw_dma_is_enabled() 早退返回 0；
 *   在途 → 走 disable + WAIT_FOR(ChEn 清) 返回 0。两条路径都必须返回 0，
 *   且通道必须仍可重新 config/start 并完成。 */
ZTEST(dma_destructive, test_dma_abort_mid_transfer)
{
	__nocache __aligned(32) static uint8_t big_src[2048];
	__nocache __aligned(32) static uint8_t big_dst[2048];

	memset(big_src, 0x3C, sizeof(big_src));
	memset(big_dst, 0x00, sizeof(big_dst));
	dma_done = false;
	dma_status = -1;

	struct dma_config cfg = {
		.dma_slot = 0,
		.channel_direction = MEMORY_TO_MEMORY,
		.dma_callback = dma_callback,
		.complete_callback_en = 1,
		.error_callback_dis = 0,
		.source_data_size = 1,
		.dest_data_size = 1,
		.source_burst_length = 1,
		.dest_burst_length = 1,
		.block_count = 1,
	};
	struct dma_block_config block = {
		.source_address = (uint32_t)big_src,
		.dest_address = (uint32_t)big_dst,
		.block_size = 2047,   /* 单块上限，尽量拉长在途窗口 */
	};

	cfg.head_block = &block;
	zassert_ok(dma_config(dma_dev, DMA_CHANNEL, &cfg));
	zassert_ok(dma_start(dma_dev, DMA_CHANNEL));

	int ret = dma_stop(dma_dev, DMA_CHANNEL);

	ZT_INFO("test_dma_abort_mid_transfer", "stop_ret=%d", ret);
	zassert_equal(ret, 0, "dma_stop (mid/after transfer) ret %d", ret);

	/* ★ 覆盖边界如实标注（审计 A 组 P1-4）：2047B M2M 传输 µs 级完成 + 硬件
	 * 在 TFR 后自清 ChEn ⇒ 本项实际走 `dw_dma_stop` 的
	 * `!dw_dma_is_enabled()` **早退分支**；在途 disable 分支与早退同返 0，
	 * 故本项**不能证明**"传输在途被 abort"（big_dst 多半已搬完，亦不可作判据）。
	 * 可确定覆盖的只有"stop 返回 0 且通道随后可复用"这一**幂等早退路径**：
	 * 重复 stop 必须仍返回 0。 */
	zassert_equal(dma_stop(dma_dev, DMA_CHANNEL), 0,
		      "second stop (idempotent early-exit path) ret != 0");

	/* 通道已释放：可再次 config + start 并完成 */
	__nocache __aligned(32) static uint8_t src2[256];
	__nocache __aligned(32) static uint8_t dst2[256];

	for (int i = 0; i < 256; i++) {
		src2[i] = (uint8_t)i;
	}
	memset(dst2, 0, sizeof(dst2));
	dma_done = false;

	struct dma_block_config blk2 = {
		.source_address = (uint32_t)src2,
		.dest_address = (uint32_t)dst2,
		.block_size = 256,
	};

	cfg.head_block = &blk2;

	zassert_ok(dma_config(dma_dev, DMA_CHANNEL, &cfg),
		   "reconfig after abort failed");
	zassert_ok(dma_start(dma_dev, DMA_CHANNEL), "restart after abort failed");
	dma_wait_complete(200);
	zassert_true(dma_done, "post-abort transfer timed out");
	zassert_mem_equal(src2, dst2, sizeof(src2), "post-abort data mismatch");
}

/* TC-9: suspend/resume 状态守卫（既有零覆盖）。成功路径（ACTIVE→SUSPENDED）
 *   需在传输在途时命中，时序不可确定 ⇒ 只覆盖可确定的状态守卫分支：
 *   非 ACTIVE 时 suspend → -EINVAL；非 SUSPENDED 时 resume → -EINVAL；
 *   越界通道号两 API → -EINVAL（另在 ch0=ACTIVE 状态下复验，见下）。 */
ZTEST(dma_destructive, test_dma_suspend_resume_guards)
{
	int ret = dma_suspend(dma_dev, DMA_CHANNEL);

	ZT_INFO("test_dma_suspend_resume_guards", "suspend_idle_ret=%d", ret);
	zassert_equal(ret, -EINVAL,
		      "suspend while IDLE ret %d != -EINVAL", ret);

	ret = dma_resume(dma_dev, DMA_CHANNEL);
	ZT_INFO("test_dma_suspend_resume_guards", "resume_idle_ret=%d", ret);
	zassert_equal(ret, -EINVAL,
		      "resume while not SUSPENDED ret %d != -EINVAL", ret);

	zassert_equal(dma_suspend(dma_dev, 99), -EINVAL,
		      "suspend(ch99) should be -EINVAL");
	zassert_equal(dma_resume(dma_dev, 99), -EINVAL,
		      "resume(ch99) should be -EINVAL");

	/* ★ 越界守卫可归因化（审计 A 组 P1-4）：旧版 ch99 半段只断 -EINVAL ——
	 * 删掉 `channel >= DW_CHAN_COUNT` 守卫后，越界 `chan_data->state` 读到 0
	 * (=IDLE) 仍返 -EINVAL，断言照过、不可归因。改为：先令 **ch0 = ACTIVE**，
	 * 再调 ch99 两个 API，最后断言 ch0 状态**未被越界访问破坏**（仍可正常 stop
	 * 返回 0）。若越界访问写坏了 ch0 的 state（例如落在同一 cache line），
	 * dma_stop 将不再返回 0。 */
	__nocache __aligned(32) static uint8_t src[2048];
	__nocache __aligned(32) static uint8_t dst[2048];

	memset(src, 0x5A, sizeof(src));
	memset(dst, 0x00, sizeof(dst));
	dma_done = false;

	struct dma_config cfg = {
		.dma_slot = 0,
		.channel_direction = MEMORY_TO_MEMORY,
		.dma_callback = dma_callback,
		.complete_callback_en = 1,
		.error_callback_dis = 0,
		.source_data_size = 1,
		.dest_data_size = 1,
		.source_burst_length = 1,
		.dest_burst_length = 1,
		.block_count = 1,
	};
	struct dma_block_config block = {
		.source_address = (uint32_t)src,
		.dest_address = (uint32_t)dst,
		.block_size = 2047,
	};

	cfg.head_block = &block;
	zassert_ok(dma_config(dma_dev, DMA_CHANNEL, &cfg), "pre ch99 config failed");
	zassert_ok(dma_start(dma_dev, DMA_CHANNEL), "pre ch99 start failed");

	zassert_equal(dma_suspend(dma_dev, 99), -EINVAL,
		      "suspend(ch99) after active ch0 should be -EINVAL");
	zassert_equal(dma_resume(dma_dev, 99), -EINVAL,
		      "resume(ch99) after active ch0 should be -EINVAL");

	/* ch0 软件状态仍是 ACTIVE（越界调用不得改动它）⇒ dma_stop 必须返回 0 */
	zassert_equal(dma_stop(dma_dev, DMA_CHANNEL), 0,
		      "ch99 guard call corrupted ch0 state (stop ret != 0)");
}

ZTEST_SUITE(dma_destructive, NULL, dma_test_setup, dma_test_before, NULL, NULL);
```

## src/dma_test.c
```c
/*
 * SPDX-License-Identifier: Apache-2.0
 *
 * DMA M2M test cases (LinkedSemi DMA driver, dmac1)
 *
 * 已知 bug：dma_request_channel() 恒失败（dma_ctx.magic 未初始化），
 * 用固定通道号规避。
 *
 * buffer 全部 __nocache __aligned(32)（DMA 硬件要求 + D-cache 一致），
 * 如果 D-cache 导致 memcmp 误判，需加 __nocache 或 cache flush。
 */

#include <zephyr/kernel.h>
#include <zephyr/device.h>
#include <zephyr/devicetree.h>
#include <zephyr/drivers/dma.h>
#include <zephyr/linker/sections.h>
#include <zephyr/ztest.h>
#include <string.h>
#include <errno.h>
#include "ztest_glue.h"

#define DMA_NODE DT_NODELABEL(dmac1)
#define DMA_CHANNEL 0  /* 固定通道号，规避 dma_request_channel magic bug */
#define TRANSFER_SIZE 256
/* block_size 按官方 API = 字节数（source_data_size=1 时字节数==block_ts 次数，
 * 与 zephyr/tests/drivers/dma/loop_transfer 官方样例一致）。 */

static const struct device *dma_dev;
static volatile bool dma_done;
static int dma_status;

static void dma_callback(const struct device *dev, void *arg,
			 uint32_t id, int status)
{
	dma_status = status;
	dma_done = true;
}

static void *dma_test_setup(void)
{
	dma_dev = DEVICE_DT_GET(DMA_NODE);
	zassert_true(device_is_ready(dma_dev), "dmac1 not ready");
	return NULL;
}

/* TC-1: M2M loop transfer with memcmp verification */
ZTEST(dma, test_dma_loop_transfer)
{
	__nocache __aligned(32) static uint8_t tx_data[TRANSFER_SIZE];
	__nocache __aligned(32) static uint8_t rx_data[TRANSFER_SIZE];

	for (int loop = 0; loop < 4; loop++) {
		for (int i = 0; i < TRANSFER_SIZE; i++) {
			tx_data[i] = (uint8_t)(i + loop);
		}
		memset(rx_data, 0, sizeof(rx_data));
		dma_done = false;

		struct dma_config cfg = {
			.dma_slot = 0,
			.channel_direction = MEMORY_TO_MEMORY,
			.dma_callback = dma_callback,
			.complete_callback_en = 1,  /* 使能完成回调，传输完成后 dma_callback 触发置 dma_done */
			.error_callback_dis = 0,
			.source_data_size = 1,
			.dest_data_size = 1,
			.source_burst_length = 1,
			.dest_burst_length = 1,
			.block_count = 1,
		};

		struct dma_block_config block = {
			.source_address = (uint32_t)tx_data,
			.dest_address = (uint32_t)rx_data,
			.block_size = TRANSFER_SIZE,
		};
		cfg.head_block = &block;

		int ret = dma_config(dma_dev, DMA_CHANNEL, &cfg);
		zassert_equal(ret, 0, "dma_config failed: %d", ret);

		ret = dma_start(dma_dev, DMA_CHANNEL);
		zassert_equal(ret, 0, "dma_start failed: %d", ret);

		/* 等传输完成（callback 或超时） */
		for (int t = 0; t < 100 && !dma_done; t++) {
			k_msleep(1);
		}
		zassert_true(dma_done, "DMA transfer timeout (loop %d)", loop);

		/* dma_status 语义：drv 会派发 block(DMA_STATUS_BLOCK=1)/tfr(COMPLETE=0)
		 * 等多个回调，status 非严格 0。真正正确性用 memcmp 验证。 */

		zassert_mem_equal(tx_data, rx_data, TRANSFER_SIZE,
			"data mismatch on loop %d", loop);
	}
}

/* TC-2: transfer with all-zeros and all-0xFF patterns */
ZTEST(dma, test_dma_transfer_ones_zeros)
{
	__nocache __aligned(32) static uint8_t tx_zero[TRANSFER_SIZE];
	__nocache __aligned(32) static uint8_t rx_zero[TRANSFER_SIZE];
	__nocache __aligned(32) static uint8_t tx_ones[TRANSFER_SIZE];
	__nocache __aligned(32) static uint8_t rx_ones[TRANSFER_SIZE];

	memset(tx_zero, 0x00, TRANSFER_SIZE);
	memset(tx_ones, 0xFF, TRANSFER_SIZE);
	memset(rx_zero, 0xAA, TRANSFER_SIZE);
	memset(rx_ones, 0x55, TRANSFER_SIZE);
	dma_done = false;

	struct dma_config cfg = {
		.dma_slot = 0,
		.channel_direction = MEMORY_TO_MEMORY,
		.dma_callback = dma_callback,
		.complete_callback_en = 1,  /* 使能完成回调，传输完成后 dma_callback 触发置 dma_done */
		.error_callback_dis = 0,
		.source_data_size = 1,
		.dest_data_size = 1,
		.source_burst_length = 1,
		.dest_burst_length = 1,
		.block_count = 1,
	};

	/* zeros */
	struct dma_block_config block_z = {
		.source_address = (uint32_t)tx_zero,
		.dest_address = (uint32_t)rx_zero,
		.block_size = TRANSFER_SIZE,
	};
	cfg.head_block = &block_z;
	zassert_ok(dma_config(dma_dev, DMA_CHANNEL, &cfg));
	zassert_ok(dma_start(dma_dev, DMA_CHANNEL));
	for (int t = 0; t < 100 && !dma_done; t++) { k_msleep(1); }
	zassert_true(dma_done, "timeout (zeros)");
	zassert_mem_equal(tx_zero, rx_zero, TRANSFER_SIZE, "zeros mismatch");

	/* ones */
	dma_done = false;
	struct dma_block_config block_o = {
		.source_address = (uint32_t)tx_ones,
		.dest_address = (uint32_t)rx_ones,
		.block_size = TRANSFER_SIZE,
	};
	cfg.head_block = &block_o;
	zassert_ok(dma_config(dma_dev, DMA_CHANNEL, &cfg));
	zassert_ok(dma_start(dma_dev, DMA_CHANNEL));
	for (int t = 0; t < 100 && !dma_done; t++) { k_msleep(1); }
	zassert_true(dma_done, "timeout (ones)");
	zassert_mem_equal(tx_ones, rx_ones, TRANSFER_SIZE, "ones mismatch");
}

/* TC-3: verify DMA channel works (config + start + stop on channel 0) */
ZTEST(dma, test_dma_channel_config_stop)
{
	/* 两个不同缓冲区：驱动显式拒绝 src == dst（-EINVAL），本项测的是
	 * 通道生命周期（config → start → 完成 → stop → 复用）。 */
	__nocache __aligned(32) static uint8_t src_buf[TRANSFER_SIZE];
	__nocache __aligned(32) static uint8_t dst_buf[TRANSFER_SIZE];

	for (int i = 0; i < TRANSFER_SIZE; i++) {
		src_buf[i] = (uint8_t)(0x80 + i);
	}
	memset(dst_buf, 0x00, sizeof(dst_buf));
	dma_done = false;
	dma_status = -1;

	struct dma_config cfg = {
		.dma_slot = 0,
		.channel_direction = MEMORY_TO_MEMORY,
		.dma_callback = dma_callback,
		.complete_callback_en = 1,   /* 使完成可观测（旧版没开，无从等完成） */
		.error_callback_dis = 0,
		.source_data_size = 1,
		.dest_data_size = 1,
		.source_burst_length = 1,
		.dest_burst_length = 1,
		.block_count = 1,
	};
	struct dma_block_config block = {
		.source_address = (uint32_t)src_buf,
		.dest_address = (uint32_t)dst_buf,
		.block_size = TRANSFER_SIZE,
	};
	cfg.head_block = &block;

	int ret = dma_config(dma_dev, DMA_CHANNEL, &cfg);
	zassert_equal(ret, 0, "dma_config failed: %d", ret);

	ret = dma_start(dma_dev, DMA_CHANNEL);
	zassert_equal(ret, 0, "dma_start failed: %d", ret);

	/* ★ 等完成 + 数据比对：把"ACTIVE→IDLE 迁移"从**不可观测**变成可归因的
	 * 数据证据。旧版只断 3 个 ret==0 —— 256B 传输 µs 级完成、硬件自清 ChEn，
	 * `dma_stop` 走早退分支同返 0，宣称的迁移根本没被验证（审计 A 组 P1-4）。 */
	for (int t = 0; t < 200 && !dma_done; t++) {
		k_msleep(1);
	}
	zassert_true(dma_done, "transfer did not complete in 200ms");
	zassert_mem_equal(src_buf, dst_buf, TRANSFER_SIZE, "lifecycle data mismatch");

	ret = dma_stop(dma_dev, DMA_CHANNEL);
	zassert_equal(ret, 0, "dma_stop failed: %d", ret);

	/* stop 后同通道必须可重新 config/start 并完成（状态确已回到可配置态） */
	memset(dst_buf, 0x00, sizeof(dst_buf));
	dma_done = false;
	zassert_ok(dma_config(dma_dev, DMA_CHANNEL, &cfg), "reconfig after stop failed");
	zassert_ok(dma_start(dma_dev, DMA_CHANNEL), "restart after stop failed");
	for (int t = 0; t < 200 && !dma_done; t++) {
		k_msleep(1);
	}
	zassert_true(dma_done, "post-stop transfer did not complete");
	zassert_mem_equal(src_buf, dst_buf, TRANSFER_SIZE, "post-stop data mismatch");
}

/* TC-4: invalid channel number returns error */
ZTEST(dma, test_dma_invalid_channel)
{
	__nocache __aligned(32) static uint8_t src[TRANSFER_SIZE];
	__nocache __aligned(32) static uint8_t dst[TRANSFER_SIZE];

	memset(src, 0x11, sizeof(src));
	memset(dst, 0x00, sizeof(dst));

	struct dma_config cfg = {
		.dma_slot = 0,
		.channel_direction = MEMORY_TO_MEMORY,
		.source_data_size = 1,
		.dest_data_size = 1,
		/* burst_length 必须显式给 1：缺省为 0 会触发 dw_dma_config() 的
		 * `source_burst_length > 0` 断言（kernel panic），本项会在
		 * 正对照阶段就被打断。 */
		.source_burst_length = 1,
		.dest_burst_length = 1,
		.block_count = 1,
	};
	struct dma_block_config block = {
		.source_address = (uint32_t)src,
		.dest_address = (uint32_t)dst,   /* 与 src 不同地址 */
		.block_size = TRANSFER_SIZE,
	};
	cfg.head_block = &block;

	/* ★ 正对照 + 精确错误码（审计 A 组 P1-4）：旧版 src==dst，驱动同址校验
	 * 也返 -EINVAL ⇒ 删掉通道越界守卫后本项仍 PASS，不可归因。先证明同一 cfg
	 * 在合法通道号被接受，再要求 ch99 返回**精确的 -EINVAL**。 */
	int ret = dma_config(dma_dev, DMA_CHANNEL, &cfg);
	zassert_equal(ret, 0, "positive control: valid channel rejected: %d", ret);

	ret = dma_config(dma_dev, 99, &cfg);
	ZT_INFO("test_dma_invalid_channel", "dma_config(99) ret=%d", ret);
	zassert_equal(ret, -EINVAL, "dma_config ch99 ret %d != -EINVAL", ret);
}

/* ==================================================================
 * P1a 新增用例（2026-09-17）
 *
 * 覆盖既有 4 项之外的驱动路径：多块 LLI 链、多通道并发、dmac2 实例。
 * 每项自建前置（各自 config/start），可独立通过。
 * ================================================================== */

/* dmac2（0x40042000，与 dmac1 同 compatible、同 8 通道）：
 * 既有用例全部只跑 dmac1；本项需 app.overlay 追加 `&dmac2 { status="okay"; };`。 */
#define DMA2_NODE DT_NODELABEL(dmac2)

static volatile bool dma2_done;
static volatile int dma2_status;

static void dma2_callback(const struct device *dev, void *arg,
			  uint32_t id, int status)
{
	ARG_UNUSED(dev);
	ARG_UNUSED(arg);
	ARG_UNUSED(id);
	dma2_status = status;
	dma2_done = true;
}

/* 多通道并发：按通道号分别记账（回调的 id = channel 号，见 dw_dma_isr） */
static volatile bool dma_ch_done[2];
static volatile int dma_ch_status[2];

static void dma_ch_callback(const struct device *dev, void *arg,
			    uint32_t id, int status)
{
	ARG_UNUSED(dev);
	ARG_UNUSED(arg);

	if (id < 2) {
		dma_ch_status[id] = status;
		dma_ch_done[id] = true;
	}
}

/* TC-5: LLI 多块 scatter-gather（block_count=2）—— 覆盖 dw_dma_config 的
 *   多块循环与描述符 lp 链接（dma_dw_common.c:265-506）、dw_dma_start 的
 *   LLP 写回（:611-624）。pool 上限 = CONFIG_DMA_DW_LLI_POOL_SIZE = 2。 */
ZTEST(dma, test_dma_lli_chain)
{
	__nocache __aligned(32) static uint8_t src[128];
	__nocache __aligned(32) static uint8_t dst[128];

	for (int i = 0; i < 128; i++) {
		src[i] = (uint8_t)(0x40 + i);
	}
	memset(dst, 0, sizeof(dst));
	dma_done = false;
	dma_status = -1;

	/* 两块各 64B：src[0..63] → dst[0..63]，src[64..127] → dst[64..127] */
	struct dma_block_config b1 = {
		.source_address = (uint32_t)(src + 64),
		.dest_address = (uint32_t)(dst + 64),
		.block_size = 64,
		.next_block = NULL,
	};
	struct dma_block_config b0 = {
		.source_address = (uint32_t)src,
		.dest_address = (uint32_t)dst,
		.block_size = 64,
		.next_block = &b1,
	};
	struct dma_config cfg = {
		.dma_slot = 0,
		.channel_direction = MEMORY_TO_MEMORY,
		.dma_callback = dma_callback,
		.complete_callback_en = 1,
		.error_callback_dis = 0,
		.source_data_size = 1,
		.dest_data_size = 1,
		.source_burst_length = 1,
		.dest_burst_length = 1,
		.block_count = 2,
		.head_block = &b0,
	};

	int ret = dma_config(dma_dev, DMA_CHANNEL, &cfg);

	zassert_equal(ret, 0, "dma_config(2 blocks) failed: %d", ret);

	ret = dma_start(dma_dev, DMA_CHANNEL);
	zassert_equal(ret, 0, "dma_start(2 blocks) failed: %d", ret);

	for (int t = 0; t < 200 && !dma_done; t++) {
		k_msleep(1);
	}
	zassert_true(dma_done, "LLI chain transfer timeout");

	ZT_INFO("test_dma_lli_chain", "blocks=2,block_size=64,status=%d", dma_status);
	zassert_mem_equal(src, dst, sizeof(src), "LLI chain data mismatch");
}

/* TC-6: 多通道同时传输（ch0 + ch1），验证通道状态互相隔离、数据不串扰。 */
ZTEST(dma, test_dma_multi_channel_concurrent)
{
	__nocache __aligned(32) static uint8_t src0[128];
	__nocache __aligned(32) static uint8_t dst0[128];
	__nocache __aligned(32) static uint8_t src1[128];
	__nocache __aligned(32) static uint8_t dst1[128];

	for (int i = 0; i < 128; i++) {
		src0[i] = (uint8_t)i;
		src1[i] = (uint8_t)(0xFF - i);
	}
	memset(dst0, 0xA5, sizeof(dst0));
	memset(dst1, 0x5A, sizeof(dst1));
	dma_ch_done[0] = dma_ch_done[1] = false;
	dma_ch_status[0] = dma_ch_status[1] = -1;

	struct dma_config cfg0 = {
		.dma_slot = 0,
		.channel_direction = MEMORY_TO_MEMORY,
		.dma_callback = dma_ch_callback,
		.complete_callback_en = 1,
		.error_callback_dis = 0,
		.source_data_size = 1,
		.dest_data_size = 1,
		.source_burst_length = 1,
		.dest_burst_length = 1,
		.block_count = 1,
	};
	struct dma_block_config blk0 = {
		.source_address = (uint32_t)src0,
		.dest_address = (uint32_t)dst0,
		.block_size = 128,
	};
	struct dma_config cfg1 = cfg0;
	struct dma_block_config blk1 = {
		.source_address = (uint32_t)src1,
		.dest_address = (uint32_t)dst1,
		.block_size = 128,
	};

	cfg0.head_block = &blk0;
	cfg1.head_block = &blk1;

	zassert_ok(dma_config(dma_dev, 0, &cfg0), "ch0 config failed");
	zassert_ok(dma_config(dma_dev, 1, &cfg1), "ch1 config failed");
	zassert_ok(dma_start(dma_dev, 0), "ch0 start failed");
	zassert_ok(dma_start(dma_dev, 1), "ch1 start failed");

	for (int t = 0; t < 200 && !(dma_ch_done[0] && dma_ch_done[1]); t++) {
		k_msleep(1);
	}

	ZT_INFO("test_dma_multi_channel_concurrent", "done0=%d,done1=%d,st0=%d,st1=%d",
		(int)dma_ch_done[0], (int)dma_ch_done[1],
		dma_ch_status[0], dma_ch_status[1]);
	zassert_true(dma_ch_done[0], "ch0 transfer did not complete");
	zassert_true(dma_ch_done[1], "ch1 transfer did not complete");
	zassert_mem_equal(src0, dst0, sizeof(src0), "ch0 data mismatch (crosstalk?)");
	zassert_mem_equal(src1, dst1, sizeof(src1), "ch1 data mismatch (crosstalk?)");

	/* 释放两个通道，避免影响后续用例 */
	dma_stop(dma_dev, 0);
	dma_stop(dma_dev, 1);
}

/* TC-7: dmac2 控制器 M2M 传输（第二个 DW DMAC 实例，既有用例只跑 dmac1）。 */
ZTEST(dma, test_dma_dmac2_transfer)
{
	const struct device *dev2 = DEVICE_DT_GET(DMA2_NODE);
	__nocache __aligned(32) static uint8_t src[256];
	__nocache __aligned(32) static uint8_t dst[256];

	zassert_true(device_is_ready(dev2),
		     "dmac2 not ready (app.overlay 需 &dmac2 status=okay?)");

	for (int i = 0; i < 256; i++) {
		src[i] = (uint8_t)(0x80 + i);
	}
	memset(dst, 0, sizeof(dst));
	dma2_done = false;
	dma2_status = -1;

	struct dma_config cfg = {
		.dma_slot = 0,
		.channel_direction = MEMORY_TO_MEMORY,
		.dma_callback = dma2_callback,
		.complete_callback_en = 1,
		.error_callback_dis = 0,
		.source_data_size = 1,
		.dest_data_size = 1,
		.source_burst_length = 1,
		.dest_burst_length = 1,
		.block_count = 1,
	};
	struct dma_block_config block = {
		.source_address = (uint32_t)src,
		.dest_address = (uint32_t)dst,
		.block_size = 256,
	};

	cfg.head_block = &block;

	int ret = dma_config(dev2, 0, &cfg);

	zassert_equal(ret, 0, "dmac2 dma_config failed: %d", ret);

	ret = dma_start(dev2, 0);
	zassert_equal(ret, 0, "dmac2 dma_start failed: %d", ret);

	for (int t = 0; t < 200 && !dma2_done; t++) {
		k_msleep(1);
	}
	zassert_true(dma2_done, "dmac2 transfer timeout");

	ZT_INFO("test_dma_dmac2_transfer", "bytes=256,status=%d", dma2_status);
	zassert_mem_equal(src, dst, sizeof(src), "dmac2 data mismatch");

	dma_stop(dev2, 0);
}

ZTEST_SUITE(dma, NULL, dma_test_setup, NULL, NULL, NULL);
```
