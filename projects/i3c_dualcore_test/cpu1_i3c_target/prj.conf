## CMakeLists.txt
```
# SPDX-License-Identifier: Apache-2.0

cmake_minimum_required(VERSION 3.20.0)
find_package(Zephyr REQUIRED HINTS $ENV{ZEPHYR_BASE})
project(cpu1_i3c_target)

# ztest 单出口覆盖点（SPEC_REFERENCE §6.9.3/§6.11.5）：本核为从核，把 ztest 的
# `PRINT_DATA` 指向 RLOG。覆盖头必须对**所有** TU 可见（ztest 库自己也用
# PRINT_DATA）⇒ 用 zephyr_include_directories 挂到 zephyr_interface。
zephyr_include_directories(${CMAKE_CURRENT_SOURCE_DIR}/src)

# 项目特定源文件
target_sources(app PRIVATE
    src/main.c
    src/i3c_target_test.c)

# 项目特定include目录
target_include_directories(app PRIVATE
    ${CMAKE_CURRENT_SOURCE_DIR}/../tests/include)

# 包含公共源文件和配置（test_results.c, ztest_glue.c, gpio_toggle.c）
include(${CMAKE_CURRENT_SOURCE_DIR}/../../../common/common_sources.cmake)

# RLOG 单出口（SPEC_REFERENCE §6.9.3）：只在本工程编入 —— 其余工程没有
# `rlog_channel` 设备树节点，编进去会因 DT_NODELABEL 取不到而构建失败。
target_sources(app PRIVATE
    ${CMAKE_CURRENT_SOURCE_DIR}/../../../common/rlog.c)

# ztest 单出口的长行预算（common/rlog.h::RLOG_TEXT_MAX 说明）：逐项 D1 行
# 可长到 ~56B（测试名 + " in X.XXX seconds"），默认 54B 会把结尾的
# 'seconds' 截掉 ⇒ 逐项证据被静默吞掉。两核取同一值（帧是双方 ABI），
# 且 overlay 的通道 width 必须 ≥ RLOG_TEXT_MAX+9（此处 118+9=127 ≤ 128）。
target_compile_definitions(app PRIVATE RLOG_TEXT_MAX=118)
```

## prj.conf
```kconfig
CONFIG_LOG=y
CONFIG_LOG_MODE_DEFERRED=y
CONFIG_LOG_BUFFER_SIZE=16384
CONFIG_LOG_PROCESS_THREAD_SLEEP_MS=10
CONFIG_SERIAL=y
CONFIG_SHELL=n
CONFIG_ZTEST=y
CONFIG_ZTEST_ASSERT_VERBOSE=1
# 逐项 START/PASS 行是 parse_ztest 数据源，必须开启（§10.26）
CONFIG_ZTEST_VERBOSE_OUTPUT=y
CONFIG_ZTEST_SUMMARY=n
CONFIG_I3C=y
CONFIG_I3C_USE_IBI=y
CONFIG_I3C_IBI_MAX_PAYLOAD_SIZE=8
CONFIG_I3C_LOG_LEVEL_OFF=y
CONFIG_PICOLIBC=y
CONFIG_NEWLIB_LIBC=n
CONFIG_MINIMAL_LIBC=n

# GPIO support for PA05/PA07 toggle threads
CONFIG_GPIO=y

# RLOG 单出口（SPEC_REFERENCE §6.9.3）：从核经 mbox 把 token 交给主核统一打印
CONFIG_MBOX=y
# ztest 输出换后端（§6.11.5）：tc_util.h 在定义 PRINT_DATA 前 include
# `tc_util_user_override.h`（见本核 src/），把逐项输出指向 RLOG。
CONFIG_ZTEST_TC_UTIL_USER_OVERRIDE=y
```

## app.overlay
```dts
&i3c6 {
    status = "okay";
    is-secondary;
    interrupts = <I3C6_IRQN 7>;
    tgt-pid = <0x0208 0x13811000>;
    dcr = <0x4>;
    bcr = <0x06>;
    /* 静态地址：写进 SCONFIG.SADDR，硬件据此响应 SETDASA/SETAASA 广播
     * （setaasa/setdasa 测试项用；日常传输仍走 ENTDAA 分配的 0x32，
     * MATCHSS 未置位，静态地址不影响正常数据通路）。与协议头
     * I3C_TARGET_STATIC_ADDR 保持一致。 */
    static-address = <0x5a>;

    pinctrl-0 = <
        &i3c6_scl_pj08
        &i3c6_sda_pj09
    >;
    pinctrl-names = "default";
};

/* GPIO toggle 使能块统一走公共层（SPEC_REFERENCE §6.1.9 复用收敛）：
 * 使能 GPIOA（PA05/PA07 翻转线程所在端口），label 调整只改公共文件。
 * GPIO toggle 仅 cpu1 使用，cpu2 侧固件不编入 gpio_toggle.c、不 include 本片段。 */
#include "../../../common/gpio_toggle.dtsi"

/* RLOG 单出口通道（SPEC_REFERENCE §6.9.3）：两核 token 汇成一路串口流。
 * `channel` 单元格必须等于本节点在 `&mbox` 子节点中的**序号**（驱动按
 * DT_INST_FOREACH_CHILD_STATUS_OKAY 的遍历序索引 FIFO），**以 zephyr.dts
 * 里 `&mbox` 的子节点顺序为准**，不要按固定数字或板级占用数推断：板级现有
 * 5 个 consumer（qspi/otbn/espi/vuart/pcc1 = 0..4），本项目追加 ⇒ 序号 5。
 * 两核必须一致；宽 128 与本工程 RLOG 帧长（127B）匹配。 */
&mbox {
	rlog_channel: rlog_channel {
		compatible = "vnd,mbox-consumer";
		mboxes = <&mbox 5 128 8 128 8>;
		mbox-names = "mbox";
	};
};
```

## src/main.c
```c
/*
 * Copyright (c) 2025 LinkedSemi
 *
 * SPDX-License-Identifier: Apache-2.0
 */

#include "i3c_target_test.h"
#include "i3c_dualcore_test_protocol.h"
#include "ztest_glue.h"
#include "rlog.h"

#include <stdio.h>
#include <string.h>
#include <zephyr/kernel.h>
#include <zephyr/device.h>
#include <zephyr/drivers/i3c.h>
#include <zephyr/logging/log.h>

LOG_MODULE_REGISTER(i3c_slave_test, LOG_LEVEL_INF);

const struct device *i3c_tgt_dev = DEVICE_DT_GET(DT_NODELABEL(i3c6));
uint8_t tgt_tx_buf[256];

void test_main(void)
{
	/* 不调用 zt_run_all()——test_main 不得返回（§4.1 dispatcher
	 * k_thread_join），逐项 ztest 由 dispatcher 按 'E' 事件运行。
	 *
	 * 单出口（§6.9.3/§6.11.5）：本核是**从核**⇒ 不往自己串口打 token。
	 * 逐项输出经 `tc_util_user_override.h` 把 PRINT_DATA 指向 RLOG 自动换
	 * 出口；BOOT 走公共宏的 printk 路径 ⇒ 此处显式换出口。本核 LOG / panic
	 * 现场仍走本核串口。本核不设 DONE：test_main 不返回（dispatcher join，
	 * §4.1），收尾标记由主核侧给出（本工程 TGT 无 PROJECT EXECUTION 属设计）。 */
	rlog_secondary_init();
	RLOG_ZT_BOOT("TGT");

	LOG_INF("[CPU1 SLAVE] I3C target test started");

	for (int i = 0; i < (int)sizeof(tgt_tx_buf); i++) {
		tgt_tx_buf[i] = (uint8_t)i;
	}

	target_test_init();
	target_dispatcher_run();
}
```

## src/i3c_target_test.h
```c
/*
 * Copyright (c) 2025 LinkedSemi
 *
 * SPDX-License-Identifier: Apache-2.0
 */

#ifndef I3C_TARGET_TEST_H
#define I3C_TARGET_TEST_H

#include <stdint.h>
#include <stddef.h>
#include <zephyr/device.h>

#ifdef __cplusplus
extern "C" {
#endif

extern const struct device *i3c_tgt_dev;
extern uint8_t tgt_tx_buf[256];

void target_test_init(void);
void target_dispatcher_run(void);

#ifdef __cplusplus
}
#endif

#endif /* I3C_TARGET_TEST_H */
```

## src/tc_util_user_override.h
```c
/*
 * SPDX-License-Identifier: Apache-2.0
 *
 * ztest 输出的**单出口**后端（SPEC_REFERENCE §6.9.3 / §6.11.5）。
 *
 * 启用方式（CMakeLists.txt）：
 *   zephyr_include_directories(${CMAKE_CURRENT_SOURCE_DIR}/src)
 * + prj.conf：CONFIG_ZTEST_TC_UTIL_USER_OVERRIDE=y
 *
 * 原理
 * ----
 * ztest 的全部逐项输出（`START - <name>` / ` PASS - <name> in X.XXX seconds` /
 * `====…` / `INFO` / `PROJECT EXECUTION` / 断言行）都经 `tc_util.h` 的
 * `PRINT_DATA` 发射。上游为此留了覆盖点：`CONFIG_ZTEST_TC_UTIL_USER_OVERRIDE`
 * ⇒ `tc_util.h` 在定义 `PRINT_DATA` **之前** include 本头文件，本头的
 * `#define` 抢先命中，ztest 源码零改动即完成换后端。
 *
 * 覆盖点必须对**所有** TU 可见（`ztest.c` 自身也用 PRINT_DATA）⇒ 只能用
 * `zephyr_include_directories()`（挂在 zephyr_interface 上），用
 * `target_include_directories(app …)` 会让 ztest 库编不过。
 *
 * 谁是"单出口"
 * ------------
 * 本核是**从核**（TGT）：不往自己的串口打 token，全部经 RLOG 交主核原样转发。
 * 现场保留不受影响——`__ASSERT` / `ZEPHYR FATAL ERROR` / 内核 oops 的寄存器
 * 与调用栈走内核自己的 printk，**不经 PRINT_DATA**，仍留在本核串口上。
 * 本核的 LOG 子系统输出（角色 banner 等）也仍走本核串口（不是 token）。
 *
 * 为什么只声明、不 include "rlog.h"
 * ---------------------------------
 * 本头被 ztest 库的 TU 也包含，而 `common/` 只挂在 app target 的 include 路径
 * 上（common_sources.cmake）⇒ 这里直接声明所需原型，避免扩大全局 include 面。
 */
#ifndef TC_UTIL_USER_OVERRIDE_H
#define TC_UTIL_USER_OVERRIDE_H

/* `common/rlog.h` 的同名声明（签名必须逐字一致）。 */
void rlog_emitf(const char *fmt, ...);

#ifndef PRINT_DATA
#if defined(RLOG_LOCAL_ECHO)
/* Integrated dual set: keep the cpu1 console informative while still relaying
 * the token to the controller. Echoing every START/PASS line with blocking
 * printk slowed the target enough to break tight read-path timing (run10c:
 * 24/35 on the controller). Echo only FAIL and SUMMARY locally; the full line
 * set still reaches the controller over RLOG. */
#include <zephyr/kernel.h>
#include <string.h>
#define PRINT_DATA(fmt, ...)                                                   \
	do {                                                                   \
		rlog_emitf(fmt, ##__VA_ARGS__);                                \
		if (strstr(fmt, "SUMMARY") != NULL ||                          \
		    strstr(fmt, "FAIL") != NULL) {                             \
			printk(fmt, ##__VA_ARGS__);                            \
		}                                                              \
	} while (0)
#elif defined(RLOG_LOCAL_ECHO_ALL)
/* Echo every ztest line locally as well as relaying it, EXCEPT while the I3C
 * target dispatcher is driving its 35 suites: those are timing-critical (the
 * TX-FIFO refill must answer inside the controller's read window) and a
 * synchronous printk there costs points.  Driver suites run from the mode
 * worker with the flag clear, so their "Running TESTSUITE ..." / PASS /
 * "TESTSUITE ... succeeded" lines do show up on this core's own UART - which is
 * what `itest peer <group>` users want to see.
 *
 * Why a flag and not a thread-name test: ztest runs every test in its own
 * thread (ztest.c creates `ztest_thread`), so `k_current_get()` inside
 * PRINT_DATA is never the "i3c_target" thread and a name guard suppressed
 * nothing -- measured 2026-10-28, all 35 target suites were echoed locally.
 * The flag is set/cleared around the dispatcher's suite call instead.
 * `rlog_local_echo_off` lives in common/rlog.c. */
extern volatile int rlog_local_echo_off;
#define PRINT_DATA(fmt, ...)                                                   \
	do {                                                                   \
		rlog_emitf(fmt, ##__VA_ARGS__);                                \
		if (!rlog_local_echo_off) {                                    \
			printk(fmt, ##__VA_ARGS__);                            \
		}                                                              \
	} while (0)
#else
#define PRINT_DATA(fmt, ...) rlog_emitf(fmt, ##__VA_ARGS__)
#endif
#endif

#endif /* TC_UTIL_USER_OVERRIDE_H */
```
