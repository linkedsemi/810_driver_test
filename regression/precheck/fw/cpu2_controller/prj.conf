## CMakeLists.txt
```
# SPDX-License-Identifier: Apache-2.0

cmake_minimum_required(VERSION 3.20.0)

# 810_driver_test 通用配置（cpu2 侧所有工程必须注入，只读引用不修改）：
#   cpu2_console_uart5.overlay  - 控制台 uart5（PN14/PN13, 115200）
#   cpu2_mem_layout.overlay     - 内存布局（sram_ro/sram 地址与大小，统一管理）
set(EXTRA_DTC_OVERLAY_FILE
    ${CMAKE_CURRENT_SOURCE_DIR}/../../../common/cpu2_console_uart5.overlay;
    ${CMAKE_CURRENT_SOURCE_DIR}/../../../common/cpu2_mem_layout.overlay)

find_package(Zephyr REQUIRED HINTS $ENV{ZEPHYR_BASE})
project(precheck_controller)

target_sources(app PRIVATE
    src/main.c)
```

## prj.conf
```kconfig
# 环境预检固件（controller 核，board cpu2）——从 i3c case controller 侧
# prj.conf 拷贝裁剪：删 i3c/ztest 项（预检非 ztest，A4）。§4.7 log 输出规范：
# deferred 模式 + LOG_BACKEND_UART + LOG_PRINTK=n（banner 走 printk 直通
# console UART，不被 log 子系统吞）。
CONFIG_LOG=y
CONFIG_LOG_MODE_DEFERRED=y
CONFIG_LOG_BUFFER_SIZE=16384
CONFIG_LOG_PROCESS_THREAD_SLEEP_MS=10
CONFIG_LOG_BACKEND_UART=y
# printk 直通 console UART，不经 log 子系统（deferred+shell 后端会吞 printk）
CONFIG_LOG_PRINTK=n
CONFIG_SERIAL=y
CONFIG_SHELL=n
CONFIG_PICOLIBC=y
CONFIG_NEWLIB_LIBC=n
CONFIG_MINIMAL_LIBC=n
```

## src/main.c
```c
/*
 * SPDX-License-Identifier: Apache-2.0
 *
 * 环境预检固件（controller 核）：最小 boot，纯链路验证。
 * 只打角色 banner + ZT_BOOT 后挂起；不依赖任何外设。
 * 串口：uart5（COM15）。
 */
#include <zephyr/kernel.h>
#include <zephyr/sys/printk.h>

void main(void)
{
	printk("[PRE CK CTRL] precheck controller boot\n");
	printk("ZT_BOOT CTRL\n");
	while (1) {
		k_sleep(K_FOREVER);
	}
}
```
