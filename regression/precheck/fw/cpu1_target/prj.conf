## CMakeLists.txt
```
# SPDX-License-Identifier: Apache-2.0

cmake_minimum_required(VERSION 3.20.0)
find_package(Zephyr REQUIRED HINTS $ENV{ZEPHYR_BASE})
project(precheck_target)

target_sources(app PRIVATE
    src/main.c)
```

## prj.conf
```kconfig
# 环境预检固件（target 核，board cpu1）——从 i3c case target 侧 prj.conf
# 拷贝裁剪：删 i3c/ztest 项（预检非 ztest，A4）。§4.7 log 输出规范：与
# controller 侧对称（banner 走 printk 直通 console UART）。
CONFIG_LOG=y
CONFIG_LOG_MODE_DEFERRED=y
CONFIG_LOG_BUFFER_SIZE=16384
CONFIG_LOG_PROCESS_THREAD_SLEEP_MS=10
CONFIG_LOG_BACKEND_UART=y
# printk 直通 console UART，不经 log 子系统（deferred+shell 后端会吞 printk）
CONFIG_LOG_PRINTK=n
CONFIG_SERIAL=y
CONFIG_SHELL=n
CONFIG_PICOLIBC=y
CONFIG_NEWLIB_LIBC=n
CONFIG_MINIMAL_LIBC=n
```

## src/main.c
```c
/*
 * SPDX-License-Identifier: Apache-2.0
 *
 * 环境预检固件（target 核）：最小 boot，纯链路验证。
 * 只打角色 banner + ZT_BOOT 后挂起；不依赖任何外设。
 * 串口：uart1（COM16）。
 */
#include <zephyr/kernel.h>
#include <zephyr/sys/printk.h>

void main(void)
{
	printk("[PRE CK TGT] precheck target boot\n");
	printk("ZT_BOOT TGT\n");
	while (1) {
		k_sleep(K_FOREVER);
	}
}
```
